/*****************************************************************************
   data.c
   Generated By:
   Raptor 2022b_1.1.14772 (6969)
   Matlab (R2022b) 9.13

   Copyright (c) 2018 New Eagle Products, Inc.
   All rights reserved.

   Code Generated at: Wed Feb 22 21:12:12 2023
 *****************************************************************************/

#include "raptor_types.h"
#include "data.h"
#include "string.h"                    /* TODO Reseach availabilty */
#include "eagle_EVSR24.h"
#include "eagle_EVSR24_private.h"

/* SS_DOUBLE  =  0,    / real32_T    /
   SS_SINGLE  =  1,    / real32_T  /
   SS_INT8    =  2,    / int8_T    /
   SS_UINT8   =  3,    / uint8_T   /
   SS_INT16   =  4,    / int16_T   /
   SS_UINT16  =  5,    / uint16_T  /
   SS_INT32   =  6,    / int32_T   /
   SS_UINT32  =  7,    / uint32_T  /
   SS_BOOLEAN =  8     / boolean_T */
#define START_SECTION_volatile_SlowRam_oem_32bit
#include "swsh_rb2oem.h"

RAMVariables_T RAMVariables ;

#define STOP_SECTION_volatile_SlowRam_oem_32bit
#include "swsh_rb2oem.h"
#define START_SECTION_Const_oem_32bit
#include "swsh_rb2oem.h"

const RAMVariables_T RAMVariables_DEFAULT = {
  55,                                  /*INIT_RAM_Variables*/
  0,                                   /* FgndTasksStopped */
  0,                                   /* KeySw_Bgnd */
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  0U,                                  /* EEPROM_State */
};

#define STOP_SECTION_Const_oem_32bit
#include "swsh_rb2oem.h"

void initRAMVariables(RAMVariables_T* ramVariables)
{
  memcpy(ramVariables, &RAMVariables_DEFAULT, sizeof(RAMVariables_DEFAULT));
}

#define START_SECTION_Const_oem_32bit
#include "swsh_rb2oem.h"

const CONSTVariables_T CONSTVariables = {
  { 101U, 97U, 103U, 108U, 101U, 95U, 69U, 86U, 83U, 82U, 50U, 52U, },/* ModelName */
  2UL,                                 /* BuildNumber */

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  2814916334UL,                        /* LiteModeKey */
};

#define STOP_SECTION_Const_oem_32bit
#include "swsh_rb2oem.h"

void initCONSTVariables(const CONSTVariables_T* cv)
{

#ifdef UNUSED

  UNUSED(cv);

#endif

}

/* Total EEPROM Structure Size: 34U Bytes */
#define START_SECTION_Const_oem_32bit
#include "swsh_rb2oem.h"

const EEVariables_T EEVariables_DEFAULT = {
  0,                                  /* Write Count: Identifies active Copy 	*/
  3219410521U,                         /* EE_UniqID 	*/
  0.2F,                                /* KeySwHiTimeThr */
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  0,                                   /* CRC Initial Value */
};

#define STOP_SECTION_Const_oem_32bit
#include "swsh_rb2oem.h"
#define START_SECTION_volatile_SlowRam_oem_32bit
#include "swsh_rb2oem.h"

EEVariables_T EEVariables_RAMShadow ;

#define STOP_SECTION_volatile_SlowRam_oem_32bit
#include "swsh_rb2oem.h"

uint32_T g_EE_LoadedCopy = 0;

#define FEE_NUM_PAGES                  18

uint16_T read_eeprom(void);

#define EE_PAGE_SIZE                   120
#define FEE_MAX_NUM_PAGES              18
#define FEE_SIZE_CALC()                (((uint32_T)&FEEVariables_RAMShadow.CRC - (uint32_T)&FEEVariables_RAMShadow) + 2)
#define EE_SIZE_CALC()                 (((uint32_T)&EEVariables_RAMShadow.CRC - (uint32_T)&EEVariables_RAMShadow) + 2)
#define RETRY_MAX                      1000

bool g_feeWrite_Started = 0;

/* MANAGE EE PROM MEMORY */
void App_EE_Defaults(void)
{
  memcpy(&EEVariables_RAMShadow, &EEVariables_DEFAULT, sizeof(EEVariables_T));
  EEPROM_State_Data() = EE_LOADED_DEFAULTS;
}

void App_EE_Init(void);
void App_EE_Init(void)
{
  uint8_T firstStart= 0;
  uint32_T ee_size = EE_SIZE_CALC();
  if ((Reset_xHistBuf[0] == SWRESET_CBPROG_E) || ((Reset_xHistBuf[0] ==
        SWRESET_POWERON_SIMU_E) && (Reset_xHistBuf[1] == SWRESET_CBPROG_E))) {
    /* SWRESET_CBPROG_E */
    /* SWRESET_POWERON_SIMU_E, SWRESET_CBPROG_E */
    firstStart = (Reset_Env.xGrp == 0x06);
  } else if ((Reset_xHistBuf[0] == RESET_SWRESET_MOCRAM_REPEXOK) &&
             (Reset_xHistBuf[1] == SWRESET_POWERON_SIMU_E) && (Reset_xHistBuf[2]
              == SWRESET_CBPROG_E)) {
    /*RESET_SWRESET_MOCRAM_REPEXOK, SWRESET_POWERON_SIMU_E, SWRESET_CBPROG_E */
    firstStart = (Reset_Env.xGrp == 0x07);
  }

  /* Fixed NV Read */
  if (firstStart) {
    /* Load defaults after programming - new values may have been merged into EEVariables_DEFAULT */
    App_EE_Defaults();
    EEPROM_State_Data() = EE_LOADED_DEFAULTS_AFTER_PROGRAMMING;
  } else if (read_eeprom() != SWS_EEP_SUCCEEDED) {
    /* Revert to defaults - error reading stored data */
    App_EE_Defaults();
    EEPROM_State_Data() = EE_LOADED_DEFAULTS_ERROR_READING;
  } else if (EEVariables_RAMShadow.EE_UniqID != EEVariables_DEFAULT.EE_UniqID) {
    /* Revert to defaults - the data stored previously doesn't match the format for the current application */
    App_EE_Defaults();
    EEPROM_State_Data() = EE_LOADED_DEFAULTS_INCORRECT_EEID;
  } else if (!is_crc_valid((void*)&EEVariables_RAMShadow, ee_size-2,
              EEVariables_RAMShadow.CRC)) {
    /* Revert to defaults - stored data is corrupted */
    App_EE_Defaults();
    EEPROM_State_Data() = EE_LOADED_DEFAULTS_INCORRECT_CRC;
  } else {
    /* Normal case startup, reloaded values */
    EEPROM_State_Data() = EE_LOADED_SAVED_VALUES;
                                      /* Normal case startup, reloaded values */
  }
}

void App_EE_Store(void)
{
}

/* Extra Funcitons Definitions for EEPROM */
uint16_T read_eeprom(void)
{
  swsEEP_ret result;
  uint16_T eeReadIdx = 20;
  uint8_T readBuf[120];
  uint8_T retryCnt = 0;
  uint8_T* wrPtr = (uint8_T*)&EEVariables_RAMShadow;
  uint32_T ee_size = EE_SIZE_CALC();
  uint16_T total_EE_PgCnt = (ee_size / EE_PAGE_SIZE) + ((ee_size % EE_PAGE_SIZE)
    > 0);
  uint16_T lastPageIdx = total_EE_PgCnt + 20;
  uint16_T lastFullpageIndx = 0;
  eeReadIdx = 20;
  lastPageIdx = total_EE_PgCnt + eeReadIdx;
  if ((EE_SIZE_CALC() % EE_PAGE_SIZE) == 0) {
    lastFullpageIndx = lastPageIdx;
  } else {
    lastFullpageIndx = lastPageIdx - 1;
  }

  /* READ Full EEPROM */
  for (; eeReadIdx < lastPageIdx; eeReadIdx++) {
    retryCnt = 0;
    for (retryCnt = 0; retryCnt < 25; retryCnt++) {
      result = swsEEP_Read_Directly((void*)&readBuf, eeReadIdx);
      if (result == SWS_EEP_SUCCEEDED) {
        break;
      }
    }

    if (result == SWS_EEP_SUCCEEDED) {
      /* copy into EEVariables_RAMShadow	*/
      if (eeReadIdx < lastFullpageIndx) {
        memcpy(wrPtr, &readBuf, EE_PAGE_SIZE);
        wrPtr += EE_PAGE_SIZE;
      } else {
        uint16_T eeReadSize = (EE_SIZE_CALC() % EE_PAGE_SIZE);
        if (eeReadSize == 0) {
          eeReadSize = EE_PAGE_SIZE;
        }

        memcpy(wrPtr, &readBuf, eeReadSize);
      }
    } else {
      break;
    }
  }

  return result;
}

void App_EE_WriteAsync(uint8_T startWrite)
{
  static uint32_T ee_size = 0;
  static uint16_T total_EE_PgCnt = 0;
  static bool eeWrite_Started = 0;
  static uint16_T eeWrite_RetryCnt = 0;
  static uint8_T* eeWrite_Ptr;
  static uint16_T eeWrite_Idx = 20;
  static uint16_T runningCRC = 0xFFFF;
  static uint32_T ee_WriteLen = 0;
  static uint16_T lastPageIdx = 0;
  static uint8_T writeBuffer[EE_PAGE_SIZE] = { 0 };

  swsEEP_ret result;

  //only execute if we are starting a write or already have one in progress
  if (!startWrite && !eeWrite_Started) {
    return;
  }

  if (!eeWrite_Started) {
    eeWrite_RetryCnt = 0;
    eeWrite_Ptr = (void*)&EEVariables_RAMShadow;
    EEPROM_State_Data() = EE_STORE_IN_PROGESS;
    ee_size = EE_SIZE_CALC();
    total_EE_PgCnt = (ee_size / EE_PAGE_SIZE) + ((ee_size % EE_PAGE_SIZE) > 0);
    eeWrite_Started = 1;
    eeWrite_Idx = 20;
    ee_WriteLen = EE_PAGE_SIZE;
    lastPageIdx = total_EE_PgCnt + eeWrite_Idx - 1;
    runningCRC = 0xFFFF;
    if (total_EE_PgCnt == 1) {
      SuspInt();                     //suspend interrupts while we calculate CRC

      //and copy to write buffer so data is not modified elsewhere

      //EE is a single page
      ee_WriteLen = ee_size;
      runningCRC = crc16_spd((void*)&EEVariables_RAMShadow, ee_WriteLen-2,
        runningCRC);
      EEVariables_RAMShadow.CRC = runningCRC;
      memcpy((void*)&writeBuffer, eeWrite_Ptr, ee_WriteLen);
      ResInt();
    } else {
      memcpy((void*)&writeBuffer, eeWrite_Ptr, ee_WriteLen);
      runningCRC = crc16_spd((void*)&writeBuffer, ee_WriteLen, runningCRC);
    }

    // Write the first set of pages to the queue
    result = swsEEP_Write_Directly((void*)&writeBuffer, eeWrite_Idx);
  } else {
    // Check status of previous page writes
    result = swsEEP_Write_Directly((void*)&writeBuffer, eeWrite_Idx);
    if (result == SWS_EEP_SUCCEEDED) {
      //Success
      eeWrite_RetryCnt = 0;
      eeWrite_Idx++;
      eeWrite_Ptr += EE_PAGE_SIZE;
      if (eeWrite_Idx == lastPageIdx ) {
        //last page, update crc
        SuspInt();                   //suspend interrupts while we calculate CRC

        //and copy to write buffer so data is not modified elsewhere
        ee_WriteLen = ee_size % EE_PAGE_SIZE;
        if (ee_WriteLen == 0) {
          ee_WriteLen = EE_PAGE_SIZE;
        }

        runningCRC = crc16_spd((void*)eeWrite_Ptr, ee_WriteLen-2, runningCRC);
        EEVariables_RAMShadow.CRC = runningCRC;
        memcpy((void*)&writeBuffer, (void*)eeWrite_Ptr, ee_WriteLen);
        ResInt();
      } else if (eeWrite_Idx < lastPageIdx) {
        memcpy((void*)&writeBuffer, eeWrite_Ptr, ee_WriteLen);
        runningCRC = crc16_spd((void*)&writeBuffer, ee_WriteLen, runningCRC);
      }

      /* Queue up the write operatation */
      if (eeWrite_Idx <= lastPageIdx) {
        // write new page
        result = swsEEP_Write_Directly((void*)&writeBuffer, eeWrite_Idx);
      } else {
        //finished
        eeWrite_Started = 0;
        EEPROM_State_Data() = EE_STORE_SUCCESS;
      }
    } else if (eeWrite_RetryCnt < RETRY_MAX) {
      //we will check next time
      eeWrite_RetryCnt++;
    } else {
      //Abort Operation
      EEPROM_State_Data() = EE_STORE_FAILED;
      eeWrite_Started = 0;
    }
  }
}
