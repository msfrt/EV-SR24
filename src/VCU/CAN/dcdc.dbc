VERSION ""

NS_ :

BS_:

BU_:

BO_ 2550173648 Command: 8 Vector__XXX
 SG_ Control_order : 1|2@0+ (1,0) [0|0] "" Vector__XXX
 SG_ Protect_order : 3|2@0+ (1,0) [0|0] "" Vector__XXX

BO_ 2550255759 General: 8 Vector__XXX
 SG_ DCDC_temperature : 63|8@0+ (0.1,0) [0|0] "" Vector__XXX
 SG_ DCDC_warm_temp : 40|1@0+ (1,0) [0|0] "" Vector__XXX
 SG_ DCDC_over_temp : 41|1@0+ (1,0) [0|0] "" Vector__XXX
 SG_ DCDC_OverVol_in : 42|1@0+ (1,0) [0|0] "" Vector__XXX
 SG_ DCDC_LowVol_in : 43|1@0+ (1,0) [0|0] "" Vector__XXX
 SG_ DCDC_OverVol_out : 44|1@0+ (1,0) [0|0] "" Vector__XXX
 SG_ DCDC_LowVol_out : 45|1@0+ (1,0) [0|0] "" Vector__XXX
 SG_ DCDC_overcur_out : 46|1@0+ (1,0) [0|0] "" Vector__XXX
 SG_ DCDC_ready : 32|1@0+ (1,0) [0|0] "" Vector__XXX
 SG_ DCDC_status : 33|1@0+ (1,0) [0|0] "" Vector__XXX
 SG_ DCDC_hard_fault : 34|1@0+ (1,0) [0|0] "" Vector__XXX
 SG_ DCDC_error_CAN : 35|1@0+ (1,0) [0|0] "" Vector__XXX
 SG_ DCDC_Fan_WaterCon : 36|1@0+ (1,0) [0|0] "" Vector__XXX
 SG_ DCDC_Stop_Error : 37|1@0+ (1,0) [0|0] "" Vector__XXX
 SG_ DCDC_WATER_FAN : 38|1@0+ (1,0) [0|0] "" Vector__XXX
 SG_ DCDC_HVIL_ERR : 39|1@0+ (1,0) [0|0] "" Vector__XXX
 SG_ DCDC_current : 23|16@0+ (0.1,0) [0|0] "" Vector__XXX
 SG_ DCDC_voltage : 7|16@0+ (0.1,0) [0|0] "" Vector__XXX

CM_ SG_ 2550173648 Control_order "Control Command
00:Reserve;01:start
0 0 10:stop;11:Reserve";
CM_ SG_ 2550173648 Protect_order "Protection command(once protection confirmed,converter won't work until restart)
00:Reserve;
01: Protectionconfirmed
10:Reserve;11:Reserve";
CM_ SG_ 2550255759 DCDC_temperature "DC_DC Temperature";
CM_ SG_ 2550255759 DCDC_warm_temp "DCDC over temperature warning; 1:warm, 0:Nowarm";
CM_ SG_ 2550255759 DCDC_over_temp "DCDC over temperature protection; 1:Error, 0:Noerror";
CM_ SG_ 2550255759 DCDC_OverVol_in "DCDC input over voltage; 1:Error, 0:Noerror";
CM_ SG_ 2550255759 DCDC_LowVol_in " DCDC input under voltage; 1:Error, 0:Noerror";
CM_ SG_ 2550255759 DCDC_OverVol_out "DCDC Output over voltage; 1:Error, 0:Noerror";
CM_ SG_ 2550255759 DCDC_LowVol_out "DCDC Input under voltage; 1:Error, 0:Noerror";
CM_ SG_ 2550255759 DCDC_overcur_out "DCDC output over current or short circuit; 1:Error, 0:Noerror";
CM_ SG_ 2550255759 DCDC_ready "DCDC Initialization complete; 0: uncompleted, 1:completed";
CM_ SG_ 2550255759 DCDC_status "DCDC working state; 0:stop,1:work";
CM_ SG_ 2550255759 DCDC_hard_fault "DCDC Hardware error; 0:No error,1:Error";
CM_ SG_ 2550255759 DCDC_error_CAN "DCDC Communication Error; 0:No error,1:Error";
CM_ SG_ 2550255759 DCDC_Fan_WaterCon "DCDC control; FAN 0:off?1:ON";
CM_ SG_ 2550255759 DCDC_Stop_Error "shut off error; 1:Error, 0:Noerror";
CM_ SG_ 2550255759 DCDC_WATER_FAN "Fan Control; 0:FANOFF?1: FANON";
CM_ SG_ 2550255759 DCDC_HVIL_ERR "High voltage lock error; 0:Lock accomplish,1NonLock";
CM_ SG_ 2550255759 DCDC_current "DCDC output current";
CM_ SG_ 2550255759 DCDC_voltage "DCDC output voltage";
BA_DEF_  "BusType" STRING ;
BA_DEF_DEF_  "BusType" "CAN";
