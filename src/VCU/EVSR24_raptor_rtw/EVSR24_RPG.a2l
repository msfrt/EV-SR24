ASAP2_VERSION 1 51
/begin PROJECT EVSR24_004 "A__Kv6KfdEe4w4m4A8_oz"
/begin MODULE EVSR24 "20038"
/begin MOD_COMMON /* COMMENT */ "" BYTE_ORDER MSB_LAST ALIGNMENT_BYTE 1 ALIGNMENT_FLOAT32_IEEE 1 ALIGNMENT_FLOAT64_IEEE 1 ALIGNMENT_LONG 1 ALIGNMENT_WORD 1 /end MOD_COMMON
/begin RECORD_LAYOUT RECORD_LAYOUT__2 AXIS_PTS_X 1 FLOAT32_IEEE /* IndexIncr */ INDEX_INCR /* Addressing */ DIRECT /end RECORD_LAYOUT
/begin RECORD_LAYOUT RECORD_LAYOUT__1 FNC_VALUES 1 FLOAT32_IEEE ROW_DIR DIRECT /end RECORD_LAYOUT
/begin RECORD_LAYOUT RECORD_LAYOUT__3 FNC_VALUES 1 UBYTE ROW_DIR DIRECT /end RECORD_LAYOUT
/begin RECORD_LAYOUT RECORD_LAYOUT__5 FNC_VALUES 1 ULONG ROW_DIR DIRECT /end RECORD_LAYOUT
/begin RECORD_LAYOUT RECORD_LAYOUT__6 FNC_VALUES 1 UWORD ROW_DIR DIRECT /end RECORD_LAYOUT
/begin COMPU_METHOD COMPU_METHOD__22 "" RAT_FUNC "%1.0" "count" COEFFS 0 1 0 0 0 1 /end COMPU_METHOD
/begin COMPU_METHOD COMPU_METHOD__43 "" RAT_FUNC "%10.6" "ms" COEFFS 0 1 0 0 0 0.001 /end COMPU_METHOD
/begin COMPU_METHOD COMPU_METHOD__19 "" RAT_FUNC "%3.0" "" COEFFS 0 1 0 0 0 1 /end COMPU_METHOD
/begin COMPU_METHOD COMPU_METHOD__20 "" RAT_FUNC "%4.0" "" COEFFS 0 1 0 0 0 1 /end COMPU_METHOD
/begin COMPU_METHOD COMPU_METHOD__29 "" RAT_FUNC "%4.0" "cnt" COEFFS 0 1 0 0 0 1 /end COMPU_METHOD
/begin COMPU_METHOD COMPU_METHOD__27 "" RAT_FUNC "%4.0" "ms" COEFFS 0 1 0 0 0 1 /end COMPU_METHOD
/begin COMPU_METHOD COMPU_METHOD__39 "" RAT_FUNC "%4.0" "NA" COEFFS 0 1 0 0 0 1 /end COMPU_METHOD
/begin COMPU_METHOD COMPU_METHOD__35 "" RAT_FUNC "%4.0" "Sec" COEFFS 0 1 0 0 0 0.1 /end COMPU_METHOD
/begin COMPU_METHOD COMPU_METHOD__5 "" RAT_FUNC "%5.0" "" COEFFS 0 1 0 0 0 1 /end COMPU_METHOD
/begin COMPU_METHOD COMPU_METHOD__26 "" RAT_FUNC "%6.0" "cnt" COEFFS 0 1 0 0 0 1 /end COMPU_METHOD
/begin COMPU_METHOD COMPU_METHOD__32 "" RAT_FUNC "%6.2" "%" COEFFS 0 1 0 0 0 0.01 /end COMPU_METHOD
/begin COMPU_METHOD COMPU_METHOD__33 "" RAT_FUNC "%6.2" "%" COEFFS 0 1 100 0 0 0.01 /end COMPU_METHOD
/begin COMPU_METHOD COMPU_METHOD__40 "" RAT_FUNC "%6.2" "NA" COEFFS 0 1 0 0 0 0.00152588 /end COMPU_METHOD
/begin COMPU_METHOD COMPU_METHOD__17 "" RAT_FUNC "%7.0" "Counts" COEFFS 0 1 0 0 0 1 /end COMPU_METHOD
/begin COMPU_METHOD COMPU_METHOD__3 "" RAT_FUNC "%7.2" "" COEFFS 0 1 0 0 0 1 /end COMPU_METHOD
/begin COMPU_METHOD COMPU_METHOD__16 "" RAT_FUNC "%7.2" "Deg_C" COEFFS 0 1 0 0 0 1 /end COMPU_METHOD
/begin COMPU_METHOD COMPU_METHOD__15 "" RAT_FUNC "%7.2" "V" COEFFS 0 1 0 0 0 1 /end COMPU_METHOD
/begin COMPU_METHOD COMPU_METHOD__42 "" RAT_FUNC "%7.3" "%" COEFFS 0 1 0 0 0 0.0001 /end COMPU_METHOD
/begin COMPU_METHOD COMPU_METHOD__25 "" RAT_FUNC "%7.3" "%" COEFFS 0 1 0 0 0 0.001 /end COMPU_METHOD
/begin COMPU_METHOD COMPU_METHOD__41 "" RAT_FUNC "%7.3" "%" COEFFS 0 1 0 0 0 0.002 /end COMPU_METHOD
/begin COMPU_METHOD COMPU_METHOD__24 "" RAT_FUNC "%7.3" "%" COEFFS 0 1 0 0 0 0.01 /end COMPU_METHOD
/begin COMPU_METHOD COMPU_METHOD__44 "" RAT_FUNC "%7.3" "flag" COEFFS 0 1 0 0 0 1 /end COMPU_METHOD
/begin COMPU_METHOD COMPU_METHOD__21 "" RAT_FUNC "%7.3" "ms" COEFFS 0 1 0 0 0 0.001 /end COMPU_METHOD
/begin COMPU_METHOD COMPU_METHOD__28 "" TAB_VERB "%1.0" "" COMPU_TAB_REF COMPU_VTAB__3 /end COMPU_METHOD
/begin COMPU_METHOD COMPU_METHOD__6 "" TAB_VERB "%3.0" "" COMPU_TAB_REF COMPU_VTAB__1 /end COMPU_METHOD
/begin COMPU_METHOD COMPU_METHOD__45 "" TAB_VERB "%3.0" "" COMPU_TAB_REF COMPU_VTAB__10 /end COMPU_METHOD
/begin COMPU_METHOD COMPU_METHOD__30 "" TAB_VERB "%3.0" "" COMPU_TAB_REF COMPU_VTAB__4 /end COMPU_METHOD
/begin COMPU_METHOD COMPU_METHOD__31 "" TAB_VERB "%3.0" "" COMPU_TAB_REF COMPU_VTAB__5 /end COMPU_METHOD
/begin COMPU_METHOD COMPU_METHOD__34 "" TAB_VERB "%3.0" "" COMPU_TAB_REF COMPU_VTAB__6 /end COMPU_METHOD
/begin COMPU_METHOD COMPU_METHOD__36 "" TAB_VERB "%4.0" "" COMPU_TAB_REF COMPU_VTAB__7 /end COMPU_METHOD
/begin COMPU_METHOD COMPU_METHOD__37 "" TAB_VERB "%4.0" "" COMPU_TAB_REF COMPU_VTAB__8 /end COMPU_METHOD
/begin COMPU_METHOD COMPU_METHOD__38 "" TAB_VERB "%4.0" "" COMPU_TAB_REF COMPU_VTAB__9 /end COMPU_METHOD
/begin COMPU_METHOD COMPU_METHOD__23 "" TAB_VERB "%6.0" "" COMPU_TAB_REF COMPU_VTAB__2 /end COMPU_METHOD
/begin COMPU_VTAB COMPU_VTAB__9 "" TAB_VERB 11 0 "SWRESET_GRP_POWERON_E" 1 "SWRESET_GRP_HWRESET_E" 2 "SWRESET_GRP_WDT_E" 3 "SWRESET_GRP_WAKEUP_E" 4 "SWRESET_GRP_TRAP_E" 5 "SWRESET_GRP_SB_E" 6 "SWRESET_GRP_CB_E" 7 "SWRESET_SOFTRESETGRP_E" 8 "SWRESET_GRP_DUMMY_01" 9 "SWRESET_GRP_DUMMY_02" 10 "SWRESET_GRP_SYC_KL15RST_E" /end COMPU_VTAB
/begin COMPU_VTAB COMPU_VTAB__5 "" TAB_VERB 12 0 "None" 1 "See_ResetReason" 2 "CPU Idle Threshold" 3 "Pct Overrun Limit" 4 "STARVATION" 5 "FGND Stack Margin" 6 "BGND Stack Margin" 7 "ApplicationInterupt Stack Margin" 8 "Heap Margin" 65535 "ForegroundOverrun" 65534 "BackgroundOverrun" 65533 "SecondOverrun" /end COMPU_VTAB
/begin COMPU_VTAB COMPU_VTAB__10 "" TAB_VERB 13 0 "Initialization" 1 "Loaded Defaults - Manual" 2 "Loaded Defaults - After Reprogramming" 3 "Loaded Defaults - Incorrect CRC" 4 "Loaded Defaults - Incorrect EE Format" 5 "Loaded Defaults - Error Reading EEPROM" 6 "Loaded Defaults - Failed Driver Initialization" 7 "Loaded Saved Values - After Reprogramming" 8 "Loaded Saved Values - Normal Startup" 9 "Loaded Saved Values - Backup Copy" 10 "Store In Progess" 11 "Store Attempt Failed" 12 "Store Succeeded" /end COMPU_VTAB
/begin COMPU_VTAB COMPU_VTAB__7 "" TAB_VERB 156 0 "SWRESET_POWERON_E" 1 "SWRESET_POWERON_WDT_E" 2 "SWRESET_POWERON_KL15_E" 3 "SWRESET_HW_E" 4 "SWRESET_WDT_E" 4096 "TRAP_MMU_VAF_E" 4097 "TRAP_MMU_VAP_E" 4098 "TRAP_INTPROT_PRIV_E" 4099 "TRAP_INTPROT_MPR_E" 4100 "TRAP_INTPROT_MPW_E" 4101 "TRAP_INTPROT_MPX_E" 4102 "TRAP_INTPROT_MPP_E" 4103 "TRAP_INTPROT_MPN_E" 4104 "TRAP_INTPROT_GRWP_E" 4105 "TRAP_INSTRERR_IOPC_E" 4106 "TRAP_INSTRERR_UOPC_E" 4107 "TRAP_INSTRERR_OPD_E" 4108 "TRAP_INSTRERR_ALN_E" 4109 "TRAP_INSTRERR_MEM_E" 4110 "TRAP_CONTMANA_FCD_E" 4111 "TRAP_CONTMANA_CDO_E" 4112 "TRAP_CONTMANA_CDU_E" 4113 "TRAP_CONTMANA_FCU_E" 4114 "TRAP_CONTMANA_CSU_E" 4115 "TRAP_CONTMANA_CTYP_E" 4116 "TRAP_CONTMANA_NEST_E" 4117 "TRAP_SYSBUSERR_PSE_E" 4118 "TRAP_SYSBUSERR_DSE_E" 4119 "TRAP_SYSBUSERR_DAE_E" 4120 "TRAP_SYSBUSERR_CAE_E" 4121 "TRAP_SYSBUSERR_PIE_E" 4122 "TRAP_SYSBUSERR_DIE_E" 4123 "TRAP_ASSTRAP_OVF_E" 4124 "TRAP_ASSTRAP_SOVF_E" 4125 "TRAP_SYSCALL_SYS_E" 4126 "TRAP_NMI_ESR0_E" 4127 "TRAP_NMI_ESR1_E" 4128 "TRAP_NMI_RES0_E" 4129 "TRAP_NMI_WDT_E" 4130 "TRAP_NMI_PE_E" 4131 "TRAP_NMI_OSCLWD_E" 4132 "TRAP_NMI_OSCHWD_E" 4133 "TRAP_NMI_OSCSPWD_E" 4134 "TRAP_NMI_SYSVCOLCK_E" 4135 "TRAP_NMI_ERAYVCOLCKT" 4136 "TRAP_NMI_FLOT_E" 4137 "TRAP_PE_P_IED_E" 4138 "TRAP_PE_P_IE_T_E" 4139 "TRAP_PE_P_IE_C_E" 4140 "TRAP_PE_P_IE_S_E" 4141 "TRAP_PE_P_IE_B_E" 4142 "TRAP_PE_D_IED_E" 4143 "TRAP_PE_D_IE_T_E" 4144 "TRAP_PE_D_IE_C_E" 4145 "TRAP_PE_D_IE_S_E" 4146 "TRAP_PE_D_IE_B_E" 4147 "TRAP_NMIPE_LDRAM_DSPR_E" 4148 "TRAP_NMIPE_DTAG_E" 4149 "TRAP_NMIPE_SPRAM_PSPR_E" 4150 "TRAP_NMIPE_PTAG_E" 4151 "TRAP_NMIPE_PMU_LMU_E" 4152 "TRAP_NMIPE_PRAM_E" 4153 "TRAP_NMIPE_CMEM_E" 4154 "TRAP_NMIPE_CAN_E" 4155 "TRAP_NMIPE_ERAY_E" 4156 "TRAP_NMIPE_SRI_E" 4157 "TRAP_NMIPE_EBU_E" 4158 "TRAP_NMIPE_BMU_E" 8192 "SWRESET_POWERON_SIMU_E" 8193 "SWRESET_HRESET_SIMU_E" 8194 "SWRESET_RB_PROG_E" 8195 "SWRESET_SOFTRESET_5VUNDERVOLTAGE_E" 8196 "SWRESET_SOFTRESET_POSTDRV2PREDRV_E" 8197 "SWRESET_CBPROG_E" 8198 "SWRESET_CBCPU_E" 8199 "SWRESET_RB_PROG_ILLEGAL_PATH_E" 8200 "SWRESET_TSW_EXIT_E" 8201 "SWRESET_TSW_HWTEST_FAIL_E" 8202 "SWRESET_TRPOT_FAIL_E" 8203 "SWRESET_OBD_SVC11_RESET_E" 8204 "SWRESET_SBDUMMY_6_E" 8205 "SWRESET_SBDUMMY_7_E" 8206 "SWRESET_SBDUMMY_8_E" 12288 "SWRST_EEPBANDGAP_E" 12289 "SWRST_EEPNODEBUGGER_E" 12290 "SWRST_EEPDELENVRAM_E" 12291 "SWRST_WRITE_ERRORS_SECTORCHANGE_E" 12292 "SWRST_EEPACTFIRSTINIT_E" 12293 "RESET_SWRESET_EPMHCRS_WAIT_PCP_RESET_E" 12294 "RESET_SWRESET_ESC_SCHED_RESET_E" 12295 "SWRST_EXECON_FAULTYSTATE_E" 12296 "RESET_SWRESET_ILLEGAL_OPCODE" 12297 "RESET_SWRESET_ILLEGAL_RETURN_TO_MAIN" 12298 "RESET_SWRESET_MEMLAY_MP_ACCESS" 12299 "SWRESET_MOCADCNTP_PREICO" 12300 "SWRESET_MOCADCTST_PREICO" 12301 "RESET_SWRESET_ILLEGAL_SW_PATH" 12302 "RESET_SWRESET_MOCCOM_SPI_ERROR" 12303 "RESET_SWRESET_MOCCOM_CTSOPTST" 12304 "RESET_SWRESET_MOCCOM_SOPTST" 12305 "RESET_SWRESET_MOCCOM_CPLCHK_FAILED" 12306 "RESET_SWRESET_MOCCOM_OS_TIMEOUT_ERROR" 12307 "RESET_SWRESET_MOCGPTA" 12308 "RESET_SWRESET_MOCMEM_CPLCHK_FAILED" 12309 "RESET_SWRESET_MOCMEM_CHKRAM_FAILED" 12310 "RESET_SWRESET_MOCMEM_CHKROM_FAILED" 12311 "RESET_SWRESET_MOCMEM_WTRAM_FAILED" 12312 "RESET_SWRESET_MOCMEM_WTROM_FAILED" 12313 "RESET_SWRESET_MOCPCP" 12314 "RESET_SWRESET_MOCRAM_WRI" 12315 "RESET_SWRESET_MOCRAM_CPL" 12316 "RESET_SWRESET_MOCRAM_RAMTAB" 12317 "RESET_SWRESET_MOCRAM_RSTPTRRAM" 12318 "RESET_SWRESET_MOCRAM_STACKRAM" 12319 "RESET_SWRESET_MOCRAM_CSARAM" 12320 "RESET_SWRESET_MOCRAM_XRAM" 12321 "RESET_SWRESET_MOCRAM_IRAM" 12322 "RESET_SWRESET_MOCRAM_EXRAM" 12323 "RESET_SWRESET_MOCRAM_PROTRAM" 12324 "RESET_SWRESET_MOCRAM_EEPCPL" 12325 "RESET_SWRESET_MOCRAM_REPEXOK" 12326 "RESET_SWRESET_MOCROM" 12327 "RESET_SWRESET_MOCROM_CPL" 12328 "RESET_SWRESET_MOCROM_INDEX" 12329 "RESET_SWRESET_SOPTEST_FAILED" 12330 "RESET_SWRESET_CPLCHK_FAILED" 12331 "RESET_SWRESET_MOCSOP_MSC_ERROR" 12332 "RESET_SWRESET_MOCSOP_SPI_ERROR" 12333 "RESET_SWRESET_MOCSOP_OS_TIMEOUT_ERROR" 12334 "RESET_SWRESET_MOCSOP_TIRESPTIME_ERROR" 12335 "SWRESET_OCWDA_WDA_ACTV" 12336 "SWRESET_OCWDA_WDA_MONITOR" 12337 "SWRESET_OCWDA_LOW_VLTG" 12338 "SWRESET_OCWDA_OVR_VLTG" 12339 "RESET_SWRESET_INTERRUPTLOCK_EXPECTED" 12340 "RESET_USERSTACKOVERFLOW_DETECTED" 12341 "SWRST_HWEMONDEFAULT_E" 12342 "RESET_ERRINTR_E" 12343 "SWRESET_CALWAKEUP_E" 12344 "SWRESET_DEADLINE1MS_E" 12345 "SWRESET_DEADLINE10MS_E" 12346 "SWRESET_DEADLINEBG_E" 12347 "SWRESET_NMIDISABLED_E" 12348 "SWRESET_POSTDRIVE_E" 12349 "SWRESET_UNEXPSYCSTSUB_E" 12350 "SWRESET_SOFTRESET_WAKEUP_E" 12351 "SWRESET_SOFTRESET_SHUTDOWN_E" 12352 "SWRESET_UNDERVOLTAGE_E" 12353 "RESET_SWRESET_SWOVER_DONE" 12354 "SWRESET_UNSUPPORTED_CPU_E" 12355 "SWRST_CAN_MESSAGECONFIG" 12356 "SWRST_ADCI_ERROR_E" 12357 "SWRST_PMD_PM_ERROR_E" 12358 "RESET_DMA_ERROR_E" 12359 "SWRST_FLASHCONFIG_E" 12360 "SWRESET_PCP_ERROR_E" /end COMPU_VTAB
/begin COMPU_VTAB COMPU_VTAB__2 "" TAB_VERB 2 0 "None" 20038 "Lite" /end COMPU_VTAB
/begin COMPU_VTAB COMPU_VTAB__1 "" TAB_VERB 2 0 "Pass Through" 1 "Override" /end COMPU_VTAB
/begin COMPU_VTAB COMPU_VTAB__6 "" TAB_VERB 2 0 "Stop Application" 1 "Count Occurrences" /end COMPU_VTAB
/begin COMPU_VTAB COMPU_VTAB__3 "" TAB_VERB 3 0 "Normal Operation" 1 "Force Unsuspected" 2 "Force Suspected" /end COMPU_VTAB
/begin COMPU_VTAB COMPU_VTAB__4 "" TAB_VERB 5 0 "App Monitor Disabled" 1 "Running" 2 "Pause" 3 "Step" 4 "Reboot" /end COMPU_VTAB
/begin COMPU_VTAB COMPU_VTAB__8 "" TAB_VERB 5 0 "OCWDA_CO_WDA_NOT_ACTV" -1802201964 "OCWDA_CO_WDA_OVRVLTG" -1431655766 "OCWDA_CO_WDA_ACTV" -1246382667 "OCWDA_CO_WDA_MONITOR" -943208505 "OCWDA_CO_WDA_LOWVLTG" /end COMPU_VTAB
/begin MEASUREMENT AppMonitorExecutionCount "Number of times application monitor has run." ULONG COMPU_METHOD__26 0 0 0 -1 ECU_ADDRESS 0xB0000DC4 /begin FUNCTION_LIST Application_Monitor /end FUNCTION_LIST /end MEASUREMENT
/begin MEASUREMENT AppMonitorLastError "Last error to pause the Application Monitor." UWORD COMPU_METHOD__31 0 0 0 65535 ECU_ADDRESS 0xB0000DBC /begin FUNCTION_LIST Application_Monitor /end FUNCTION_LIST /end MEASUREMENT
/begin MEASUREMENT AppMonitorNumForegroundOverruns "Number of times that Foreground execution was delayed by more than the specified limit" ULONG COMPU_METHOD__26 0 0 0 -1 ECU_ADDRESS 0x80038160 /begin FUNCTION_LIST Application_Monitor /end FUNCTION_LIST /end MEASUREMENT
/begin MEASUREMENT AppMonitorPctIdleTime "Estimated CPU idle time." ULONG COMPU_METHOD__32 0 0 0 100 ECU_ADDRESS 0xB0000DC0 /begin FUNCTION_LIST Application_Monitor /end FUNCTION_LIST /end MEASUREMENT
/begin MEASUREMENT AppMonitorPctOverrun "Percentage of the Foreground period that the Foreground execution was delayed by" ULONG COMPU_METHOD__33 0 0 0 100 ECU_ADDRESS 0xB0000DC8 /begin FUNCTION_LIST Application_Monitor /end FUNCTION_LIST /end MEASUREMENT
/begin MEASUREMENT B_pwf "Power fail bit." UBYTE COMPU_METHOD__39 0 0 0 255 ECU_ADDRESS 0xD000001B /begin FUNCTION_LIST Platform /end FUNCTION_LIST /end MEASUREMENT
/begin MEASUREMENT Background_LongestRun "Longest measured run of the task in milliseconds." ULONG COMPU_METHOD__21 0 0 0 4294967.295 ECU_ADDRESS 0xB0000DE0 /begin FUNCTION_LIST Timed_Triggers /end FUNCTION_LIST /end MEASUREMENT
/begin MEASUREMENT Background_Pct_Usage "Percentage of processor time used by task." ULONG COMPU_METHOD__41 0 0 0 100 ECU_ADDRESS 0xB0000DD8 /begin FUNCTION_LIST Timed_Triggers /end FUNCTION_LIST /end MEASUREMENT
/begin MEASUREMENT Background_Period "Measured period of task." ULONG COMPU_METHOD__21 0 0 0 4294967.295 ECU_ADDRESS 0xB0000DDC /begin FUNCTION_LIST Timed_Triggers /end FUNCTION_LIST /end MEASUREMENT
/begin MEASUREMENT CAN1_CANRX_QueueCount "Number of messages currently in CAN1 transmission queue." UBYTE COMPU_METHOD__26 0 0 0 100 ECU_ADDRESS 0xB0000B14 /begin FUNCTION_LIST CAN /end FUNCTION_LIST /end MEASUREMENT
/begin MEASUREMENT CAN1_CANRX_QueueMax "Max number of messages seen in CAN1 transmission queue." UBYTE COMPU_METHOD__26 0 0 0 100 ECU_ADDRESS 0xB0000B15 /begin FUNCTION_LIST CAN /end FUNCTION_LIST /end MEASUREMENT
/begin MEASUREMENT CAN1_CANRX_QueueOverrun "Number of times the CAN1 transmission queue has overrun." UBYTE COMPU_METHOD__26 0 0 0 255 ECU_ADDRESS 0xB0000B13 /begin FUNCTION_LIST CAN /end FUNCTION_LIST /end MEASUREMENT
/begin MEASUREMENT CAN1_CANTX_QueueCount "Number of messages currently in CAN1 transmission queue." UBYTE COMPU_METHOD__26 0 0 0 100 ECU_ADDRESS 0xB0000B11 /begin FUNCTION_LIST CAN /end FUNCTION_LIST /end MEASUREMENT
/begin MEASUREMENT CAN1_CANTX_QueueMax "Max number of messages seen in CAN1 transmission queue." UBYTE COMPU_METHOD__26 0 0 0 100 ECU_ADDRESS 0xB0000B12 /begin FUNCTION_LIST CAN /end FUNCTION_LIST /end MEASUREMENT
/begin MEASUREMENT CAN1_CANTX_QueueOverrun "Number of times the CAN1 transmission queue has overrun." UBYTE COMPU_METHOD__26 0 0 0 255 ECU_ADDRESS 0xB0000B10 /begin FUNCTION_LIST CAN /end FUNCTION_LIST /end MEASUREMENT
/begin MEASUREMENT CAN2_CANTX_QueueCount "Number of messages currently in CAN2 transmission queue." UBYTE COMPU_METHOD__26 0 0 0 100 ECU_ADDRESS 0xB0000B17 /begin FUNCTION_LIST CAN /end FUNCTION_LIST /end MEASUREMENT
/begin MEASUREMENT CAN2_CANTX_QueueMax "Max number of messages seen in CAN2 transmission queue." UBYTE COMPU_METHOD__26 0 0 0 100 ECU_ADDRESS 0xB0000B18 /begin FUNCTION_LIST CAN /end FUNCTION_LIST /end MEASUREMENT
/begin MEASUREMENT CAN2_CANTX_QueueOverrun "Number of times the CAN2 transmission queue has overrun." UBYTE COMPU_METHOD__26 0 0 0 255 ECU_ADDRESS 0xB0000B16 /begin FUNCTION_LIST CAN /end FUNCTION_LIST /end MEASUREMENT
/begin MEASUREMENT ContextSaveAreaSize "Current % System Context Save Area Consumption." UWORD COMPU_METHOD__40 0 0 0 99.9985458 ECU_ADDRESS 0xD0009864 /begin FUNCTION_LIST Platform /end FUNCTION_LIST /end MEASUREMENT
/begin MEASUREMENT EEPROM_State "EEPROM State on startup." UBYTE COMPU_METHOD__45 0 0 0 255 ECU_ADDRESS 0xB0000DFC /begin FUNCTION_LIST System /end FUNCTION_LIST /end MEASUREMENT
/begin MEASUREMENT Foreground_LongestRun "Longest measured run of the task in milliseconds." ULONG COMPU_METHOD__21 0 0 0 4294967.295 ECU_ADDRESS 0xB0000DD4 /begin FUNCTION_LIST Timed_Triggers /end FUNCTION_LIST /end MEASUREMENT
/begin MEASUREMENT Foreground_Pct_Usage "Percentage of processor time used by task." ULONG COMPU_METHOD__24 0 0 0 100 ECU_ADDRESS 0xB0000DCC /begin FUNCTION_LIST Timed_Triggers /end FUNCTION_LIST /end MEASUREMENT
/begin MEASUREMENT Foreground_Period "Measured period of task." ULONG COMPU_METHOD__21 0 0 0 4294967.295 ECU_ADDRESS 0xB0000DD0 /begin FUNCTION_LIST Timed_Triggers /end FUNCTION_LIST /end MEASUREMENT
/begin MEASUREMENT IN_coolPolarity_bool "" UBYTE COMPU_METHOD__5 0 0 0 1 ECU_ADDRESS 0xB0000AF0 /begin FUNCTION_LIST coolSwitch /end FUNCTION_LIST /end MEASUREMENT
/begin MEASUREMENT IN_groundSpeedFL_mph "" FLOAT32_IEEE COMPU_METHOD__3 0 0 -1E+17 1E+17 ECU_ADDRESS 0xB0000AC8 /begin FUNCTION_LIST wheelSpeedFL /end FUNCTION_LIST /end MEASUREMENT
/begin MEASUREMENT IN_groundSpeedFR_mph "" FLOAT32_IEEE COMPU_METHOD__3 0 0 -1E+17 1E+17 ECU_ADDRESS 0xB0000AD4 /begin FUNCTION_LIST wheelSpeedFR /end FUNCTION_LIST /end MEASUREMENT
/begin MEASUREMENT IN_groundSpeedRL_mph "" FLOAT32_IEEE COMPU_METHOD__3 0 0 -1E+17 1E+17 ECU_ADDRESS 0xB0000AE0 /begin FUNCTION_LIST wheelSpeedRL /end FUNCTION_LIST /end MEASUREMENT
/begin MEASUREMENT IN_groundSpeedRR_mph "" FLOAT32_IEEE COMPU_METHOD__3 0 0 -1E+17 1E+17 ECU_ADDRESS 0xB0000AEC /begin FUNCTION_LIST wheelSpeedRR /end FUNCTION_LIST /end MEASUREMENT
/begin MEASUREMENT IN_markPolarity_bool "" UBYTE COMPU_METHOD__5 0 0 0 1 ECU_ADDRESS 0xB0000AF2 /begin FUNCTION_LIST markSwitch /end FUNCTION_LIST /end MEASUREMENT
/begin MEASUREMENT IN_pageDownPolarity_bool "" UBYTE COMPU_METHOD__5 0 0 0 1 ECU_ADDRESS 0xB0000AF3 /begin FUNCTION_LIST pageDown /end FUNCTION_LIST /end MEASUREMENT
/begin MEASUREMENT IN_pageUpPolarity_bool "" UBYTE COMPU_METHOD__5 0 0 0 1 ECU_ADDRESS 0xB0000AF4 /begin FUNCTION_LIST pageUp /end FUNCTION_LIST /end MEASUREMENT
/begin MEASUREMENT IN_Polarity_bool "" UBYTE COMPU_METHOD__5 0 0 0 1 ECU_ADDRESS 0xB0000AF1 /begin FUNCTION_LIST digitalSwitch1 /end FUNCTION_LIST /end MEASUREMENT
/begin MEASUREMENT IN_pttPolarity_bool "" UBYTE COMPU_METHOD__5 0 0 0 1 ECU_ADDRESS 0xB0000AF5 /begin FUNCTION_LIST pttSwitch /end FUNCTION_LIST /end MEASUREMENT
/begin MEASUREMENT IN_pwrDownPolarity_bool "" UBYTE COMPU_METHOD__5 0 0 0 1 ECU_ADDRESS 0xB0000AF6 /begin FUNCTION_LIST pwrDownSwitch /end FUNCTION_LIST /end MEASUREMENT
/begin MEASUREMENT IN_pwrUpPolarity_bool "" UBYTE COMPU_METHOD__5 0 0 0 1 ECU_ADDRESS 0xB0000AF7 /begin FUNCTION_LIST pwrUpSwitch /end FUNCTION_LIST /end MEASUREMENT
/begin MEASUREMENT IN_tireTempRLM_deg "" FLOAT32_IEEE COMPU_METHOD__3 0 0 -1E+17 1E+17 ECU_ADDRESS 0xB0000A88 /begin FUNCTION_LIST Override_21_ /end FUNCTION_LIST /end MEASUREMENT
/begin MEASUREMENT IN_tireTempRLO_deg "" FLOAT32_IEEE COMPU_METHOD__3 0 0 -1E+17 1E+17 ECU_ADDRESS 0xB0000A94 /begin FUNCTION_LIST Override_22_ /end FUNCTION_LIST /end MEASUREMENT
/begin MEASUREMENT IN_tireTempRRI_deg "" FLOAT32_IEEE COMPU_METHOD__3 0 0 -1E+17 1E+17 ECU_ADDRESS 0xB0000AA0 /begin FUNCTION_LIST Override_23_ /end FUNCTION_LIST /end MEASUREMENT
/begin MEASUREMENT IN_tireTempRRM_deg "" FLOAT32_IEEE COMPU_METHOD__3 0 0 -1E+17 1E+17 ECU_ADDRESS 0xB0000AAC /begin FUNCTION_LIST Override_24_ /end FUNCTION_LIST /end MEASUREMENT
/begin MEASUREMENT IN_tireTempRRO_deg "" FLOAT32_IEEE COMPU_METHOD__3 0 0 -1E+17 1E+17 ECU_ADDRESS 0xB0000AB8 /begin FUNCTION_LIST Override_25_ /end FUNCTION_LIST /end MEASUREMENT
/begin MEASUREMENT IN_tireTempVToDegRLM_LookupX_IN "Input for IN_tireTempVToDegRLM_LookupX" FLOAT32_IEEE COMPU_METHOD__3 0 0 -1E+17 1E+17 ECU_ADDRESS 0xB0000A80 /begin FUNCTION_LIST tireTempRLM /end FUNCTION_LIST /end MEASUREMENT
/begin MEASUREMENT IN_tireTempVToDegRLO_LookupX_IN "Input for IN_tireTempVToDegRLO_LookupX" FLOAT32_IEEE COMPU_METHOD__3 0 0 -1E+17 1E+17 ECU_ADDRESS 0xB0000A8C /begin FUNCTION_LIST tireTempRLO /end FUNCTION_LIST /end MEASUREMENT
/begin MEASUREMENT IN_tireTempVToDegRRI_LookupX_IN "Input for IN_tireTempVToDegRRI_LookupX" FLOAT32_IEEE COMPU_METHOD__3 0 0 -1E+17 1E+17 ECU_ADDRESS 0xB0000A98 /begin FUNCTION_LIST tireTempRRI /end FUNCTION_LIST /end MEASUREMENT
/begin MEASUREMENT IN_tireTempVToDegRRM_LookupX_IN "Input for IN_tireTempVToDegRRM_LookupX" FLOAT32_IEEE COMPU_METHOD__3 0 0 -1E+17 1E+17 ECU_ADDRESS 0xB0000AA4 /begin FUNCTION_LIST tireTempRRM /end FUNCTION_LIST /end MEASUREMENT
/begin MEASUREMENT IN_tireTempVToDegRRO_LookupX_IN "Input for IN_tireTempVToDegRRO_LookupX" FLOAT32_IEEE COMPU_METHOD__3 0 0 -1E+17 1E+17 ECU_ADDRESS 0xB0000AB0 /begin FUNCTION_LIST tireTempRRO /end FUNCTION_LIST /end MEASUREMENT
/begin MEASUREMENT IN_tsSwitchSig_v "" UWORD COMPU_METHOD__5 0 0 0 65535 ECU_ADDRESS 0xB0000ABC /begin FUNCTION_LIST tsSwitch_1_ /end FUNCTION_LIST /end MEASUREMENT
/begin MEASUREMENT IN_wheelSpeedFL_mps "" FLOAT32_IEEE COMPU_METHOD__3 0 0 -1E+17 1E+17 ECU_ADDRESS 0xB0000AC4 /begin FUNCTION_LIST wheelSpeedFL /end FUNCTION_LIST /end MEASUREMENT
/begin MEASUREMENT IN_wheelSpeedFL_rpm "" FLOAT32_IEEE COMPU_METHOD__3 0 0 -1E+17 1E+17 ECU_ADDRESS 0xB0000AC0 /begin FUNCTION_LIST wheelSpeedFL /end FUNCTION_LIST /end MEASUREMENT
/begin MEASUREMENT IN_wheelSpeedFR_mps "" FLOAT32_IEEE COMPU_METHOD__3 0 0 -1E+17 1E+17 ECU_ADDRESS 0xB0000AD0 /begin FUNCTION_LIST wheelSpeedFR /end FUNCTION_LIST /end MEASUREMENT
/begin MEASUREMENT IN_wheelSpeedFR_rpm "" FLOAT32_IEEE COMPU_METHOD__3 0 0 -1E+17 1E+17 ECU_ADDRESS 0xB0000ACC /begin FUNCTION_LIST wheelSpeedFR /end FUNCTION_LIST /end MEASUREMENT
/begin MEASUREMENT IN_wheelSpeedRL_mps "" FLOAT32_IEEE COMPU_METHOD__3 0 0 -1E+17 1E+17 ECU_ADDRESS 0xB0000ADC /begin FUNCTION_LIST wheelSpeedRL /end FUNCTION_LIST /end MEASUREMENT
/begin MEASUREMENT IN_wheelSpeedRL_rpm "" FLOAT32_IEEE COMPU_METHOD__3 0 0 -1E+17 1E+17 ECU_ADDRESS 0xB0000AD8 /begin FUNCTION_LIST wheelSpeedRL /end FUNCTION_LIST /end MEASUREMENT
/begin MEASUREMENT IN_wheelSpeedRR_mps "" FLOAT32_IEEE COMPU_METHOD__3 0 0 -1E+17 1E+17 ECU_ADDRESS 0xB0000AE8 /begin FUNCTION_LIST wheelSpeedRR /end FUNCTION_LIST /end MEASUREMENT
/begin MEASUREMENT IN_wheelSpeedRR_rpm "" FLOAT32_IEEE COMPU_METHOD__3 0 0 -1E+17 1E+17 ECU_ADDRESS 0xB0000AE4 /begin FUNCTION_LIST wheelSpeedRR /end FUNCTION_LIST /end MEASUREMENT
/begin MEASUREMENT MaxContextSaveAreaSize "Maximum % System Context Save Area Consumption." UWORD COMPU_METHOD__40 0 0 0 99.9985458 ECU_ADDRESS 0xD000986A /begin FUNCTION_LIST Platform /end FUNCTION_LIST /end MEASUREMENT
/begin MEASUREMENT MaxSystemStackSize "Maximum % System Stack Consumption." UWORD COMPU_METHOD__40 0 0 0 99.9985458 ECU_ADDRESS 0xD000986C /begin FUNCTION_LIST Platform /end FUNCTION_LIST /end MEASUREMENT
/begin MEASUREMENT MaxUserStackSize "Maximum % User Stack Consumption." UWORD COMPU_METHOD__40 0 0 0 99.9985458 ECU_ADDRESS 0xD000986E /begin FUNCTION_LIST Platform /end FUNCTION_LIST /end MEASUREMENT
/begin MEASUREMENT NumberOfResetsSincePowerOnReset "The number of resets since the last PowerOn Reset." UBYTE COMPU_METHOD__39 0 0 0 255 ECU_ADDRESS 0xD00017C7 /begin FUNCTION_LIST Platform /end FUNCTION_LIST /end MEASUREMENT
/begin MEASUREMENT OCWDA_stWDAPtt "Status information for diagnosis module to report reason of WDA activation." ULONG COMPU_METHOD__37 0 0 0 255 ECU_ADDRESS 0xD00015BC /begin FUNCTION_LIST Platform /end FUNCTION_LIST /end MEASUREMENT
/begin MEASUREMENT Reset_xHistBuf "Reset History." UWORD COMPU_METHOD__36 0 0 0 255 ECU_ADDRESS 0xD000D7C8 MATRIX_DIM 1 8 1 /begin FUNCTION_LIST Platform /end FUNCTION_LIST /end MEASUREMENT
/begin MEASUREMENT ResetGroupId "The last reset reason group id." UBYTE COMPU_METHOD__38 0 0 0 255 ECU_ADDRESS 0xD00017C6 /begin FUNCTION_LIST Platform /end FUNCTION_LIST /end MEASUREMENT
/begin MEASUREMENT ResetReason "The last reset reason." UWORD COMPU_METHOD__36 0 0 0 65535 ECU_ADDRESS 0xD00017C4 /begin FUNCTION_LIST Platform /end FUNCTION_LIST /end MEASUREMENT
/begin MEASUREMENT SafetyMonitor_Usage "Processor time (ms) used by task." ULONG COMPU_METHOD__43 0 0 0 4294967.295 ECU_ADDRESS 0xB0000DF8 /begin FUNCTION_LIST App_Triggers /end FUNCTION_LIST /end MEASUREMENT
/begin MEASUREMENT Second_LongestRun "Longest measured run of the task in milliseconds." ULONG COMPU_METHOD__21 0 0 0 4294967.295 ECU_ADDRESS 0xB0000DEC /begin FUNCTION_LIST Timed_Triggers /end FUNCTION_LIST /end MEASUREMENT
/begin MEASUREMENT Second_Pct_Usage "Percentage of processor time used by task." ULONG COMPU_METHOD__42 0 0 0 100 ECU_ADDRESS 0xB0000DE4 /begin FUNCTION_LIST Timed_Triggers /end FUNCTION_LIST /end MEASUREMENT
/begin MEASUREMENT Second_Period "Measured period of task." ULONG COMPU_METHOD__21 0 0 0 4294967.295 ECU_ADDRESS 0xB0000DE8 /begin FUNCTION_LIST Timed_Triggers /end FUNCTION_LIST /end MEASUREMENT
/begin MEASUREMENT Shutdown_Usage "Processor time (ms) used by task." ULONG COMPU_METHOD__43 0 0 0 4294967.295 ECU_ADDRESS 0xB0000DF4 /begin FUNCTION_LIST App_Triggers /end FUNCTION_LIST /end MEASUREMENT
/begin MEASUREMENT Startup_Usage "Processor time (ms) used by task." ULONG COMPU_METHOD__43 0 0 0 4294967.295 ECU_ADDRESS 0xB0000DF0 /begin FUNCTION_LIST App_Triggers /end FUNCTION_LIST /end MEASUREMENT
/begin MEASUREMENT SystemStackSize "Current % System Stack Consumption." UWORD COMPU_METHOD__40 0 0 0 99.9985458 ECU_ADDRESS 0xD0009866 /begin FUNCTION_LIST Platform /end FUNCTION_LIST /end MEASUREMENT
/begin MEASUREMENT UserStackSize "Current % User Stack Consumption." UWORD COMPU_METHOD__40 0 0 0 99.9985458 ECU_ADDRESS 0xD0009868 /begin FUNCTION_LIST Platform /end FUNCTION_LIST /end MEASUREMENT
/begin MEASUREMENT XCP_DAQ_TotalUsage "Processor time used by XCP in mSec." ULONG COMPU_METHOD__21 0 0 0 4294967.295 ECU_ADDRESS 0xB0000AFC /begin FUNCTION_LIST Application_Monitor /end FUNCTION_LIST /end MEASUREMENT
/begin MEASUREMENT XCP_DAQ00_10ms_Pct_Usage "Processor time used by DAQ 0 (10 ms)" ULONG COMPU_METHOD__24 0 0 0 42949672.95 ECU_ADDRESS 0xB0000B08 /begin FUNCTION_LIST Application_Monitor /end FUNCTION_LIST /end MEASUREMENT
/begin MEASUREMENT XCP_DAQ01_100ms_Pct_Usage "Processor time used by DAQ 1 (100 ms)" ULONG COMPU_METHOD__25 0 0 0 4294967.295 ECU_ADDRESS 0xB0000B0C /begin FUNCTION_LIST Application_Monitor /end FUNCTION_LIST /end MEASUREMENT
/begin MEASUREMENT XCP_Error_Count "XCP drop count." ULONG COMPU_METHOD__22 0 0 0 4294967295 ECU_ADDRESS 0xB0000B04 /begin FUNCTION_LIST Application_Monitor /end FUNCTION_LIST /end MEASUREMENT
/begin MEASUREMENT XCP_LongestRun "Longest measured run of the task in milliseconds." ULONG COMPU_METHOD__21 0 0 0 4294967.295 ECU_ADDRESS 0xB0000B00 /begin FUNCTION_LIST Application_Monitor /end FUNCTION_LIST /end MEASUREMENT
/begin CHARACTERISTIC AppMonitorForegroundOverrunAction "Action to take when overrun occurs" VALUE 0x80038164 RECORD_LAYOUT__3 0 COMPU_METHOD__34 0 255 /begin FUNCTION_LIST Application_Monitor /end FUNCTION_LIST /end CHARACTERISTIC
/begin CHARACTERISTIC AppMonitorState "State of the Application Monitor" VALUE 0x800380FE RECORD_LAYOUT__3 0 COMPU_METHOD__30 0 255 /begin FUNCTION_LIST Application_Monitor /end FUNCTION_LIST /end CHARACTERISTIC
/begin CHARACTERISTIC BuildNumber "Model build number." VALUE 0x8003B09C RECORD_LAYOUT__5 0 COMPU_METHOD__19 0 4294967295 READ_ONLY /end CHARACTERISTIC
/begin CHARACTERISTIC BuildUID "Unique build ID for this software." ASCII 0x8003B0D9 RECORD_LAYOUT__3 0 COMPU_METHOD__19 0 255 READ_ONLY MATRIX_DIM 21 1 1 /end CHARACTERISTIC
/begin CHARACTERISTIC CalIdTxt "Calibration ID for this Software Package." ASCII 0x8003B0CB RECORD_LAYOUT__3 0 COMPU_METHOD__19 0 255 MATRIX_DIM 14 1 1 /end CHARACTERISTIC
/begin CHARACTERISTIC CAN1_ErrorCheck_Interval "Frequency interval to check for CAN errors, 0 to disable." VALUE 0x8003B036 RECORD_LAYOUT__3 0 COMPU_METHOD__27 0 255 /begin FUNCTION_LIST CAN /end FUNCTION_LIST /end CHARACTERISTIC
/begin CHARACTERISTIC CAN1_ErrorPassive_Delay "Delay before restart after Error passive detected." VALUE 0x8003B037 RECORD_LAYOUT__3 0 COMPU_METHOD__27 0 255 /begin FUNCTION_LIST CAN /end FUNCTION_LIST /end CHARACTERISTIC
/begin CHARACTERISTIC CAN1_Startup_Delay "Delay before starting send/receive to allow bus conditions to settle out after powerup." VALUE 0x8003B034 RECORD_LAYOUT__6 0 COMPU_METHOD__27 20 60000 /begin FUNCTION_LIST CAN /end FUNCTION_LIST /end CHARACTERISTIC
/begin CHARACTERISTIC CAN2_ErrorCheck_Interval "Frequency interval to check for CAN errors, 0 to disable." VALUE 0x8003B03A RECORD_LAYOUT__3 0 COMPU_METHOD__27 0 255 /begin FUNCTION_LIST CAN /end FUNCTION_LIST /end CHARACTERISTIC
/begin CHARACTERISTIC CAN2_ErrorPassive_Delay "Delay before restart after Error passive detected." VALUE 0x8003B03B RECORD_LAYOUT__3 0 COMPU_METHOD__27 0 255 /begin FUNCTION_LIST CAN /end FUNCTION_LIST /end CHARACTERISTIC
/begin CHARACTERISTIC CAN2_Startup_Delay "Delay before starting send/receive to allow bus conditions to settle out after powerup." VALUE 0x8003B038 RECORD_LAYOUT__6 0 COMPU_METHOD__27 20 60000 /begin FUNCTION_LIST CAN /end FUNCTION_LIST /end CHARACTERISTIC
/begin CHARACTERISTIC DateStamp "Date and time the model was built." ASCII 0x8003B0F4 RECORD_LAYOUT__3 0 COMPU_METHOD__19 0 255 READ_ONLY MATRIX_DIM 20 1 1 /end CHARACTERISTIC
/begin CHARACTERISTIC EndOfStart "Indicates whether start is completed." VALUE 0x8003B091 RECORD_LAYOUT__3 0 COMPU_METHOD__44 0 255 /begin FUNCTION_LIST Platform /end FUNCTION_LIST /end CHARACTERISTIC
/begin CHARACTERISTIC EVSR24_step_Steps "Number of times to step the task." VALUE 0x80038100 RECORD_LAYOUT__6 0 COMPU_METHOD__29 0 65535 /begin FUNCTION_LIST Application_Monitor /end FUNCTION_LIST /end CHARACTERISTIC
/begin CHARACTERISTIC HardwareType "Hardware type for the target." VALUE 0x8003B0F0 RECORD_LAYOUT__5 0 COMPU_METHOD__19 0 4294967295 READ_ONLY /end CHARACTERISTIC
/begin CHARACTERISTIC IdTableRev "IdTableRev for the model (XCP device ids)." VALUE 0x8003B0EE RECORD_LAYOUT__6 0 COMPU_METHOD__19 0 65535 READ_ONLY /end CHARACTERISTIC
/begin CHARACTERISTIC IN_appsError_bool_FaultOperation "Calibration for testing fault." VALUE 0x8003B03C RECORD_LAYOUT__3 0 COMPU_METHOD__28 0 8 /begin FUNCTION_LIST FaultManager /end FUNCTION_LIST /end CHARACTERISTIC
/begin CHARACTERISTIC IN_appsError_bool_X_Limit "Limit threshold for X." VALUE 0x8003AA94 RECORD_LAYOUT__5 0 COMPU_METHOD__17 0 4294967295 /begin FUNCTION_LIST FaultManager /end FUNCTION_LIST /end CHARACTERISTIC
/begin CHARACTERISTIC IN_appsError_bool_Y_Limit "Limit threshold for Y." VALUE 0x8003AA98 RECORD_LAYOUT__5 0 COMPU_METHOD__17 0 4294967295 /begin FUNCTION_LIST FaultManager /end FUNCTION_LIST /end CHARACTERISTIC
/begin CHARACTERISTIC IN_brakeErrorF_bool_FaultOperation "Calibration for testing fault." VALUE 0x8003B03D RECORD_LAYOUT__3 0 COMPU_METHOD__28 0 8 /begin FUNCTION_LIST FaultManager /end FUNCTION_LIST /end CHARACTERISTIC
/begin CHARACTERISTIC IN_brakeErrorF_bool_X_Limit "Limit threshold for X." VALUE 0x8003A724 RECORD_LAYOUT__5 0 COMPU_METHOD__17 0 4294967295 /begin FUNCTION_LIST FaultManager /end FUNCTION_LIST /end CHARACTERISTIC
/begin CHARACTERISTIC IN_brakeErrorF_bool_Y_Limit "Limit threshold for Y." VALUE 0x8003A728 RECORD_LAYOUT__5 0 COMPU_METHOD__17 0 4294967295 /begin FUNCTION_LIST FaultManager /end FUNCTION_LIST /end CHARACTERISTIC
/begin CHARACTERISTIC IN_brakeErrorR_bool_FaultOperation "Calibration for testing fault." VALUE 0x8003B03E RECORD_LAYOUT__3 0 COMPU_METHOD__28 0 8 /begin FUNCTION_LIST FaultManager /end FUNCTION_LIST /end CHARACTERISTIC
/begin CHARACTERISTIC IN_brakeErrorR_bool_X_Limit "Limit threshold for X." VALUE 0x8003A73C RECORD_LAYOUT__5 0 COMPU_METHOD__17 0 4294967295 /begin FUNCTION_LIST FaultManager /end FUNCTION_LIST /end CHARACTERISTIC
/begin CHARACTERISTIC IN_brakeErrorR_bool_Y_Limit "Limit threshold for Y." VALUE 0x8003A740 RECORD_LAYOUT__5 0 COMPU_METHOD__17 0 4294967295 /begin FUNCTION_LIST FaultManager /end FUNCTION_LIST /end CHARACTERISTIC
/begin CHARACTERISTIC IN_brakeVHighF_bool_FaultOperation "Calibration for testing fault." VALUE 0x8003B03F RECORD_LAYOUT__3 0 COMPU_METHOD__28 0 8 /begin FUNCTION_LIST FaultManager /end FUNCTION_LIST /end CHARACTERISTIC
/begin CHARACTERISTIC IN_brakeVHighF_bool_X_Limit "Limit threshold for X." VALUE 0x8003A71C RECORD_LAYOUT__5 0 COMPU_METHOD__17 0 4294967295 /begin FUNCTION_LIST FaultManager /end FUNCTION_LIST /end CHARACTERISTIC
/begin CHARACTERISTIC IN_brakeVHighF_bool_Y_Limit "Limit threshold for Y." VALUE 0x8003A720 RECORD_LAYOUT__5 0 COMPU_METHOD__17 0 4294967295 /begin FUNCTION_LIST FaultManager /end FUNCTION_LIST /end CHARACTERISTIC
/begin CHARACTERISTIC IN_brakeVHighR_bool_FaultOperation "Calibration for testing fault." VALUE 0x8003B040 RECORD_LAYOUT__3 0 COMPU_METHOD__28 0 8 /begin FUNCTION_LIST FaultManager /end FUNCTION_LIST /end CHARACTERISTIC
/begin CHARACTERISTIC IN_brakeVHighR_bool_X_Limit "Limit threshold for X." VALUE 0x8003A734 RECORD_LAYOUT__5 0 COMPU_METHOD__17 0 4294967295 /begin FUNCTION_LIST FaultManager /end FUNCTION_LIST /end CHARACTERISTIC
/begin CHARACTERISTIC IN_brakeVHighR_bool_Y_Limit "Limit threshold for Y." VALUE 0x8003A738 RECORD_LAYOUT__5 0 COMPU_METHOD__17 0 4294967295 /begin FUNCTION_LIST FaultManager /end FUNCTION_LIST /end CHARACTERISTIC
/begin CHARACTERISTIC IN_brakeVLowF_bool_FaultOperation "Calibration for testing fault." VALUE 0x8003B041 RECORD_LAYOUT__3 0 COMPU_METHOD__28 0 8 /begin FUNCTION_LIST FaultManager /end FUNCTION_LIST /end CHARACTERISTIC
/begin CHARACTERISTIC IN_brakeVLowF_bool_X_Limit "Limit threshold for X." VALUE 0x8003A714 RECORD_LAYOUT__5 0 COMPU_METHOD__17 0 4294967295 /begin FUNCTION_LIST FaultManager /end FUNCTION_LIST /end CHARACTERISTIC
/begin CHARACTERISTIC IN_brakeVLowF_bool_Y_Limit "Limit threshold for Y." VALUE 0x8003A718 RECORD_LAYOUT__5 0 COMPU_METHOD__17 0 4294967295 /begin FUNCTION_LIST FaultManager /end FUNCTION_LIST /end CHARACTERISTIC
/begin CHARACTERISTIC IN_brakeVLowR_bool_FaultOperation "Calibration for testing fault." VALUE 0x8003B042 RECORD_LAYOUT__3 0 COMPU_METHOD__28 0 8 /begin FUNCTION_LIST FaultManager /end FUNCTION_LIST /end CHARACTERISTIC
/begin CHARACTERISTIC IN_brakeVLowR_bool_X_Limit "Limit threshold for X." VALUE 0x8003A72C RECORD_LAYOUT__5 0 COMPU_METHOD__17 0 4294967295 /begin FUNCTION_LIST FaultManager /end FUNCTION_LIST /end CHARACTERISTIC
/begin CHARACTERISTIC IN_brakeVLowR_bool_Y_Limit "Limit threshold for Y." VALUE 0x8003A730 RECORD_LAYOUT__5 0 COMPU_METHOD__17 0 4294967295 /begin FUNCTION_LIST FaultManager /end FUNCTION_LIST /end CHARACTERISTIC
/begin CHARACTERISTIC IN_bspdBrakeError_bool_FaultOperation "Calibration for testing fault." VALUE 0x8003B043 RECORD_LAYOUT__3 0 COMPU_METHOD__28 0 8 /begin FUNCTION_LIST FaultManager /end FUNCTION_LIST /end CHARACTERISTIC
/begin CHARACTERISTIC IN_bspdBrakeError_bool_X_Limit "Limit threshold for X." VALUE 0x8003A754 RECORD_LAYOUT__5 0 COMPU_METHOD__17 0 4294967295 /begin FUNCTION_LIST FaultManager /end FUNCTION_LIST /end CHARACTERISTIC
/begin CHARACTERISTIC IN_bspdBrakeError_bool_Y_Limit "Limit threshold for Y." VALUE 0x8003A758 RECORD_LAYOUT__5 0 COMPU_METHOD__17 0 4294967295 /begin FUNCTION_LIST FaultManager /end FUNCTION_LIST /end CHARACTERISTIC
/begin CHARACTERISTIC IN_bspdStatusError_bool_FaultOperation "Calibration for testing fault." VALUE 0x8003B044 RECORD_LAYOUT__3 0 COMPU_METHOD__28 0 8 /begin FUNCTION_LIST FaultManager /end FUNCTION_LIST /end CHARACTERISTIC
/begin CHARACTERISTIC IN_bspdStatusError_bool_X_Limit "Limit threshold for X." VALUE 0x8003A76C RECORD_LAYOUT__5 0 COMPU_METHOD__17 0 4294967295 /begin FUNCTION_LIST FaultManager /end FUNCTION_LIST /end CHARACTERISTIC
/begin CHARACTERISTIC IN_bspdStatusError_bool_Y_Limit "Limit threshold for Y." VALUE 0x8003A770 RECORD_LAYOUT__5 0 COMPU_METHOD__17 0 4294967295 /begin FUNCTION_LIST FaultManager /end FUNCTION_LIST /end CHARACTERISTIC
/begin CHARACTERISTIC IN_coolantTempErrorInverterIn_bool_FaultOperation "Calibration for testing fault." VALUE 0x8003B045 RECORD_LAYOUT__3 0 COMPU_METHOD__28 0 8 /begin FUNCTION_LIST FaultManager /end FUNCTION_LIST /end CHARACTERISTIC
/begin CHARACTERISTIC IN_coolantTempErrorInverterIn_bool_X_Limit "Limit threshold for X." VALUE 0x8003A78C RECORD_LAYOUT__5 0 COMPU_METHOD__17 0 4294967295 /begin FUNCTION_LIST FaultManager /end FUNCTION_LIST /end CHARACTERISTIC
/begin CHARACTERISTIC IN_coolantTempErrorInverterIn_bool_Y_Limit "Limit threshold for Y." VALUE 0x8003A790 RECORD_LAYOUT__5 0 COMPU_METHOD__17 0 4294967295 /begin FUNCTION_LIST FaultManager /end FUNCTION_LIST /end CHARACTERISTIC
/begin CHARACTERISTIC IN_coolantTempErrorInverterOut_bool_FaultOperation "Calibration for testing fault." VALUE 0x8003B046 RECORD_LAYOUT__3 0 COMPU_METHOD__28 0 8 /begin FUNCTION_LIST FaultManager /end FUNCTION_LIST /end CHARACTERISTIC
/begin CHARACTERISTIC IN_coolantTempErrorInverterOut_bool_X_Limit "Limit threshold for X." VALUE 0x8003A7AC RECORD_LAYOUT__5 0 COMPU_METHOD__17 0 4294967295 /begin FUNCTION_LIST FaultManager /end FUNCTION_LIST /end CHARACTERISTIC
/begin CHARACTERISTIC IN_coolantTempErrorInverterOut_bool_Y_Limit "Limit threshold for Y." VALUE 0x8003A7B0 RECORD_LAYOUT__5 0 COMPU_METHOD__17 0 4294967295 /begin FUNCTION_LIST FaultManager /end FUNCTION_LIST /end CHARACTERISTIC
/begin CHARACTERISTIC IN_coolantTempErrorMotorIn_bool_FaultOperation "Calibration for testing fault." VALUE 0x8003B047 RECORD_LAYOUT__3 0 COMPU_METHOD__28 0 8 /begin FUNCTION_LIST FaultManager /end FUNCTION_LIST /end CHARACTERISTIC
/begin CHARACTERISTIC IN_coolantTempErrorMotorIn_bool_X_Limit "Limit threshold for X." VALUE 0x8003A7CC RECORD_LAYOUT__5 0 COMPU_METHOD__17 0 4294967295 /begin FUNCTION_LIST FaultManager /end FUNCTION_LIST /end CHARACTERISTIC
/begin CHARACTERISTIC IN_coolantTempErrorMotorIn_bool_Y_Limit "Limit threshold for Y." VALUE 0x8003A7D0 RECORD_LAYOUT__5 0 COMPU_METHOD__17 0 4294967295 /begin FUNCTION_LIST FaultManager /end FUNCTION_LIST /end CHARACTERISTIC
/begin CHARACTERISTIC IN_coolantTempVHighInverterIn_bool_FaultOperation "Calibration for testing fault." VALUE 0x8003B048 RECORD_LAYOUT__3 0 COMPU_METHOD__28 0 8 /begin FUNCTION_LIST FaultManager /end FUNCTION_LIST /end CHARACTERISTIC
/begin CHARACTERISTIC IN_coolantTempVHighInverterIn_bool_X_Limit "Limit threshold for X." VALUE 0x8003A784 RECORD_LAYOUT__5 0 COMPU_METHOD__17 0 4294967295 /begin FUNCTION_LIST FaultManager /end FUNCTION_LIST /end CHARACTERISTIC
/begin CHARACTERISTIC IN_coolantTempVHighInverterIn_bool_Y_Limit "Limit threshold for Y." VALUE 0x8003A788 RECORD_LAYOUT__5 0 COMPU_METHOD__17 0 4294967295 /begin FUNCTION_LIST FaultManager /end FUNCTION_LIST /end CHARACTERISTIC
/begin CHARACTERISTIC IN_coolantTempVHighInverterOut_bool_FaultOperation "Calibration for testing fault." VALUE 0x8003B049 RECORD_LAYOUT__3 0 COMPU_METHOD__28 0 8 /begin FUNCTION_LIST FaultManager /end FUNCTION_LIST /end CHARACTERISTIC
/begin CHARACTERISTIC IN_coolantTempVHighInverterOut_bool_X_Limit "Limit threshold for X." VALUE 0x8003A7A4 RECORD_LAYOUT__5 0 COMPU_METHOD__17 0 4294967295 /begin FUNCTION_LIST FaultManager /end FUNCTION_LIST /end CHARACTERISTIC
/begin CHARACTERISTIC IN_coolantTempVHighInverterOut_bool_Y_Limit "Limit threshold for Y." VALUE 0x8003A7A8 RECORD_LAYOUT__5 0 COMPU_METHOD__17 0 4294967295 /begin FUNCTION_LIST FaultManager /end FUNCTION_LIST /end CHARACTERISTIC
/begin CHARACTERISTIC IN_coolantTempVHighMotorIn_bool_FaultOperation "Calibration for testing fault." VALUE 0x8003B04A RECORD_LAYOUT__3 0 COMPU_METHOD__28 0 8 /begin FUNCTION_LIST FaultManager /end FUNCTION_LIST /end CHARACTERISTIC
/begin CHARACTERISTIC IN_coolantTempVHighMotorIn_bool_X_Limit "Limit threshold for X." VALUE 0x8003A7C4 RECORD_LAYOUT__5 0 COMPU_METHOD__17 0 4294967295 /begin FUNCTION_LIST FaultManager /end FUNCTION_LIST /end CHARACTERISTIC
/begin CHARACTERISTIC IN_coolantTempVHighMotorIn_bool_Y_Limit "Limit threshold for Y." VALUE 0x8003A7C8 RECORD_LAYOUT__5 0 COMPU_METHOD__17 0 4294967295 /begin FUNCTION_LIST FaultManager /end FUNCTION_LIST /end CHARACTERISTIC
/begin CHARACTERISTIC IN_coolantTempVLowInverterIn_bool_FaultOperation "Calibration for testing fault." VALUE 0x8003B04B RECORD_LAYOUT__3 0 COMPU_METHOD__28 0 8 /begin FUNCTION_LIST FaultManager /end FUNCTION_LIST /end CHARACTERISTIC
/begin CHARACTERISTIC IN_coolantTempVLowInverterIn_bool_X_Limit "Limit threshold for X." VALUE 0x8003A778 RECORD_LAYOUT__5 0 COMPU_METHOD__17 0 4294967295 /begin FUNCTION_LIST FaultManager /end FUNCTION_LIST /end CHARACTERISTIC
/begin CHARACTERISTIC IN_coolantTempVLowInverterIn_bool_Y_Limit "Limit threshold for Y." VALUE 0x8003A77C RECORD_LAYOUT__5 0 COMPU_METHOD__17 0 4294967295 /begin FUNCTION_LIST FaultManager /end FUNCTION_LIST /end CHARACTERISTIC
/begin CHARACTERISTIC IN_coolantTempVLowInverterOut_bool_FaultOperation "Calibration for testing fault." VALUE 0x8003B04C RECORD_LAYOUT__3 0 COMPU_METHOD__28 0 8 /begin FUNCTION_LIST FaultManager /end FUNCTION_LIST /end CHARACTERISTIC
/begin CHARACTERISTIC IN_coolantTempVLowInverterOut_bool_X_Limit "Limit threshold for X." VALUE 0x8003A798 RECORD_LAYOUT__5 0 COMPU_METHOD__17 0 4294967295 /begin FUNCTION_LIST FaultManager /end FUNCTION_LIST /end CHARACTERISTIC
/begin CHARACTERISTIC IN_coolantTempVLowInverterOut_bool_Y_Limit "Limit threshold for Y." VALUE 0x8003A79C RECORD_LAYOUT__5 0 COMPU_METHOD__17 0 4294967295 /begin FUNCTION_LIST FaultManager /end FUNCTION_LIST /end CHARACTERISTIC
/begin CHARACTERISTIC IN_coolantTempVLowMotorIn_bool_FaultOperation "Calibration for testing fault." VALUE 0x8003B04D RECORD_LAYOUT__3 0 COMPU_METHOD__28 0 8 /begin FUNCTION_LIST FaultManager /end FUNCTION_LIST /end CHARACTERISTIC
/begin CHARACTERISTIC IN_coolantTempVLowMotorIn_bool_X_Limit "Limit threshold for X." VALUE 0x8003A7B8 RECORD_LAYOUT__5 0 COMPU_METHOD__17 0 4294967295 /begin FUNCTION_LIST FaultManager /end FUNCTION_LIST /end CHARACTERISTIC
/begin CHARACTERISTIC IN_coolantTempVLowMotorIn_bool_Y_Limit "Limit threshold for Y." VALUE 0x8003A7BC RECORD_LAYOUT__5 0 COMPU_METHOD__17 0 4294967295 /begin FUNCTION_LIST FaultManager /end FUNCTION_LIST /end CHARACTERISTIC
/begin CHARACTERISTIC IN_coolPolarityOverride_bool "" VALUE 0x8003B008 RECORD_LAYOUT__3 0 COMPU_METHOD__5 0 1 /begin FUNCTION_LIST coolSwitch /end FUNCTION_LIST /end CHARACTERISTIC
/begin CHARACTERISTIC IN_hallEffectErrorFL_bool_FaultOperation "Calibration for testing fault." VALUE 0x8003B04E RECORD_LAYOUT__3 0 COMPU_METHOD__28 0 8 /begin FUNCTION_LIST FaultManager /end FUNCTION_LIST /end CHARACTERISTIC
/begin CHARACTERISTIC IN_hallEffectErrorFL_bool_X_Limit "Limit threshold for X." VALUE 0x8003AFA0 RECORD_LAYOUT__5 0 COMPU_METHOD__17 0 4294967295 /begin FUNCTION_LIST FaultManager /end FUNCTION_LIST /end CHARACTERISTIC
/begin CHARACTERISTIC IN_hallEffectErrorFL_bool_Y_Limit "Limit threshold for Y." VALUE 0x8003AFA4 RECORD_LAYOUT__5 0 COMPU_METHOD__17 0 4294967295 /begin FUNCTION_LIST FaultManager /end FUNCTION_LIST /end CHARACTERISTIC
/begin CHARACTERISTIC IN_hallEffectErrorFR_bool_FaultOperation "Calibration for testing fault." VALUE 0x8003B04F RECORD_LAYOUT__3 0 COMPU_METHOD__28 0 8 /begin FUNCTION_LIST FaultManager /end FUNCTION_LIST /end CHARACTERISTIC
/begin CHARACTERISTIC IN_hallEffectErrorFR_bool_X_Limit "Limit threshold for X." VALUE 0x8003AFC0 RECORD_LAYOUT__5 0 COMPU_METHOD__17 0 4294967295 /begin FUNCTION_LIST FaultManager /end FUNCTION_LIST /end CHARACTERISTIC
/begin CHARACTERISTIC IN_hallEffectErrorFR_bool_Y_Limit "Limit threshold for Y." VALUE 0x8003AFC4 RECORD_LAYOUT__5 0 COMPU_METHOD__17 0 4294967295 /begin FUNCTION_LIST FaultManager /end FUNCTION_LIST /end CHARACTERISTIC
/begin CHARACTERISTIC IN_hallEffectErrorRL_bool_FaultOperation "Calibration for testing fault." VALUE 0x8003B050 RECORD_LAYOUT__3 0 COMPU_METHOD__28 0 8 /begin FUNCTION_LIST FaultManager /end FUNCTION_LIST /end CHARACTERISTIC
/begin CHARACTERISTIC IN_hallEffectErrorRL_bool_X_Limit "Limit threshold for X." VALUE 0x8003AFE0 RECORD_LAYOUT__5 0 COMPU_METHOD__17 0 4294967295 /begin FUNCTION_LIST FaultManager /end FUNCTION_LIST /end CHARACTERISTIC
/begin CHARACTERISTIC IN_hallEffectErrorRL_bool_Y_Limit "Limit threshold for Y." VALUE 0x8003AFE4 RECORD_LAYOUT__5 0 COMPU_METHOD__17 0 4294967295 /begin FUNCTION_LIST FaultManager /end FUNCTION_LIST /end CHARACTERISTIC
/begin CHARACTERISTIC IN_hallEffectErrorRR_bool_FaultOperation "Calibration for testing fault." VALUE 0x8003B051 RECORD_LAYOUT__3 0 COMPU_METHOD__28 0 8 /begin FUNCTION_LIST FaultManager /end FUNCTION_LIST /end CHARACTERISTIC
/begin CHARACTERISTIC IN_hallEffectErrorRR_bool_X_Limit "Limit threshold for X." VALUE 0x8003B000 RECORD_LAYOUT__5 0 COMPU_METHOD__17 0 4294967295 /begin FUNCTION_LIST FaultManager /end FUNCTION_LIST /end CHARACTERISTIC
/begin CHARACTERISTIC IN_hallEffectErrorRR_bool_Y_Limit "Limit threshold for Y." VALUE 0x8003B004 RECORD_LAYOUT__5 0 COMPU_METHOD__17 0 4294967295 /begin FUNCTION_LIST FaultManager /end FUNCTION_LIST /end CHARACTERISTIC
/begin CHARACTERISTIC IN_hallEffectHighFL_hz "" VALUE 0x8003AF94 RECORD_LAYOUT__1 0 COMPU_METHOD__3 -1E+17 1E+17 /begin FUNCTION_LIST wheelSpeedFL /end FUNCTION_LIST /end CHARACTERISTIC
/begin CHARACTERISTIC IN_hallEffectHighFR_hz "" VALUE 0x8003AFB4 RECORD_LAYOUT__1 0 COMPU_METHOD__3 -1E+17 1E+17 /begin FUNCTION_LIST wheelSpeedFR /end FUNCTION_LIST /end CHARACTERISTIC
/begin CHARACTERISTIC IN_hallEffectHighRL_hz "" VALUE 0x8003AFD4 RECORD_LAYOUT__1 0 COMPU_METHOD__3 -1E+17 1E+17 /begin FUNCTION_LIST wheelSpeedRL /end FUNCTION_LIST /end CHARACTERISTIC
/begin CHARACTERISTIC IN_hallEffectHighRR_hz "" VALUE 0x8003AFF4 RECORD_LAYOUT__1 0 COMPU_METHOD__3 -1E+17 1E+17 /begin FUNCTION_LIST wheelSpeedRR /end FUNCTION_LIST /end CHARACTERISTIC
/begin CHARACTERISTIC IN_hallEffectLowFL_hz "" VALUE 0x8003AF88 RECORD_LAYOUT__1 0 COMPU_METHOD__3 -1E+17 1E+17 /begin FUNCTION_LIST wheelSpeedFL /end FUNCTION_LIST /end CHARACTERISTIC
/begin CHARACTERISTIC IN_hallEffectLowFR_hz "" VALUE 0x8003AFA8 RECORD_LAYOUT__1 0 COMPU_METHOD__3 -1E+17 1E+17 /begin FUNCTION_LIST wheelSpeedFR /end FUNCTION_LIST /end CHARACTERISTIC
/begin CHARACTERISTIC IN_hallEffectLowRL_hz "" VALUE 0x8003AFC8 RECORD_LAYOUT__1 0 COMPU_METHOD__3 -1E+17 1E+17 /begin FUNCTION_LIST wheelSpeedRL /end FUNCTION_LIST /end CHARACTERISTIC
/begin CHARACTERISTIC IN_hallEffectLowRR_hz "" VALUE 0x8003AFE8 RECORD_LAYOUT__1 0 COMPU_METHOD__3 -1E+17 1E+17 /begin FUNCTION_LIST wheelSpeedRR /end FUNCTION_LIST /end CHARACTERISTIC
/begin CHARACTERISTIC IN_hallEffectVHighFL_bool_FaultOperation "Calibration for testing fault." VALUE 0x8003B052 RECORD_LAYOUT__3 0 COMPU_METHOD__28 0 8 /begin FUNCTION_LIST FaultManager /end FUNCTION_LIST /end CHARACTERISTIC
/begin CHARACTERISTIC IN_hallEffectVHighFL_bool_X_Limit "Limit threshold for X." VALUE 0x8003AF98 RECORD_LAYOUT__5 0 COMPU_METHOD__17 0 4294967295 /begin FUNCTION_LIST FaultManager /end FUNCTION_LIST /end CHARACTERISTIC
/begin CHARACTERISTIC IN_hallEffectVHighFL_bool_Y_Limit "Limit threshold for Y." VALUE 0x8003AF9C RECORD_LAYOUT__5 0 COMPU_METHOD__17 0 4294967295 /begin FUNCTION_LIST FaultManager /end FUNCTION_LIST /end CHARACTERISTIC
/begin CHARACTERISTIC IN_hallEffectVHighFR_bool_FaultOperation "Calibration for testing fault." VALUE 0x8003B053 RECORD_LAYOUT__3 0 COMPU_METHOD__28 0 8 /begin FUNCTION_LIST FaultManager /end FUNCTION_LIST /end CHARACTERISTIC
/begin CHARACTERISTIC IN_hallEffectVHighFR_bool_X_Limit "Limit threshold for X." VALUE 0x8003AFB8 RECORD_LAYOUT__5 0 COMPU_METHOD__17 0 4294967295 /begin FUNCTION_LIST FaultManager /end FUNCTION_LIST /end CHARACTERISTIC
/begin CHARACTERISTIC IN_hallEffectVHighFR_bool_Y_Limit "Limit threshold for Y." VALUE 0x8003AFBC RECORD_LAYOUT__5 0 COMPU_METHOD__17 0 4294967295 /begin FUNCTION_LIST FaultManager /end FUNCTION_LIST /end CHARACTERISTIC
/begin CHARACTERISTIC IN_hallEffectVHighRL_bool_FaultOperation "Calibration for testing fault." VALUE 0x8003B054 RECORD_LAYOUT__3 0 COMPU_METHOD__28 0 8 /begin FUNCTION_LIST FaultManager /end FUNCTION_LIST /end CHARACTERISTIC
/begin CHARACTERISTIC IN_hallEffectVHighRL_bool_X_Limit "Limit threshold for X." VALUE 0x8003AFD8 RECORD_LAYOUT__5 0 COMPU_METHOD__17 0 4294967295 /begin FUNCTION_LIST FaultManager /end FUNCTION_LIST /end CHARACTERISTIC
/begin CHARACTERISTIC IN_hallEffectVHighRL_bool_Y_Limit "Limit threshold for Y." VALUE 0x8003AFDC RECORD_LAYOUT__5 0 COMPU_METHOD__17 0 4294967295 /begin FUNCTION_LIST FaultManager /end FUNCTION_LIST /end CHARACTERISTIC
/begin CHARACTERISTIC IN_hallEffectVHighRR_bool_FaultOperation "Calibration for testing fault." VALUE 0x8003B055 RECORD_LAYOUT__3 0 COMPU_METHOD__28 0 8 /begin FUNCTION_LIST FaultManager /end FUNCTION_LIST /end CHARACTERISTIC
/begin CHARACTERISTIC IN_hallEffectVHighRR_bool_X_Limit "Limit threshold for X." VALUE 0x8003AFF8 RECORD_LAYOUT__5 0 COMPU_METHOD__17 0 4294967295 /begin FUNCTION_LIST FaultManager /end FUNCTION_LIST /end CHARACTERISTIC
/begin CHARACTERISTIC IN_hallEffectVHighRR_bool_Y_Limit "Limit threshold for Y." VALUE 0x8003AFFC RECORD_LAYOUT__5 0 COMPU_METHOD__17 0 4294967295 /begin FUNCTION_LIST FaultManager /end FUNCTION_LIST /end CHARACTERISTIC
/begin CHARACTERISTIC IN_hallEffectVLowFL_bool_FaultOperation "Calibration for testing fault." VALUE 0x8003B056 RECORD_LAYOUT__3 0 COMPU_METHOD__28 0 8 /begin FUNCTION_LIST FaultManager /end FUNCTION_LIST /end CHARACTERISTIC
/begin CHARACTERISTIC IN_hallEffectVLowFL_bool_X_Limit "Limit threshold for X." VALUE 0x8003AF8C RECORD_LAYOUT__5 0 COMPU_METHOD__17 0 4294967295 /begin FUNCTION_LIST FaultManager /end FUNCTION_LIST /end CHARACTERISTIC
/begin CHARACTERISTIC IN_hallEffectVLowFL_bool_Y_Limit "Limit threshold for Y." VALUE 0x8003AF90 RECORD_LAYOUT__5 0 COMPU_METHOD__17 0 4294967295 /begin FUNCTION_LIST FaultManager /end FUNCTION_LIST /end CHARACTERISTIC
/begin CHARACTERISTIC IN_hallEffectVLowFR_bool_FaultOperation "Calibration for testing fault." VALUE 0x8003B057 RECORD_LAYOUT__3 0 COMPU_METHOD__28 0 8 /begin FUNCTION_LIST FaultManager /end FUNCTION_LIST /end CHARACTERISTIC
/begin CHARACTERISTIC IN_hallEffectVLowFR_bool_X_Limit "Limit threshold for X." VALUE 0x8003AFAC RECORD_LAYOUT__5 0 COMPU_METHOD__17 0 4294967295 /begin FUNCTION_LIST FaultManager /end FUNCTION_LIST /end CHARACTERISTIC
/begin CHARACTERISTIC IN_hallEffectVLowFR_bool_Y_Limit "Limit threshold for Y." VALUE 0x8003AFB0 RECORD_LAYOUT__5 0 COMPU_METHOD__17 0 4294967295 /begin FUNCTION_LIST FaultManager /end FUNCTION_LIST /end CHARACTERISTIC
/begin CHARACTERISTIC IN_hallEffectVLowRL_bool_FaultOperation "Calibration for testing fault." VALUE 0x8003B058 RECORD_LAYOUT__3 0 COMPU_METHOD__28 0 8 /begin FUNCTION_LIST FaultManager /end FUNCTION_LIST /end CHARACTERISTIC
/begin CHARACTERISTIC IN_hallEffectVLowRL_bool_X_Limit "Limit threshold for X." VALUE 0x8003AFCC RECORD_LAYOUT__5 0 COMPU_METHOD__17 0 4294967295 /begin FUNCTION_LIST FaultManager /end FUNCTION_LIST /end CHARACTERISTIC
/begin CHARACTERISTIC IN_hallEffectVLowRL_bool_Y_Limit "Limit threshold for Y." VALUE 0x8003AFD0 RECORD_LAYOUT__5 0 COMPU_METHOD__17 0 4294967295 /begin FUNCTION_LIST FaultManager /end FUNCTION_LIST /end CHARACTERISTIC
/begin CHARACTERISTIC IN_hallEffectVLowRR_bool_FaultOperation "Calibration for testing fault." VALUE 0x8003B059 RECORD_LAYOUT__3 0 COMPU_METHOD__28 0 8 /begin FUNCTION_LIST FaultManager /end FUNCTION_LIST /end CHARACTERISTIC
/begin CHARACTERISTIC IN_hallEffectVLowRR_bool_X_Limit "Limit threshold for X." VALUE 0x8003AFEC RECORD_LAYOUT__5 0 COMPU_METHOD__17 0 4294967295 /begin FUNCTION_LIST FaultManager /end FUNCTION_LIST /end CHARACTERISTIC
/begin CHARACTERISTIC IN_hallEffectVLowRR_bool_Y_Limit "Limit threshold for Y." VALUE 0x8003AFF0 RECORD_LAYOUT__5 0 COMPU_METHOD__17 0 4294967295 /begin FUNCTION_LIST FaultManager /end FUNCTION_LIST /end CHARACTERISTIC
/begin CHARACTERISTIC IN_markPolarityOverride_bool "" VALUE 0x8003B00A RECORD_LAYOUT__3 0 COMPU_METHOD__5 0 1 /begin FUNCTION_LIST markSwitch /end FUNCTION_LIST /end CHARACTERISTIC
/begin CHARACTERISTIC IN_pageDownPolarityOverride_bool "" VALUE 0x8003B00B RECORD_LAYOUT__3 0 COMPU_METHOD__5 0 1 /begin FUNCTION_LIST pageDown /end FUNCTION_LIST /end CHARACTERISTIC
/begin CHARACTERISTIC IN_pageUpPolarityOverride_bool "" VALUE 0x8003B00C RECORD_LAYOUT__3 0 COMPU_METHOD__5 0 1 /begin FUNCTION_LIST pageUp /end FUNCTION_LIST /end CHARACTERISTIC
/begin CHARACTERISTIC IN_PolarityOverride_bool "" VALUE 0x8003B009 RECORD_LAYOUT__3 0 COMPU_METHOD__5 0 1 /begin FUNCTION_LIST digitalSwitch1 /end FUNCTION_LIST /end CHARACTERISTIC
/begin CHARACTERISTIC IN_pttPolarityOverride_bool "" VALUE 0x8003B00D RECORD_LAYOUT__3 0 COMPU_METHOD__5 0 1 /begin FUNCTION_LIST pttSwitch /end FUNCTION_LIST /end CHARACTERISTIC
/begin CHARACTERISTIC IN_pwrDownPolarityOverride_bool "" VALUE 0x8003B00E RECORD_LAYOUT__3 0 COMPU_METHOD__5 0 1 /begin FUNCTION_LIST pwrDownSwitch /end FUNCTION_LIST /end CHARACTERISTIC
/begin CHARACTERISTIC IN_pwrUpPolarityOverride_bool "" VALUE 0x8003B00F RECORD_LAYOUT__3 0 COMPU_METHOD__5 0 1 /begin FUNCTION_LIST pwrUpSwitch /end FUNCTION_LIST /end CHARACTERISTIC
/begin CHARACTERISTIC IN_rotorTempErrorFL_bool_FaultOperation "Calibration for testing fault." VALUE 0x8003B05A RECORD_LAYOUT__3 0 COMPU_METHOD__28 0 8 /begin FUNCTION_LIST FaultManager /end FUNCTION_LIST /end CHARACTERISTIC
/begin CHARACTERISTIC IN_rotorTempErrorFL_bool_X_Limit "Limit threshold for X." VALUE 0x8003A7EC RECORD_LAYOUT__5 0 COMPU_METHOD__17 0 4294967295 /begin FUNCTION_LIST FaultManager /end FUNCTION_LIST /end CHARACTERISTIC
/begin CHARACTERISTIC IN_rotorTempErrorFL_bool_Y_Limit "Limit threshold for Y." VALUE 0x8003A7F0 RECORD_LAYOUT__5 0 COMPU_METHOD__17 0 4294967295 /begin FUNCTION_LIST FaultManager /end FUNCTION_LIST /end CHARACTERISTIC
/begin CHARACTERISTIC IN_rotorTempErrorFR_bool_FaultOperation "Calibration for testing fault." VALUE 0x8003B05B RECORD_LAYOUT__3 0 COMPU_METHOD__28 0 8 /begin FUNCTION_LIST FaultManager /end FUNCTION_LIST /end CHARACTERISTIC
/begin CHARACTERISTIC IN_rotorTempErrorFR_bool_X_Limit "Limit threshold for X." VALUE 0x8003A944 RECORD_LAYOUT__5 0 COMPU_METHOD__17 0 4294967295 /begin FUNCTION_LIST FaultManager /end FUNCTION_LIST /end CHARACTERISTIC
/begin CHARACTERISTIC IN_rotorTempErrorFR_bool_Y_Limit "Limit threshold for Y." VALUE 0x8003A948 RECORD_LAYOUT__5 0 COMPU_METHOD__17 0 4294967295 /begin FUNCTION_LIST FaultManager /end FUNCTION_LIST /end CHARACTERISTIC
/begin CHARACTERISTIC IN_rotorTempErrorRL_bool_FaultOperation "Calibration for testing fault." VALUE 0x8003B05C RECORD_LAYOUT__3 0 COMPU_METHOD__28 0 8 /begin FUNCTION_LIST FaultManager /end FUNCTION_LIST /end CHARACTERISTIC
/begin CHARACTERISTIC IN_rotorTempErrorRL_bool_X_Limit "Limit threshold for X." VALUE 0x8003A898 RECORD_LAYOUT__5 0 COMPU_METHOD__17 0 4294967295 /begin FUNCTION_LIST FaultManager /end FUNCTION_LIST /end CHARACTERISTIC
/begin CHARACTERISTIC IN_rotorTempErrorRL_bool_Y_Limit "Limit threshold for Y." VALUE 0x8003A89C RECORD_LAYOUT__5 0 COMPU_METHOD__17 0 4294967295 /begin FUNCTION_LIST FaultManager /end FUNCTION_LIST /end CHARACTERISTIC
/begin CHARACTERISTIC IN_rotorTempErrorRR_bool_FaultOperation "Calibration for testing fault." VALUE 0x8003B05D RECORD_LAYOUT__3 0 COMPU_METHOD__28 0 8 /begin FUNCTION_LIST FaultManager /end FUNCTION_LIST /end CHARACTERISTIC
/begin CHARACTERISTIC IN_rotorTempErrorRR_bool_X_Limit "Limit threshold for X." VALUE 0x8003A9F0 RECORD_LAYOUT__5 0 COMPU_METHOD__17 0 4294967295 /begin FUNCTION_LIST FaultManager /end FUNCTION_LIST /end CHARACTERISTIC
/begin CHARACTERISTIC IN_rotorTempErrorRR_bool_Y_Limit "Limit threshold for Y." VALUE 0x8003A9F4 RECORD_LAYOUT__5 0 COMPU_METHOD__17 0 4294967295 /begin FUNCTION_LIST FaultManager /end FUNCTION_LIST /end CHARACTERISTIC
/begin CHARACTERISTIC IN_rotorTempVHighFL_bool_FaultOperation "Calibration for testing fault." VALUE 0x8003B05E RECORD_LAYOUT__3 0 COMPU_METHOD__28 0 8 /begin FUNCTION_LIST FaultManager /end FUNCTION_LIST /end CHARACTERISTIC
/begin CHARACTERISTIC IN_rotorTempVHighFL_bool_X_Limit "Limit threshold for X." VALUE 0x8003A7E4 RECORD_LAYOUT__5 0 COMPU_METHOD__17 0 4294967295 /begin FUNCTION_LIST FaultManager /end FUNCTION_LIST /end CHARACTERISTIC
/begin CHARACTERISTIC IN_rotorTempVHighFL_bool_Y_Limit "Limit threshold for Y." VALUE 0x8003A7E8 RECORD_LAYOUT__5 0 COMPU_METHOD__17 0 4294967295 /begin FUNCTION_LIST FaultManager /end FUNCTION_LIST /end CHARACTERISTIC
/begin CHARACTERISTIC IN_rotorTempVHighFR_bool_FaultOperation "Calibration for testing fault." VALUE 0x8003B05F RECORD_LAYOUT__3 0 COMPU_METHOD__28 0 8 /begin FUNCTION_LIST FaultManager /end FUNCTION_LIST /end CHARACTERISTIC
/begin CHARACTERISTIC IN_rotorTempVHighFR_bool_X_Limit "Limit threshold for X." VALUE 0x8003A93C RECORD_LAYOUT__5 0 COMPU_METHOD__17 0 4294967295 /begin FUNCTION_LIST FaultManager /end FUNCTION_LIST /end CHARACTERISTIC
/begin CHARACTERISTIC IN_rotorTempVHighFR_bool_Y_Limit "Limit threshold for Y." VALUE 0x8003A940 RECORD_LAYOUT__5 0 COMPU_METHOD__17 0 4294967295 /begin FUNCTION_LIST FaultManager /end FUNCTION_LIST /end CHARACTERISTIC
/begin CHARACTERISTIC IN_rotorTempVHighRL_bool_FaultOperation "Calibration for testing fault." VALUE 0x8003B060 RECORD_LAYOUT__3 0 COMPU_METHOD__28 0 8 /begin FUNCTION_LIST FaultManager /end FUNCTION_LIST /end CHARACTERISTIC
/begin CHARACTERISTIC IN_rotorTempVHighRL_bool_X_Limit "Limit threshold for X." VALUE 0x8003A890 RECORD_LAYOUT__5 0 COMPU_METHOD__17 0 4294967295 /begin FUNCTION_LIST FaultManager /end FUNCTION_LIST /end CHARACTERISTIC
/begin CHARACTERISTIC IN_rotorTempVHighRL_bool_Y_Limit "Limit threshold for Y." VALUE 0x8003A894 RECORD_LAYOUT__5 0 COMPU_METHOD__17 0 4294967295 /begin FUNCTION_LIST FaultManager /end FUNCTION_LIST /end CHARACTERISTIC
/begin CHARACTERISTIC IN_rotorTempVHighRR_bool_FaultOperation "Calibration for testing fault." VALUE 0x8003B061 RECORD_LAYOUT__3 0 COMPU_METHOD__28 0 8 /begin FUNCTION_LIST FaultManager /end FUNCTION_LIST /end CHARACTERISTIC
/begin CHARACTERISTIC IN_rotorTempVHighRR_bool_X_Limit "Limit threshold for X." VALUE 0x8003A9E8 RECORD_LAYOUT__5 0 COMPU_METHOD__17 0 4294967295 /begin FUNCTION_LIST FaultManager /end FUNCTION_LIST /end CHARACTERISTIC
/begin CHARACTERISTIC IN_rotorTempVHighRR_bool_Y_Limit "Limit threshold for Y." VALUE 0x8003A9EC RECORD_LAYOUT__5 0 COMPU_METHOD__17 0 4294967295 /begin FUNCTION_LIST FaultManager /end FUNCTION_LIST /end CHARACTERISTIC
/begin CHARACTERISTIC IN_rotorTempVLowFL_bool_FaultOperation "Calibration for testing fault." VALUE 0x8003B062 RECORD_LAYOUT__3 0 COMPU_METHOD__28 0 8 /begin FUNCTION_LIST FaultManager /end FUNCTION_LIST /end CHARACTERISTIC
/begin CHARACTERISTIC IN_rotorTempVLowFL_bool_X_Limit "Limit threshold for X." VALUE 0x8003A7D8 RECORD_LAYOUT__5 0 COMPU_METHOD__17 0 4294967295 /begin FUNCTION_LIST FaultManager /end FUNCTION_LIST /end CHARACTERISTIC
/begin CHARACTERISTIC IN_rotorTempVLowFL_bool_Y_Limit "Limit threshold for Y." VALUE 0x8003A7DC RECORD_LAYOUT__5 0 COMPU_METHOD__17 0 4294967295 /begin FUNCTION_LIST FaultManager /end FUNCTION_LIST /end CHARACTERISTIC
/begin CHARACTERISTIC IN_rotorTempVLowFR_bool_FaultOperation "Calibration for testing fault." VALUE 0x8003B063 RECORD_LAYOUT__3 0 COMPU_METHOD__28 0 8 /begin FUNCTION_LIST FaultManager /end FUNCTION_LIST /end CHARACTERISTIC
/begin CHARACTERISTIC IN_rotorTempVLowFR_bool_X_Limit "Limit threshold for X." VALUE 0x8003A930 RECORD_LAYOUT__5 0 COMPU_METHOD__17 0 4294967295 /begin FUNCTION_LIST FaultManager /end FUNCTION_LIST /end CHARACTERISTIC
/begin CHARACTERISTIC IN_rotorTempVLowFR_bool_Y_Limit "Limit threshold for Y." VALUE 0x8003A934 RECORD_LAYOUT__5 0 COMPU_METHOD__17 0 4294967295 /begin FUNCTION_LIST FaultManager /end FUNCTION_LIST /end CHARACTERISTIC
/begin CHARACTERISTIC IN_rotorTempVLowRL_bool_FaultOperation "Calibration for testing fault." VALUE 0x8003B064 RECORD_LAYOUT__3 0 COMPU_METHOD__28 0 8 /begin FUNCTION_LIST FaultManager /end FUNCTION_LIST /end CHARACTERISTIC
/begin CHARACTERISTIC IN_rotorTempVLowRL_bool_X_Limit "Limit threshold for X." VALUE 0x8003A884 RECORD_LAYOUT__5 0 COMPU_METHOD__17 0 4294967295 /begin FUNCTION_LIST FaultManager /end FUNCTION_LIST /end CHARACTERISTIC
/begin CHARACTERISTIC IN_rotorTempVLowRL_bool_Y_Limit "Limit threshold for Y." VALUE 0x8003A888 RECORD_LAYOUT__5 0 COMPU_METHOD__17 0 4294967295 /begin FUNCTION_LIST FaultManager /end FUNCTION_LIST /end CHARACTERISTIC
/begin CHARACTERISTIC IN_rotorTempVLowRR_bool_FaultOperation "Calibration for testing fault." VALUE 0x8003B065 RECORD_LAYOUT__3 0 COMPU_METHOD__28 0 8 /begin FUNCTION_LIST FaultManager /end FUNCTION_LIST /end CHARACTERISTIC
/begin CHARACTERISTIC IN_rotorTempVLowRR_bool_X_Limit "Limit threshold for X." VALUE 0x8003A9DC RECORD_LAYOUT__5 0 COMPU_METHOD__17 0 4294967295 /begin FUNCTION_LIST FaultManager /end FUNCTION_LIST /end CHARACTERISTIC
/begin CHARACTERISTIC IN_rotorTempVLowRR_bool_Y_Limit "Limit threshold for Y." VALUE 0x8003A9E0 RECORD_LAYOUT__5 0 COMPU_METHOD__17 0 4294967295 /begin FUNCTION_LIST FaultManager /end FUNCTION_LIST /end CHARACTERISTIC
/begin CHARACTERISTIC IN_throttleError1_bool_FaultOperation "Calibration for testing fault." VALUE 0x8003B066 RECORD_LAYOUT__3 0 COMPU_METHOD__28 0 8 /begin FUNCTION_LIST FaultManager /end FUNCTION_LIST /end CHARACTERISTIC
/begin CHARACTERISTIC IN_throttleError1_bool_X_Limit "Limit threshold for X." VALUE 0x8003AAAC RECORD_LAYOUT__5 0 COMPU_METHOD__17 0 4294967295 /begin FUNCTION_LIST FaultManager /end FUNCTION_LIST /end CHARACTERISTIC
/begin CHARACTERISTIC IN_throttleError1_bool_Y_Limit "Limit threshold for Y." VALUE 0x8003AAB0 RECORD_LAYOUT__5 0 COMPU_METHOD__17 0 4294967295 /begin FUNCTION_LIST FaultManager /end FUNCTION_LIST /end CHARACTERISTIC
/begin CHARACTERISTIC IN_throttleError2_bool_FaultOperation "Calibration for testing fault." VALUE 0x8003B067 RECORD_LAYOUT__3 0 COMPU_METHOD__28 0 8 /begin FUNCTION_LIST FaultManager /end FUNCTION_LIST /end CHARACTERISTIC
/begin CHARACTERISTIC IN_throttleError2_bool_X_Limit "Limit threshold for X." VALUE 0x8003AAC4 RECORD_LAYOUT__5 0 COMPU_METHOD__17 0 4294967295 /begin FUNCTION_LIST FaultManager /end FUNCTION_LIST /end CHARACTERISTIC
/begin CHARACTERISTIC IN_throttleError2_bool_Y_Limit "Limit threshold for Y." VALUE 0x8003AAC8 RECORD_LAYOUT__5 0 COMPU_METHOD__17 0 4294967295 /begin FUNCTION_LIST FaultManager /end FUNCTION_LIST /end CHARACTERISTIC
/begin CHARACTERISTIC IN_throttleVHigh1_bool_FaultOperation "Calibration for testing fault." VALUE 0x8003B068 RECORD_LAYOUT__3 0 COMPU_METHOD__28 0 8 /begin FUNCTION_LIST FaultManager /end FUNCTION_LIST /end CHARACTERISTIC
/begin CHARACTERISTIC IN_throttleVHigh1_bool_X_Limit "Limit threshold for X." VALUE 0x8003AAA4 RECORD_LAYOUT__5 0 COMPU_METHOD__17 0 4294967295 /begin FUNCTION_LIST FaultManager /end FUNCTION_LIST /end CHARACTERISTIC
/begin CHARACTERISTIC IN_throttleVHigh1_bool_Y_Limit "Limit threshold for Y." VALUE 0x8003AAA8 RECORD_LAYOUT__5 0 COMPU_METHOD__17 0 4294967295 /begin FUNCTION_LIST FaultManager /end FUNCTION_LIST /end CHARACTERISTIC
/begin CHARACTERISTIC IN_throttleVHigh2_bool_FaultOperation "Calibration for testing fault." VALUE 0x8003B069 RECORD_LAYOUT__3 0 COMPU_METHOD__28 0 8 /begin FUNCTION_LIST FaultManager /end FUNCTION_LIST /end CHARACTERISTIC
/begin CHARACTERISTIC IN_throttleVHigh2_bool_X_Limit "Limit threshold for X." VALUE 0x8003AABC RECORD_LAYOUT__5 0 COMPU_METHOD__17 0 4294967295 /begin FUNCTION_LIST FaultManager /end FUNCTION_LIST /end CHARACTERISTIC
/begin CHARACTERISTIC IN_throttleVHigh2_bool_Y_Limit "Limit threshold for Y." VALUE 0x8003AAC0 RECORD_LAYOUT__5 0 COMPU_METHOD__17 0 4294967295 /begin FUNCTION_LIST FaultManager /end FUNCTION_LIST /end CHARACTERISTIC
/begin CHARACTERISTIC IN_throttleVLow1_bool_FaultOperation "Calibration for testing fault." VALUE 0x8003B06A RECORD_LAYOUT__3 0 COMPU_METHOD__28 0 8 /begin FUNCTION_LIST FaultManager /end FUNCTION_LIST /end CHARACTERISTIC
/begin CHARACTERISTIC IN_throttleVLow1_bool_X_Limit "Limit threshold for X." VALUE 0x8003AA9C RECORD_LAYOUT__5 0 COMPU_METHOD__17 0 4294967295 /begin FUNCTION_LIST FaultManager /end FUNCTION_LIST /end CHARACTERISTIC
/begin CHARACTERISTIC IN_throttleVLow1_bool_Y_Limit "Limit threshold for Y." VALUE 0x8003AAA0 RECORD_LAYOUT__5 0 COMPU_METHOD__17 0 4294967295 /begin FUNCTION_LIST FaultManager /end FUNCTION_LIST /end CHARACTERISTIC
/begin CHARACTERISTIC IN_throttleVLow2_bool_FaultOperation "Calibration for testing fault." VALUE 0x8003B06B RECORD_LAYOUT__3 0 COMPU_METHOD__28 0 8 /begin FUNCTION_LIST FaultManager /end FUNCTION_LIST /end CHARACTERISTIC
/begin CHARACTERISTIC IN_throttleVLow2_bool_X_Limit "Limit threshold for X." VALUE 0x8003AAB4 RECORD_LAYOUT__5 0 COMPU_METHOD__17 0 4294967295 /begin FUNCTION_LIST FaultManager /end FUNCTION_LIST /end CHARACTERISTIC
/begin CHARACTERISTIC IN_throttleVLow2_bool_Y_Limit "Limit threshold for Y." VALUE 0x8003AAB8 RECORD_LAYOUT__5 0 COMPU_METHOD__17 0 4294967295 /begin FUNCTION_LIST FaultManager /end FUNCTION_LIST /end CHARACTERISTIC
/begin CHARACTERISTIC IN_tireTempErrorFLI_bool_FaultOperation "Calibration for testing fault." VALUE 0x8003B06C RECORD_LAYOUT__3 0 COMPU_METHOD__28 0 8 /begin FUNCTION_LIST FaultManager /end FUNCTION_LIST /end CHARACTERISTIC
/begin CHARACTERISTIC IN_tireTempErrorFLI_bool_X_Limit "Limit threshold for X." VALUE 0x8003AAE4 RECORD_LAYOUT__5 0 COMPU_METHOD__17 0 4294967295 /begin FUNCTION_LIST FaultManager /end FUNCTION_LIST /end CHARACTERISTIC
/begin CHARACTERISTIC IN_tireTempErrorFLI_bool_Y_Limit "Limit threshold for Y." VALUE 0x8003AAE8 RECORD_LAYOUT__5 0 COMPU_METHOD__17 0 4294967295 /begin FUNCTION_LIST FaultManager /end FUNCTION_LIST /end CHARACTERISTIC
/begin CHARACTERISTIC IN_tireTempErrorFLM_bool_FaultOperation "Calibration for testing fault." VALUE 0x8003B06D RECORD_LAYOUT__3 0 COMPU_METHOD__28 0 8 /begin FUNCTION_LIST FaultManager /end FUNCTION_LIST /end CHARACTERISTIC
/begin CHARACTERISTIC IN_tireTempErrorFLM_bool_X_Limit "Limit threshold for X." VALUE 0x8003AB48 RECORD_LAYOUT__5 0 COMPU_METHOD__17 0 4294967295 /begin FUNCTION_LIST FaultManager /end FUNCTION_LIST /end CHARACTERISTIC
/begin CHARACTERISTIC IN_tireTempErrorFLM_bool_Y_Limit "Limit threshold for Y." VALUE 0x8003AB4C RECORD_LAYOUT__5 0 COMPU_METHOD__17 0 4294967295 /begin FUNCTION_LIST FaultManager /end FUNCTION_LIST /end CHARACTERISTIC
/begin CHARACTERISTIC IN_tireTempErrorFLO_bool_FaultOperation "Calibration for testing fault." VALUE 0x8003B06E RECORD_LAYOUT__3 0 COMPU_METHOD__28 0 8 /begin FUNCTION_LIST FaultManager /end FUNCTION_LIST /end CHARACTERISTIC
/begin CHARACTERISTIC IN_tireTempErrorFLO_bool_X_Limit "Limit threshold for X." VALUE 0x8003ABAC RECORD_LAYOUT__5 0 COMPU_METHOD__17 0 4294967295 /begin FUNCTION_LIST FaultManager /end FUNCTION_LIST /end CHARACTERISTIC
/begin CHARACTERISTIC IN_tireTempErrorFLO_bool_Y_Limit "Limit threshold for Y." VALUE 0x8003ABB0 RECORD_LAYOUT__5 0 COMPU_METHOD__17 0 4294967295 /begin FUNCTION_LIST FaultManager /end FUNCTION_LIST /end CHARACTERISTIC
/begin CHARACTERISTIC IN_tireTempErrorFRI_bool_FaultOperation "Calibration for testing fault." VALUE 0x8003B06F RECORD_LAYOUT__3 0 COMPU_METHOD__28 0 8 /begin FUNCTION_LIST FaultManager /end FUNCTION_LIST /end CHARACTERISTIC
/begin CHARACTERISTIC IN_tireTempErrorFRI_bool_X_Limit "Limit threshold for X." VALUE 0x8003AC10 RECORD_LAYOUT__5 0 COMPU_METHOD__17 0 4294967295 /begin FUNCTION_LIST FaultManager /end FUNCTION_LIST /end CHARACTERISTIC
/begin CHARACTERISTIC IN_tireTempErrorFRI_bool_Y_Limit "Limit threshold for Y." VALUE 0x8003AC14 RECORD_LAYOUT__5 0 COMPU_METHOD__17 0 4294967295 /begin FUNCTION_LIST FaultManager /end FUNCTION_LIST /end CHARACTERISTIC
/begin CHARACTERISTIC IN_tireTempErrorFRM_bool_FaultOperation "Calibration for testing fault." VALUE 0x8003B070 RECORD_LAYOUT__3 0 COMPU_METHOD__28 0 8 /begin FUNCTION_LIST FaultManager /end FUNCTION_LIST /end CHARACTERISTIC
/begin CHARACTERISTIC IN_tireTempErrorFRM_bool_X_Limit "Limit threshold for X." VALUE 0x8003AC74 RECORD_LAYOUT__5 0 COMPU_METHOD__17 0 4294967295 /begin FUNCTION_LIST FaultManager /end FUNCTION_LIST /end CHARACTERISTIC
/begin CHARACTERISTIC IN_tireTempErrorFRM_bool_Y_Limit "Limit threshold for Y." VALUE 0x8003AC78 RECORD_LAYOUT__5 0 COMPU_METHOD__17 0 4294967295 /begin FUNCTION_LIST FaultManager /end FUNCTION_LIST /end CHARACTERISTIC
/begin CHARACTERISTIC IN_tireTempErrorFRO_bool_FaultOperation "Calibration for testing fault." VALUE 0x8003B071 RECORD_LAYOUT__3 0 COMPU_METHOD__28 0 8 /begin FUNCTION_LIST FaultManager /end FUNCTION_LIST /end CHARACTERISTIC
/begin CHARACTERISTIC IN_tireTempErrorFRO_bool_X_Limit "Limit threshold for X." VALUE 0x8003ACD8 RECORD_LAYOUT__5 0 COMPU_METHOD__17 0 4294967295 /begin FUNCTION_LIST FaultManager /end FUNCTION_LIST /end CHARACTERISTIC
/begin CHARACTERISTIC IN_tireTempErrorFRO_bool_Y_Limit "Limit threshold for Y." VALUE 0x8003ACDC RECORD_LAYOUT__5 0 COMPU_METHOD__17 0 4294967295 /begin FUNCTION_LIST FaultManager /end FUNCTION_LIST /end CHARACTERISTIC
/begin CHARACTERISTIC IN_tireTempErrorRLI_bool_FaultOperation "Calibration for testing fault." VALUE 0x8003B072 RECORD_LAYOUT__3 0 COMPU_METHOD__28 0 8 /begin FUNCTION_LIST FaultManager /end FUNCTION_LIST /end CHARACTERISTIC
/begin CHARACTERISTIC IN_tireTempErrorRLI_bool_X_Limit "Limit threshold for X." VALUE 0x8003AD3C RECORD_LAYOUT__5 0 COMPU_METHOD__17 0 4294967295 /begin FUNCTION_LIST FaultManager /end FUNCTION_LIST /end CHARACTERISTIC
/begin CHARACTERISTIC IN_tireTempErrorRLI_bool_Y_Limit "Limit threshold for Y." VALUE 0x8003AD40 RECORD_LAYOUT__5 0 COMPU_METHOD__17 0 4294967295 /begin FUNCTION_LIST FaultManager /end FUNCTION_LIST /end CHARACTERISTIC
/begin CHARACTERISTIC IN_tireTempErrorRLM_bool_FaultOperation "Calibration for testing fault." VALUE 0x8003B073 RECORD_LAYOUT__3 0 COMPU_METHOD__28 0 8 /begin FUNCTION_LIST FaultManager /end FUNCTION_LIST /end CHARACTERISTIC
/begin CHARACTERISTIC IN_tireTempErrorRLM_bool_X_Limit "Limit threshold for X." VALUE 0x8003ADA0 RECORD_LAYOUT__5 0 COMPU_METHOD__17 0 4294967295 /begin FUNCTION_LIST FaultManager /end FUNCTION_LIST /end CHARACTERISTIC
/begin CHARACTERISTIC IN_tireTempErrorRLM_bool_Y_Limit "Limit threshold for Y." VALUE 0x8003ADA4 RECORD_LAYOUT__5 0 COMPU_METHOD__17 0 4294967295 /begin FUNCTION_LIST FaultManager /end FUNCTION_LIST /end CHARACTERISTIC
/begin CHARACTERISTIC IN_tireTempErrorRLO_bool_FaultOperation "Calibration for testing fault." VALUE 0x8003B074 RECORD_LAYOUT__3 0 COMPU_METHOD__28 0 8 /begin FUNCTION_LIST FaultManager /end FUNCTION_LIST /end CHARACTERISTIC
/begin CHARACTERISTIC IN_tireTempErrorRLO_bool_X_Limit "Limit threshold for X." VALUE 0x8003AE04 RECORD_LAYOUT__5 0 COMPU_METHOD__17 0 4294967295 /begin FUNCTION_LIST FaultManager /end FUNCTION_LIST /end CHARACTERISTIC
/begin CHARACTERISTIC IN_tireTempErrorRLO_bool_Y_Limit "Limit threshold for Y." VALUE 0x8003AE08 RECORD_LAYOUT__5 0 COMPU_METHOD__17 0 4294967295 /begin FUNCTION_LIST FaultManager /end FUNCTION_LIST /end CHARACTERISTIC
/begin CHARACTERISTIC IN_tireTempErrorRRI_bool_FaultOperation "Calibration for testing fault." VALUE 0x8003B075 RECORD_LAYOUT__3 0 COMPU_METHOD__28 0 8 /begin FUNCTION_LIST FaultManager /end FUNCTION_LIST /end CHARACTERISTIC
/begin CHARACTERISTIC IN_tireTempErrorRRI_bool_X_Limit "Limit threshold for X." VALUE 0x8003AE68 RECORD_LAYOUT__5 0 COMPU_METHOD__17 0 4294967295 /begin FUNCTION_LIST FaultManager /end FUNCTION_LIST /end CHARACTERISTIC
/begin CHARACTERISTIC IN_tireTempErrorRRI_bool_Y_Limit "Limit threshold for Y." VALUE 0x8003AE6C RECORD_LAYOUT__5 0 COMPU_METHOD__17 0 4294967295 /begin FUNCTION_LIST FaultManager /end FUNCTION_LIST /end CHARACTERISTIC
/begin CHARACTERISTIC IN_tireTempErrorRRM_bool_FaultOperation "Calibration for testing fault." VALUE 0x8003B076 RECORD_LAYOUT__3 0 COMPU_METHOD__28 0 8 /begin FUNCTION_LIST FaultManager /end FUNCTION_LIST /end CHARACTERISTIC
/begin CHARACTERISTIC IN_tireTempErrorRRM_bool_X_Limit "Limit threshold for X." VALUE 0x8003AECC RECORD_LAYOUT__5 0 COMPU_METHOD__17 0 4294967295 /begin FUNCTION_LIST FaultManager /end FUNCTION_LIST /end CHARACTERISTIC
/begin CHARACTERISTIC IN_tireTempErrorRRM_bool_Y_Limit "Limit threshold for Y." VALUE 0x8003AED0 RECORD_LAYOUT__5 0 COMPU_METHOD__17 0 4294967295 /begin FUNCTION_LIST FaultManager /end FUNCTION_LIST /end CHARACTERISTIC
/begin CHARACTERISTIC IN_tireTempErrorRRO_bool_FaultOperation "Calibration for testing fault." VALUE 0x8003B077 RECORD_LAYOUT__3 0 COMPU_METHOD__28 0 8 /begin FUNCTION_LIST FaultManager /end FUNCTION_LIST /end CHARACTERISTIC
/begin CHARACTERISTIC IN_tireTempErrorRRO_bool_X_Limit "Limit threshold for X." VALUE 0x8003AF30 RECORD_LAYOUT__5 0 COMPU_METHOD__17 0 4294967295 /begin FUNCTION_LIST FaultManager /end FUNCTION_LIST /end CHARACTERISTIC
/begin CHARACTERISTIC IN_tireTempErrorRRO_bool_Y_Limit "Limit threshold for Y." VALUE 0x8003AF34 RECORD_LAYOUT__5 0 COMPU_METHOD__17 0 4294967295 /begin FUNCTION_LIST FaultManager /end FUNCTION_LIST /end CHARACTERISTIC
/begin CHARACTERISTIC IN_tireTempHighRLM_v "" VALUE 0x8003AD94 RECORD_LAYOUT__1 0 COMPU_METHOD__3 -1E+17 1E+17 /begin FUNCTION_LIST tireTempRLM /end FUNCTION_LIST /end CHARACTERISTIC
/begin CHARACTERISTIC IN_tireTempHighRLO_v "" VALUE 0x8003ADF8 RECORD_LAYOUT__1 0 COMPU_METHOD__3 -1E+17 1E+17 /begin FUNCTION_LIST tireTempRLO /end FUNCTION_LIST /end CHARACTERISTIC
/begin CHARACTERISTIC IN_tireTempHighRRI_v "" VALUE 0x8003AE5C RECORD_LAYOUT__1 0 COMPU_METHOD__3 -1E+17 1E+17 /begin FUNCTION_LIST tireTempRRI /end FUNCTION_LIST /end CHARACTERISTIC
/begin CHARACTERISTIC IN_tireTempHighRRM_v "" VALUE 0x8003AEC0 RECORD_LAYOUT__1 0 COMPU_METHOD__3 -1E+17 1E+17 /begin FUNCTION_LIST tireTempRRM /end FUNCTION_LIST /end CHARACTERISTIC
/begin CHARACTERISTIC IN_tireTempHighRRO_v "" VALUE 0x8003AF24 RECORD_LAYOUT__1 0 COMPU_METHOD__3 -1E+17 1E+17 /begin FUNCTION_LIST tireTempRRO /end FUNCTION_LIST /end CHARACTERISTIC
/begin CHARACTERISTIC IN_tireTempLowRLM_v "" VALUE 0x8003AD88 RECORD_LAYOUT__1 0 COMPU_METHOD__3 -1E+17 1E+17 /begin FUNCTION_LIST tireTempRLM /end FUNCTION_LIST /end CHARACTERISTIC
/begin CHARACTERISTIC IN_tireTempLowRLO_v "" VALUE 0x8003ADEC RECORD_LAYOUT__1 0 COMPU_METHOD__3 -1E+17 1E+17 /begin FUNCTION_LIST tireTempRLO /end FUNCTION_LIST /end CHARACTERISTIC
/begin CHARACTERISTIC IN_tireTempLowRRI_v "" VALUE 0x8003AE50 RECORD_LAYOUT__1 0 COMPU_METHOD__3 -1E+17 1E+17 /begin FUNCTION_LIST tireTempRRI /end FUNCTION_LIST /end CHARACTERISTIC
/begin CHARACTERISTIC IN_tireTempLowRRM_v "" VALUE 0x8003AEB4 RECORD_LAYOUT__1 0 COMPU_METHOD__3 -1E+17 1E+17 /begin FUNCTION_LIST tireTempRRM /end FUNCTION_LIST /end CHARACTERISTIC
/begin CHARACTERISTIC IN_tireTempLowRRO_v "" VALUE 0x8003AF18 RECORD_LAYOUT__1 0 COMPU_METHOD__3 -1E+17 1E+17 /begin FUNCTION_LIST tireTempRRO /end FUNCTION_LIST /end CHARACTERISTIC
/begin CHARACTERISTIC IN_tireTempRLM_bool "" VALUE 0x8003ADE8 RECORD_LAYOUT__3 0 COMPU_METHOD__5 0 1 /begin FUNCTION_LIST tireTempRLM /end FUNCTION_LIST /end CHARACTERISTIC
/begin CHARACTERISTIC IN_tireTempRLM_deg_OvrSts "Controls status of value override." VALUE 0x800380D8 RECORD_LAYOUT__3 0 COMPU_METHOD__6 0 255 /begin FUNCTION_LIST Override_21_ /end FUNCTION_LIST /end CHARACTERISTIC
/begin CHARACTERISTIC IN_tireTempRLM_deg_OvrVal "" VALUE 0x800380D4 RECORD_LAYOUT__1 0 COMPU_METHOD__3 -1E+17 1E+17 /begin FUNCTION_LIST Override_21_ /end FUNCTION_LIST /end CHARACTERISTIC
/begin CHARACTERISTIC IN_tireTempRLO_bool "" VALUE 0x8003AE4C RECORD_LAYOUT__3 0 COMPU_METHOD__5 0 1 /begin FUNCTION_LIST tireTempRLO /end FUNCTION_LIST /end CHARACTERISTIC
/begin CHARACTERISTIC IN_tireTempRLO_deg_OvrSts "Controls status of value override." VALUE 0x800380E0 RECORD_LAYOUT__3 0 COMPU_METHOD__6 0 255 /begin FUNCTION_LIST Override_22_ /end FUNCTION_LIST /end CHARACTERISTIC
/begin CHARACTERISTIC IN_tireTempRLO_deg_OvrVal "" VALUE 0x800380DC RECORD_LAYOUT__1 0 COMPU_METHOD__3 -1E+17 1E+17 /begin FUNCTION_LIST Override_22_ /end FUNCTION_LIST /end CHARACTERISTIC
/begin CHARACTERISTIC IN_tireTempRRI_bool "" VALUE 0x8003AEB0 RECORD_LAYOUT__3 0 COMPU_METHOD__5 0 1 /begin FUNCTION_LIST tireTempRRI /end FUNCTION_LIST /end CHARACTERISTIC
/begin CHARACTERISTIC IN_tireTempRRI_deg_OvrSts "Controls status of value override." VALUE 0x800380E8 RECORD_LAYOUT__3 0 COMPU_METHOD__6 0 255 /begin FUNCTION_LIST Override_23_ /end FUNCTION_LIST /end CHARACTERISTIC
/begin CHARACTERISTIC IN_tireTempRRI_deg_OvrVal "" VALUE 0x800380E4 RECORD_LAYOUT__1 0 COMPU_METHOD__3 -1E+17 1E+17 /begin FUNCTION_LIST Override_23_ /end FUNCTION_LIST /end CHARACTERISTIC
/begin CHARACTERISTIC IN_tireTempRRM_bool "" VALUE 0x8003AF14 RECORD_LAYOUT__3 0 COMPU_METHOD__5 0 1 /begin FUNCTION_LIST tireTempRRM /end FUNCTION_LIST /end CHARACTERISTIC
/begin CHARACTERISTIC IN_tireTempRRM_deg_OvrSts "Controls status of value override." VALUE 0x800380F0 RECORD_LAYOUT__3 0 COMPU_METHOD__6 0 255 /begin FUNCTION_LIST Override_24_ /end FUNCTION_LIST /end CHARACTERISTIC
/begin CHARACTERISTIC IN_tireTempRRM_deg_OvrVal "" VALUE 0x800380EC RECORD_LAYOUT__1 0 COMPU_METHOD__3 -1E+17 1E+17 /begin FUNCTION_LIST Override_24_ /end FUNCTION_LIST /end CHARACTERISTIC
/begin CHARACTERISTIC IN_tireTempRRO_bool "" VALUE 0x8003AF78 RECORD_LAYOUT__3 0 COMPU_METHOD__5 0 1 /begin FUNCTION_LIST tireTempRRO /end FUNCTION_LIST /end CHARACTERISTIC
/begin CHARACTERISTIC IN_tireTempRRO_deg_OvrSts "Controls status of value override." VALUE 0x800380F8 RECORD_LAYOUT__3 0 COMPU_METHOD__6 0 255 /begin FUNCTION_LIST Override_25_ /end FUNCTION_LIST /end CHARACTERISTIC
/begin CHARACTERISTIC IN_tireTempRRO_deg_OvrVal "" VALUE 0x800380F4 RECORD_LAYOUT__1 0 COMPU_METHOD__3 -1E+17 1E+17 /begin FUNCTION_LIST Override_25_ /end FUNCTION_LIST /end CHARACTERISTIC
/begin CHARACTERISTIC IN_tireTempVHighFLI_bool_FaultOperation "Calibration for testing fault." VALUE 0x8003B078 RECORD_LAYOUT__3 0 COMPU_METHOD__28 0 8 /begin FUNCTION_LIST FaultManager /end FUNCTION_LIST /end CHARACTERISTIC
/begin CHARACTERISTIC IN_tireTempVHighFLI_bool_X_Limit "Limit threshold for X." VALUE 0x8003AADC RECORD_LAYOUT__5 0 COMPU_METHOD__17 0 4294967295 /begin FUNCTION_LIST FaultManager /end FUNCTION_LIST /end CHARACTERISTIC
/begin CHARACTERISTIC IN_tireTempVHighFLI_bool_Y_Limit "Limit threshold for Y." VALUE 0x8003AAE0 RECORD_LAYOUT__5 0 COMPU_METHOD__17 0 4294967295 /begin FUNCTION_LIST FaultManager /end FUNCTION_LIST /end CHARACTERISTIC
/begin CHARACTERISTIC IN_tireTempVHighFLM_bool_FaultOperation "Calibration for testing fault." VALUE 0x8003B079 RECORD_LAYOUT__3 0 COMPU_METHOD__28 0 8 /begin FUNCTION_LIST FaultManager /end FUNCTION_LIST /end CHARACTERISTIC
/begin CHARACTERISTIC IN_tireTempVHighFLM_bool_X_Limit "Limit threshold for X." VALUE 0x8003AB40 RECORD_LAYOUT__5 0 COMPU_METHOD__17 0 4294967295 /begin FUNCTION_LIST FaultManager /end FUNCTION_LIST /end CHARACTERISTIC
/begin CHARACTERISTIC IN_tireTempVHighFLM_bool_Y_Limit "Limit threshold for Y." VALUE 0x8003AB44 RECORD_LAYOUT__5 0 COMPU_METHOD__17 0 4294967295 /begin FUNCTION_LIST FaultManager /end FUNCTION_LIST /end CHARACTERISTIC
/begin CHARACTERISTIC IN_tireTempVHighFLO_bool_FaultOperation "Calibration for testing fault." VALUE 0x8003B07A RECORD_LAYOUT__3 0 COMPU_METHOD__28 0 8 /begin FUNCTION_LIST FaultManager /end FUNCTION_LIST /end CHARACTERISTIC
/begin CHARACTERISTIC IN_tireTempVHighFLO_bool_X_Limit "Limit threshold for X." VALUE 0x8003ABA4 RECORD_LAYOUT__5 0 COMPU_METHOD__17 0 4294967295 /begin FUNCTION_LIST FaultManager /end FUNCTION_LIST /end CHARACTERISTIC
/begin CHARACTERISTIC IN_tireTempVHighFLO_bool_Y_Limit "Limit threshold for Y." VALUE 0x8003ABA8 RECORD_LAYOUT__5 0 COMPU_METHOD__17 0 4294967295 /begin FUNCTION_LIST FaultManager /end FUNCTION_LIST /end CHARACTERISTIC
/begin CHARACTERISTIC IN_tireTempVHighFRI_bool_FaultOperation "Calibration for testing fault." VALUE 0x8003B07B RECORD_LAYOUT__3 0 COMPU_METHOD__28 0 8 /begin FUNCTION_LIST FaultManager /end FUNCTION_LIST /end CHARACTERISTIC
/begin CHARACTERISTIC IN_tireTempVHighFRI_bool_X_Limit "Limit threshold for X." VALUE 0x8003AC08 RECORD_LAYOUT__5 0 COMPU_METHOD__17 0 4294967295 /begin FUNCTION_LIST FaultManager /end FUNCTION_LIST /end CHARACTERISTIC
/begin CHARACTERISTIC IN_tireTempVHighFRI_bool_Y_Limit "Limit threshold for Y." VALUE 0x8003AC0C RECORD_LAYOUT__5 0 COMPU_METHOD__17 0 4294967295 /begin FUNCTION_LIST FaultManager /end FUNCTION_LIST /end CHARACTERISTIC
/begin CHARACTERISTIC IN_tireTempVHighFRM_bool_FaultOperation "Calibration for testing fault." VALUE 0x8003B07C RECORD_LAYOUT__3 0 COMPU_METHOD__28 0 8 /begin FUNCTION_LIST FaultManager /end FUNCTION_LIST /end CHARACTERISTIC
/begin CHARACTERISTIC IN_tireTempVHighFRM_bool_X_Limit "Limit threshold for X." VALUE 0x8003AC6C RECORD_LAYOUT__5 0 COMPU_METHOD__17 0 4294967295 /begin FUNCTION_LIST FaultManager /end FUNCTION_LIST /end CHARACTERISTIC
/begin CHARACTERISTIC IN_tireTempVHighFRM_bool_Y_Limit "Limit threshold for Y." VALUE 0x8003AC70 RECORD_LAYOUT__5 0 COMPU_METHOD__17 0 4294967295 /begin FUNCTION_LIST FaultManager /end FUNCTION_LIST /end CHARACTERISTIC
/begin CHARACTERISTIC IN_tireTempVHighFRO_bool_FaultOperation "Calibration for testing fault." VALUE 0x8003B07D RECORD_LAYOUT__3 0 COMPU_METHOD__28 0 8 /begin FUNCTION_LIST FaultManager /end FUNCTION_LIST /end CHARACTERISTIC
/begin CHARACTERISTIC IN_tireTempVHighFRO_bool_X_Limit "Limit threshold for X." VALUE 0x8003ACD0 RECORD_LAYOUT__5 0 COMPU_METHOD__17 0 4294967295 /begin FUNCTION_LIST FaultManager /end FUNCTION_LIST /end CHARACTERISTIC
/begin CHARACTERISTIC IN_tireTempVHighFRO_bool_Y_Limit "Limit threshold for Y." VALUE 0x8003ACD4 RECORD_LAYOUT__5 0 COMPU_METHOD__17 0 4294967295 /begin FUNCTION_LIST FaultManager /end FUNCTION_LIST /end CHARACTERISTIC
/begin CHARACTERISTIC IN_tireTempVHighRLI_bool_FaultOperation "Calibration for testing fault." VALUE 0x8003B07E RECORD_LAYOUT__3 0 COMPU_METHOD__28 0 8 /begin FUNCTION_LIST FaultManager /end FUNCTION_LIST /end CHARACTERISTIC
/begin CHARACTERISTIC IN_tireTempVHighRLI_bool_X_Limit "Limit threshold for X." VALUE 0x8003AD34 RECORD_LAYOUT__5 0 COMPU_METHOD__17 0 4294967295 /begin FUNCTION_LIST FaultManager /end FUNCTION_LIST /end CHARACTERISTIC
/begin CHARACTERISTIC IN_tireTempVHighRLI_bool_Y_Limit "Limit threshold for Y." VALUE 0x8003AD38 RECORD_LAYOUT__5 0 COMPU_METHOD__17 0 4294967295 /begin FUNCTION_LIST FaultManager /end FUNCTION_LIST /end CHARACTERISTIC
/begin CHARACTERISTIC IN_tireTempVHighRLM_bool_FaultOperation "Calibration for testing fault." VALUE 0x8003B07F RECORD_LAYOUT__3 0 COMPU_METHOD__28 0 8 /begin FUNCTION_LIST FaultManager /end FUNCTION_LIST /end CHARACTERISTIC
/begin CHARACTERISTIC IN_tireTempVHighRLM_bool_X_Limit "Limit threshold for X." VALUE 0x8003AD98 RECORD_LAYOUT__5 0 COMPU_METHOD__17 0 4294967295 /begin FUNCTION_LIST FaultManager /end FUNCTION_LIST /end CHARACTERISTIC
/begin CHARACTERISTIC IN_tireTempVHighRLM_bool_Y_Limit "Limit threshold for Y." VALUE 0x8003AD9C RECORD_LAYOUT__5 0 COMPU_METHOD__17 0 4294967295 /begin FUNCTION_LIST FaultManager /end FUNCTION_LIST /end CHARACTERISTIC
/begin CHARACTERISTIC IN_tireTempVHighRLO_bool_FaultOperation "Calibration for testing fault." VALUE 0x8003B080 RECORD_LAYOUT__3 0 COMPU_METHOD__28 0 8 /begin FUNCTION_LIST FaultManager /end FUNCTION_LIST /end CHARACTERISTIC
/begin CHARACTERISTIC IN_tireTempVHighRLO_bool_X_Limit "Limit threshold for X." VALUE 0x8003ADFC RECORD_LAYOUT__5 0 COMPU_METHOD__17 0 4294967295 /begin FUNCTION_LIST FaultManager /end FUNCTION_LIST /end CHARACTERISTIC
/begin CHARACTERISTIC IN_tireTempVHighRLO_bool_Y_Limit "Limit threshold for Y." VALUE 0x8003AE00 RECORD_LAYOUT__5 0 COMPU_METHOD__17 0 4294967295 /begin FUNCTION_LIST FaultManager /end FUNCTION_LIST /end CHARACTERISTIC
/begin CHARACTERISTIC IN_tireTempVHighRRI_bool_FaultOperation "Calibration for testing fault." VALUE 0x8003B081 RECORD_LAYOUT__3 0 COMPU_METHOD__28 0 8 /begin FUNCTION_LIST FaultManager /end FUNCTION_LIST /end CHARACTERISTIC
/begin CHARACTERISTIC IN_tireTempVHighRRI_bool_X_Limit "Limit threshold for X." VALUE 0x8003AE60 RECORD_LAYOUT__5 0 COMPU_METHOD__17 0 4294967295 /begin FUNCTION_LIST FaultManager /end FUNCTION_LIST /end CHARACTERISTIC
/begin CHARACTERISTIC IN_tireTempVHighRRI_bool_Y_Limit "Limit threshold for Y." VALUE 0x8003AE64 RECORD_LAYOUT__5 0 COMPU_METHOD__17 0 4294967295 /begin FUNCTION_LIST FaultManager /end FUNCTION_LIST /end CHARACTERISTIC
/begin CHARACTERISTIC IN_tireTempVHighRRM_bool_FaultOperation "Calibration for testing fault." VALUE 0x8003B082 RECORD_LAYOUT__3 0 COMPU_METHOD__28 0 8 /begin FUNCTION_LIST FaultManager /end FUNCTION_LIST /end CHARACTERISTIC
/begin CHARACTERISTIC IN_tireTempVHighRRM_bool_X_Limit "Limit threshold for X." VALUE 0x8003AEC4 RECORD_LAYOUT__5 0 COMPU_METHOD__17 0 4294967295 /begin FUNCTION_LIST FaultManager /end FUNCTION_LIST /end CHARACTERISTIC
/begin CHARACTERISTIC IN_tireTempVHighRRM_bool_Y_Limit "Limit threshold for Y." VALUE 0x8003AEC8 RECORD_LAYOUT__5 0 COMPU_METHOD__17 0 4294967295 /begin FUNCTION_LIST FaultManager /end FUNCTION_LIST /end CHARACTERISTIC
/begin CHARACTERISTIC IN_tireTempVHighRRO_bool_FaultOperation "Calibration for testing fault." VALUE 0x8003B083 RECORD_LAYOUT__3 0 COMPU_METHOD__28 0 8 /begin FUNCTION_LIST FaultManager /end FUNCTION_LIST /end CHARACTERISTIC
/begin CHARACTERISTIC IN_tireTempVHighRRO_bool_X_Limit "Limit threshold for X." VALUE 0x8003AF28 RECORD_LAYOUT__5 0 COMPU_METHOD__17 0 4294967295 /begin FUNCTION_LIST FaultManager /end FUNCTION_LIST /end CHARACTERISTIC
/begin CHARACTERISTIC IN_tireTempVHighRRO_bool_Y_Limit "Limit threshold for Y." VALUE 0x8003AF2C RECORD_LAYOUT__5 0 COMPU_METHOD__17 0 4294967295 /begin FUNCTION_LIST FaultManager /end FUNCTION_LIST /end CHARACTERISTIC
/begin CHARACTERISTIC IN_tireTempVLowFLI_bool_FaultOperation "Calibration for testing fault." VALUE 0x8003B084 RECORD_LAYOUT__3 0 COMPU_METHOD__28 0 8 /begin FUNCTION_LIST FaultManager /end FUNCTION_LIST /end CHARACTERISTIC
/begin CHARACTERISTIC IN_tireTempVLowFLI_bool_X_Limit "Limit threshold for X." VALUE 0x8003AAD0 RECORD_LAYOUT__5 0 COMPU_METHOD__17 0 4294967295 /begin FUNCTION_LIST FaultManager /end FUNCTION_LIST /end CHARACTERISTIC
/begin CHARACTERISTIC IN_tireTempVLowFLI_bool_Y_Limit "Limit threshold for Y." VALUE 0x8003AAD4 RECORD_LAYOUT__5 0 COMPU_METHOD__17 0 4294967295 /begin FUNCTION_LIST FaultManager /end FUNCTION_LIST /end CHARACTERISTIC
/begin CHARACTERISTIC IN_tireTempVLowFLM_bool_FaultOperation "Calibration for testing fault." VALUE 0x8003B085 RECORD_LAYOUT__3 0 COMPU_METHOD__28 0 8 /begin FUNCTION_LIST FaultManager /end FUNCTION_LIST /end CHARACTERISTIC
/begin CHARACTERISTIC IN_tireTempVLowFLM_bool_X_Limit "Limit threshold for X." VALUE 0x8003AB34 RECORD_LAYOUT__5 0 COMPU_METHOD__17 0 4294967295 /begin FUNCTION_LIST FaultManager /end FUNCTION_LIST /end CHARACTERISTIC
/begin CHARACTERISTIC IN_tireTempVLowFLM_bool_Y_Limit "Limit threshold for Y." VALUE 0x8003AB38 RECORD_LAYOUT__5 0 COMPU_METHOD__17 0 4294967295 /begin FUNCTION_LIST FaultManager /end FUNCTION_LIST /end CHARACTERISTIC
/begin CHARACTERISTIC IN_tireTempVLowFLO_bool_FaultOperation "Calibration for testing fault." VALUE 0x8003B086 RECORD_LAYOUT__3 0 COMPU_METHOD__28 0 8 /begin FUNCTION_LIST FaultManager /end FUNCTION_LIST /end CHARACTERISTIC
/begin CHARACTERISTIC IN_tireTempVLowFLO_bool_X_Limit "Limit threshold for X." VALUE 0x8003AB98 RECORD_LAYOUT__5 0 COMPU_METHOD__17 0 4294967295 /begin FUNCTION_LIST FaultManager /end FUNCTION_LIST /end CHARACTERISTIC
/begin CHARACTERISTIC IN_tireTempVLowFLO_bool_Y_Limit "Limit threshold for Y." VALUE 0x8003AB9C RECORD_LAYOUT__5 0 COMPU_METHOD__17 0 4294967295 /begin FUNCTION_LIST FaultManager /end FUNCTION_LIST /end CHARACTERISTIC
/begin CHARACTERISTIC IN_tireTempVLowFRI_bool_FaultOperation "Calibration for testing fault." VALUE 0x8003B087 RECORD_LAYOUT__3 0 COMPU_METHOD__28 0 8 /begin FUNCTION_LIST FaultManager /end FUNCTION_LIST /end CHARACTERISTIC
/begin CHARACTERISTIC IN_tireTempVLowFRI_bool_X_Limit "Limit threshold for X." VALUE 0x8003ABFC RECORD_LAYOUT__5 0 COMPU_METHOD__17 0 4294967295 /begin FUNCTION_LIST FaultManager /end FUNCTION_LIST /end CHARACTERISTIC
/begin CHARACTERISTIC IN_tireTempVLowFRI_bool_Y_Limit "Limit threshold for Y." VALUE 0x8003AC00 RECORD_LAYOUT__5 0 COMPU_METHOD__17 0 4294967295 /begin FUNCTION_LIST FaultManager /end FUNCTION_LIST /end CHARACTERISTIC
/begin CHARACTERISTIC IN_tireTempVLowFRM_bool_FaultOperation "Calibration for testing fault." VALUE 0x8003B088 RECORD_LAYOUT__3 0 COMPU_METHOD__28 0 8 /begin FUNCTION_LIST FaultManager /end FUNCTION_LIST /end CHARACTERISTIC
/begin CHARACTERISTIC IN_tireTempVLowFRM_bool_X_Limit "Limit threshold for X." VALUE 0x8003AC60 RECORD_LAYOUT__5 0 COMPU_METHOD__17 0 4294967295 /begin FUNCTION_LIST FaultManager /end FUNCTION_LIST /end CHARACTERISTIC
/begin CHARACTERISTIC IN_tireTempVLowFRM_bool_Y_Limit "Limit threshold for Y." VALUE 0x8003AC64 RECORD_LAYOUT__5 0 COMPU_METHOD__17 0 4294967295 /begin FUNCTION_LIST FaultManager /end FUNCTION_LIST /end CHARACTERISTIC
/begin CHARACTERISTIC IN_tireTempVLowFRO_bool_FaultOperation "Calibration for testing fault." VALUE 0x8003B089 RECORD_LAYOUT__3 0 COMPU_METHOD__28 0 8 /begin FUNCTION_LIST FaultManager /end FUNCTION_LIST /end CHARACTERISTIC
/begin CHARACTERISTIC IN_tireTempVLowFRO_bool_X_Limit "Limit threshold for X." VALUE 0x8003ACC4 RECORD_LAYOUT__5 0 COMPU_METHOD__17 0 4294967295 /begin FUNCTION_LIST FaultManager /end FUNCTION_LIST /end CHARACTERISTIC
/begin CHARACTERISTIC IN_tireTempVLowFRO_bool_Y_Limit "Limit threshold for Y." VALUE 0x8003ACC8 RECORD_LAYOUT__5 0 COMPU_METHOD__17 0 4294967295 /begin FUNCTION_LIST FaultManager /end FUNCTION_LIST /end CHARACTERISTIC
/begin CHARACTERISTIC IN_tireTempVLowRLI_bool_FaultOperation "Calibration for testing fault." VALUE 0x8003B08A RECORD_LAYOUT__3 0 COMPU_METHOD__28 0 8 /begin FUNCTION_LIST FaultManager /end FUNCTION_LIST /end CHARACTERISTIC
/begin CHARACTERISTIC IN_tireTempVLowRLI_bool_X_Limit "Limit threshold for X." VALUE 0x8003AD28 RECORD_LAYOUT__5 0 COMPU_METHOD__17 0 4294967295 /begin FUNCTION_LIST FaultManager /end FUNCTION_LIST /end CHARACTERISTIC
/begin CHARACTERISTIC IN_tireTempVLowRLI_bool_Y_Limit "Limit threshold for Y." VALUE 0x8003AD2C RECORD_LAYOUT__5 0 COMPU_METHOD__17 0 4294967295 /begin FUNCTION_LIST FaultManager /end FUNCTION_LIST /end CHARACTERISTIC
/begin CHARACTERISTIC IN_tireTempVLowRLM_bool_FaultOperation "Calibration for testing fault." VALUE 0x8003B08B RECORD_LAYOUT__3 0 COMPU_METHOD__28 0 8 /begin FUNCTION_LIST FaultManager /end FUNCTION_LIST /end CHARACTERISTIC
/begin CHARACTERISTIC IN_tireTempVLowRLM_bool_X_Limit "Limit threshold for X." VALUE 0x8003AD8C RECORD_LAYOUT__5 0 COMPU_METHOD__17 0 4294967295 /begin FUNCTION_LIST FaultManager /end FUNCTION_LIST /end CHARACTERISTIC
/begin CHARACTERISTIC IN_tireTempVLowRLM_bool_Y_Limit "Limit threshold for Y." VALUE 0x8003AD90 RECORD_LAYOUT__5 0 COMPU_METHOD__17 0 4294967295 /begin FUNCTION_LIST FaultManager /end FUNCTION_LIST /end CHARACTERISTIC
/begin CHARACTERISTIC IN_tireTempVLowRLO_bool_FaultOperation "Calibration for testing fault." VALUE 0x8003B08C RECORD_LAYOUT__3 0 COMPU_METHOD__28 0 8 /begin FUNCTION_LIST FaultManager /end FUNCTION_LIST /end CHARACTERISTIC
/begin CHARACTERISTIC IN_tireTempVLowRLO_bool_X_Limit "Limit threshold for X." VALUE 0x8003ADF0 RECORD_LAYOUT__5 0 COMPU_METHOD__17 0 4294967295 /begin FUNCTION_LIST FaultManager /end FUNCTION_LIST /end CHARACTERISTIC
/begin CHARACTERISTIC IN_tireTempVLowRLO_bool_Y_Limit "Limit threshold for Y." VALUE 0x8003ADF4 RECORD_LAYOUT__5 0 COMPU_METHOD__17 0 4294967295 /begin FUNCTION_LIST FaultManager /end FUNCTION_LIST /end CHARACTERISTIC
/begin CHARACTERISTIC IN_tireTempVLowRRI_bool_FaultOperation "Calibration for testing fault." VALUE 0x8003B08D RECORD_LAYOUT__3 0 COMPU_METHOD__28 0 8 /begin FUNCTION_LIST FaultManager /end FUNCTION_LIST /end CHARACTERISTIC
/begin CHARACTERISTIC IN_tireTempVLowRRI_bool_X_Limit "Limit threshold for X." VALUE 0x8003AE54 RECORD_LAYOUT__5 0 COMPU_METHOD__17 0 4294967295 /begin FUNCTION_LIST FaultManager /end FUNCTION_LIST /end CHARACTERISTIC
/begin CHARACTERISTIC IN_tireTempVLowRRI_bool_Y_Limit "Limit threshold for Y." VALUE 0x8003AE58 RECORD_LAYOUT__5 0 COMPU_METHOD__17 0 4294967295 /begin FUNCTION_LIST FaultManager /end FUNCTION_LIST /end CHARACTERISTIC
/begin CHARACTERISTIC IN_tireTempVLowRRM_bool_FaultOperation "Calibration for testing fault." VALUE 0x8003B08E RECORD_LAYOUT__3 0 COMPU_METHOD__28 0 8 /begin FUNCTION_LIST FaultManager /end FUNCTION_LIST /end CHARACTERISTIC
/begin CHARACTERISTIC IN_tireTempVLowRRM_bool_X_Limit "Limit threshold for X." VALUE 0x8003AEB8 RECORD_LAYOUT__5 0 COMPU_METHOD__17 0 4294967295 /begin FUNCTION_LIST FaultManager /end FUNCTION_LIST /end CHARACTERISTIC
/begin CHARACTERISTIC IN_tireTempVLowRRM_bool_Y_Limit "Limit threshold for Y." VALUE 0x8003AEBC RECORD_LAYOUT__5 0 COMPU_METHOD__17 0 4294967295 /begin FUNCTION_LIST FaultManager /end FUNCTION_LIST /end CHARACTERISTIC
/begin CHARACTERISTIC IN_tireTempVLowRRO_bool_FaultOperation "Calibration for testing fault." VALUE 0x8003B08F RECORD_LAYOUT__3 0 COMPU_METHOD__28 0 8 /begin FUNCTION_LIST FaultManager /end FUNCTION_LIST /end CHARACTERISTIC
/begin CHARACTERISTIC IN_tireTempVLowRRO_bool_X_Limit "Limit threshold for X." VALUE 0x8003AF1C RECORD_LAYOUT__5 0 COMPU_METHOD__17 0 4294967295 /begin FUNCTION_LIST FaultManager /end FUNCTION_LIST /end CHARACTERISTIC
/begin CHARACTERISTIC IN_tireTempVLowRRO_bool_Y_Limit "Limit threshold for Y." VALUE 0x8003AF20 RECORD_LAYOUT__5 0 COMPU_METHOD__17 0 4294967295 /begin FUNCTION_LIST FaultManager /end FUNCTION_LIST /end CHARACTERISTIC
/begin CHARACTERISTIC IN_tireTempVToDegRLM "" CURVE 0x8003ADC8 RECORD_LAYOUT__1 0 COMPU_METHOD__16 -1E+17 1E+17
 /begin AXIS_DESCR COM_AXIS IN_tireTempVToDegRLM_LookupX_IN COMPU_METHOD__15 8 -1E+17 1E+17 AXIS_PTS_REF IN_tireTempVToDegRLM_LookupX /end AXIS_DESCR
 /begin FUNCTION_LIST tireTempRLM /end FUNCTION_LIST
/end CHARACTERISTIC
/begin CHARACTERISTIC IN_tireTempVToDegRLO "" CURVE 0x8003AE2C RECORD_LAYOUT__1 0 COMPU_METHOD__16 -1E+17 1E+17
 /begin AXIS_DESCR COM_AXIS IN_tireTempVToDegRLO_LookupX_IN COMPU_METHOD__15 8 -1E+17 1E+17 AXIS_PTS_REF IN_tireTempVToDegRLO_LookupX /end AXIS_DESCR
 /begin FUNCTION_LIST tireTempRLO /end FUNCTION_LIST
/end CHARACTERISTIC
/begin CHARACTERISTIC IN_tireTempVToDegRRI "" CURVE 0x8003AE90 RECORD_LAYOUT__1 0 COMPU_METHOD__16 -1E+17 1E+17
 /begin AXIS_DESCR COM_AXIS IN_tireTempVToDegRRI_LookupX_IN COMPU_METHOD__15 8 -1E+17 1E+17 AXIS_PTS_REF IN_tireTempVToDegRRI_LookupX /end AXIS_DESCR
 /begin FUNCTION_LIST tireTempRRI /end FUNCTION_LIST
/end CHARACTERISTIC
/begin CHARACTERISTIC IN_tireTempVToDegRRM "" CURVE 0x8003AEF4 RECORD_LAYOUT__1 0 COMPU_METHOD__16 -1E+17 1E+17
 /begin AXIS_DESCR COM_AXIS IN_tireTempVToDegRRM_LookupX_IN COMPU_METHOD__15 8 -1E+17 1E+17 AXIS_PTS_REF IN_tireTempVToDegRRM_LookupX /end AXIS_DESCR
 /begin FUNCTION_LIST tireTempRRM /end FUNCTION_LIST
/end CHARACTERISTIC
/begin CHARACTERISTIC IN_tireTempVToDegRRO "" CURVE 0x8003AF58 RECORD_LAYOUT__1 0 COMPU_METHOD__16 -1E+17 1E+17
 /begin AXIS_DESCR COM_AXIS IN_tireTempVToDegRRO_LookupX_IN COMPU_METHOD__15 8 -1E+17 1E+17 AXIS_PTS_REF IN_tireTempVToDegRRO_LookupX /end AXIS_DESCR
 /begin FUNCTION_LIST tireTempRRO /end FUNCTION_LIST
/end CHARACTERISTIC
/begin CHARACTERISTIC IN_tsSwitchNOHighLowerThresh "" VALUE 0x8003AF80 RECORD_LAYOUT__1 0 COMPU_METHOD__3 -1E+17 1E+17 /begin FUNCTION_LIST tsSwitch_1_ /end FUNCTION_LIST /end CHARACTERISTIC
/begin CHARACTERISTIC IN_tsSwitchNOHighUpperThresh "" VALUE 0x8003AF7C RECORD_LAYOUT__1 0 COMPU_METHOD__3 -1E+17 1E+17 /begin FUNCTION_LIST tsSwitch_1_ /end FUNCTION_LIST /end CHARACTERISTIC
/begin CHARACTERISTIC IN_tsSwitchNOLowLowerThresh "" VALUE 0x8003AF84 RECORD_LAYOUT__1 0 COMPU_METHOD__3 -1E+17 1E+17 /begin FUNCTION_LIST tsSwitch_1_ /end FUNCTION_LIST /end CHARACTERISTIC
/begin CHARACTERISTIC InjCDrv_EndOfStart "Indicates end of start for injection. Engine start is completed." VALUE 0x8003B090 RECORD_LAYOUT__3 0 COMPU_METHOD__44 0 255 /begin FUNCTION_LIST Fuel /end FUNCTION_LIST /end CHARACTERISTIC
/begin CHARACTERISTIC INPUT29_ADCMon_HoldCount "Number of samples to hold after ADC monitor check." VALUE 0x8003B030 RECORD_LAYOUT__3 0 COMPU_METHOD__20 0 255 /begin FUNCTION_LIST Platform /end FUNCTION_LIST /end CHARACTERISTIC
/begin CHARACTERISTIC LiteModeKey "Indicates that the build was produced with Lite mode." VALUE 0x8003B108 RECORD_LAYOUT__5 0 COMPU_METHOD__19 0 4294967295 READ_ONLY /end CHARACTERISTIC
/begin CHARACTERISTIC MatlabVersion "Matlab version used for build." ASCII 0x8003B0A0 RECORD_LAYOUT__3 0 COMPU_METHOD__19 0 255 READ_ONLY MATRIX_DIM 13 1 1 /end CHARACTERISTIC
/begin CHARACTERISTIC ModelName "Name of model" ASCII 0x8003B094 RECORD_LAYOUT__3 0 COMPU_METHOD__19 0 255 READ_ONLY MATRIX_DIM 6 1 1 /end CHARACTERISTIC
/begin CHARACTERISTIC OUT_directionCommand_bool "" VALUE 0x8003B013 RECORD_LAYOUT__3 0 COMPU_METHOD__5 0 1 /begin FUNCTION_LIST inverterOut /end FUNCTION_LIST /end CHARACTERISTIC
/begin CHARACTERISTIC OUT_dischargeEnable_bool "" VALUE 0x8003B011 RECORD_LAYOUT__3 0 COMPU_METHOD__5 0 1 /begin FUNCTION_LIST inverterOut /end FUNCTION_LIST /end CHARACTERISTIC
/begin CHARACTERISTIC OUT_inverterEnable_bool "" VALUE 0x8003B012 RECORD_LAYOUT__3 0 COMPU_METHOD__5 0 1 /begin FUNCTION_LIST inverterOut /end FUNCTION_LIST /end CHARACTERISTIC
/begin CHARACTERISTIC OUT_speedCommand_rpm "" VALUE 0x8003B014 RECORD_LAYOUT__1 0 COMPU_METHOD__3 -1E+17 1E+17 /begin FUNCTION_LIST inverterOut /end FUNCTION_LIST /end CHARACTERISTIC
/begin CHARACTERISTIC OUT_speedModeEnable_bool "" VALUE 0x8003B010 RECORD_LAYOUT__3 0 COMPU_METHOD__5 0 1 /begin FUNCTION_LIST inverterOut /end FUNCTION_LIST /end CHARACTERISTIC
/begin CHARACTERISTIC RaptorVersion "Raptor version used for build." ASCII 0x8003B0AD RECORD_LAYOUT__3 0 COMPU_METHOD__19 0 255 READ_ONLY MATRIX_DIM 20 1 1 /end CHARACTERISTIC
/begin CHARACTERISTIC SwIdTxt "Software name for this build." ASCII 0x8003B0C1 RECORD_LAYOUT__3 0 COMPU_METHOD__19 0 255 READ_ONLY MATRIX_DIM 10 1 1 /end CHARACTERISTIC
/begin CHARACTERISTIC SyC_tiPostDrvMax_C "Maximal time in PostDrive state with RPM equal to zero." VALUE 0x80983A6E RECORD_LAYOUT__6 0 COMPU_METHOD__35 0 4000 /begin FUNCTION_LIST Platform /end FUNCTION_LIST /end CHARACTERISTIC
/begin CHARACTERISTIC SyC_tiPostDrvMin_C "Minimum time in PostDrive state with RPM equal to zero." VALUE 0x80983A70 RECORD_LAYOUT__6 0 COMPU_METHOD__35 3 4000 /begin FUNCTION_LIST Platform /end FUNCTION_LIST /end CHARACTERISTIC
/begin CHARACTERISTIC SyC_tiPostDrvResv_C "Reserved time within SyC_PostDrvMax_C for DSM and EEPROM activities at the end of PostDrive." VALUE 0x80983A72 RECORD_LAYOUT__6 0 COMPU_METHOD__35 0 4000 /begin FUNCTION_LIST Platform /end FUNCTION_LIST /end CHARACTERISTIC
/begin CHARACTERISTIC Timer_BGND_G6Wyo_Steps "Number of times to step the task." VALUE 0x800380FC RECORD_LAYOUT__6 0 COMPU_METHOD__29 0 65535 /begin FUNCTION_LIST Application_Monitor /end FUNCTION_LIST /end CHARACTERISTIC
/begin CHARACTERISTIC Timer_ooqlV_Steps "Number of times to step the task." VALUE 0x800380FA RECORD_LAYOUT__6 0 COMPU_METHOD__29 0 65535 /begin FUNCTION_LIST Application_Monitor /end FUNCTION_LIST /end CHARACTERISTIC
/begin CHARACTERISTIC XCP1__XCP_BC_ID "CAN message ID used to identify XCP targets on the CAN bus. This should be the same for all ECUs on the CAN bus. This is how Raptor-Cal discovers ECUs on the CAN bus." VALUE 0x8003B018 RECORD_LAYOUT__5 0 COMPU_METHOD__5 0 4294967295 /begin FUNCTION_LIST XCP /end FUNCTION_LIST /end CHARACTERISTIC
/begin CHARACTERISTIC XCP1__XCP_RX_ID "CAN message ID that the module will receive CMD and STIM commands from the calibration tool on." VALUE 0x8003B01C RECORD_LAYOUT__5 0 COMPU_METHOD__5 0 4294967295 /begin FUNCTION_LIST XCP /end FUNCTION_LIST /end CHARACTERISTIC
/begin CHARACTERISTIC XCP1__XCP_Security "Calibration to change XCP security, takes effect at next power-up." VALUE 0x8003B032 RECORD_LAYOUT__6 0 COMPU_METHOD__23 0 65535 /begin FUNCTION_LIST XCP /end FUNCTION_LIST /end CHARACTERISTIC
/begin CHARACTERISTIC XCP1__XCP_TX_ID "CAN message ID that the module will send RES, ERR, EV, SERV and DAQ commands to the calibration tool on." VALUE 0x8003B020 RECORD_LAYOUT__5 0 COMPU_METHOD__5 0 4294967295 /begin FUNCTION_LIST XCP /end FUNCTION_LIST /end CHARACTERISTIC
/begin AXIS_PTS IN_tireTempVToDegRLM_LookupX "" 0x8003ADA8 IN_tireTempVToDegRLM_LookupX_IN RECORD_LAYOUT__2 0 COMPU_METHOD__15 8 -1E+17 1E+17 DEPOSIT ABSOLUTE /begin FUNCTION_LIST tireTempRLM /end FUNCTION_LIST /end AXIS_PTS
/begin AXIS_PTS IN_tireTempVToDegRLO_LookupX "" 0x8003AE0C IN_tireTempVToDegRLO_LookupX_IN RECORD_LAYOUT__2 0 COMPU_METHOD__15 8 -1E+17 1E+17 DEPOSIT ABSOLUTE /begin FUNCTION_LIST tireTempRLO /end FUNCTION_LIST /end AXIS_PTS
/begin AXIS_PTS IN_tireTempVToDegRRI_LookupX "" 0x8003AE70 IN_tireTempVToDegRRI_LookupX_IN RECORD_LAYOUT__2 0 COMPU_METHOD__15 8 -1E+17 1E+17 DEPOSIT ABSOLUTE /begin FUNCTION_LIST tireTempRRI /end FUNCTION_LIST /end AXIS_PTS
/begin AXIS_PTS IN_tireTempVToDegRRM_LookupX "" 0x8003AED4 IN_tireTempVToDegRRM_LookupX_IN RECORD_LAYOUT__2 0 COMPU_METHOD__15 8 -1E+17 1E+17 DEPOSIT ABSOLUTE /begin FUNCTION_LIST tireTempRRM /end FUNCTION_LIST /end AXIS_PTS
/begin AXIS_PTS IN_tireTempVToDegRRO_LookupX "" 0x8003AF38 IN_tireTempVToDegRRO_LookupX_IN RECORD_LAYOUT__2 0 COMPU_METHOD__15 8 -1E+17 1E+17 DEPOSIT ABSOLUTE /begin FUNCTION_LIST tireTempRRO /end FUNCTION_LIST /end AXIS_PTS
/begin FUNCTION tireTempRLM "tireTempRLM" /begin SUB_FUNCTION Override_21_ /end SUB_FUNCTION /end FUNCTION
/begin FUNCTION Override_21_ "Override" /end FUNCTION
/begin FUNCTION tireTempRLO "tireTempRLO" /begin SUB_FUNCTION Override_22_ /end SUB_FUNCTION /end FUNCTION
/begin FUNCTION Override_22_ "Override" /end FUNCTION
/begin FUNCTION tireTempRRI "tireTempRRI" /begin SUB_FUNCTION Override_23_ /end SUB_FUNCTION /end FUNCTION
/begin FUNCTION Override_23_ "Override" /end FUNCTION
/begin FUNCTION tireTempRRM "tireTempRRM" /begin SUB_FUNCTION Override_24_ /end SUB_FUNCTION /end FUNCTION
/begin FUNCTION Override_24_ "Override" /end FUNCTION
/begin FUNCTION tireTempRRO "tireTempRRO" /begin SUB_FUNCTION Override_25_ /end SUB_FUNCTION /end FUNCTION
/begin FUNCTION Override_25_ "Override" /end FUNCTION
/begin FUNCTION tsSwitch "tsSwitch" /begin SUB_FUNCTION tsSwitch_1_ /end SUB_FUNCTION /end FUNCTION
/begin FUNCTION tsSwitch_1_ "tsSwitch" /end FUNCTION
/begin FUNCTION wheelSpeed "wheelSpeed" /begin SUB_FUNCTION wheelSpeedFL wheelSpeedFR wheelSpeedRL wheelSpeedRR /end SUB_FUNCTION /end FUNCTION
/begin FUNCTION wheelSpeedFL "wheelSpeedFL" /end FUNCTION
/begin FUNCTION wheelSpeedFR "wheelSpeedFR" /end FUNCTION
/begin FUNCTION wheelSpeedRL "wheelSpeedRL" /end FUNCTION
/begin FUNCTION wheelSpeedRR "wheelSpeedRR" /end FUNCTION
/begin FUNCTION digitalInputs "digitalInputs" /begin SUB_FUNCTION steeringWheel /end SUB_FUNCTION /end FUNCTION
/begin FUNCTION steeringWheel "steeringWheel"
 /begin SUB_FUNCTION coolSwitch digitalSwitch1 markSwitch pageDown pageUp pttSwitch pwrDownSwitch pwrUpSwitch /end SUB_FUNCTION
/end FUNCTION
/begin FUNCTION coolSwitch "coolSwitch" /end FUNCTION
/begin FUNCTION digitalSwitch1 "digitalSwitch1" /end FUNCTION
/begin FUNCTION markSwitch "markSwitch" /end FUNCTION
/begin FUNCTION pageDown "pageDown" /end FUNCTION
/begin FUNCTION pageUp "pageUp" /end FUNCTION
/begin FUNCTION pttSwitch "pttSwitch" /end FUNCTION
/begin FUNCTION pwrDownSwitch "pwrDownSwitch" /end FUNCTION
/begin FUNCTION pwrUpSwitch "pwrUpSwitch" /end FUNCTION
/begin FUNCTION Outputs "Outputs" /begin SUB_FUNCTION canOutputs /end SUB_FUNCTION /end FUNCTION
/begin FUNCTION canOutputs "canOutputs" /begin SUB_FUNCTION inverterOut /end SUB_FUNCTION /end FUNCTION
/begin FUNCTION inverterOut "inverterOut" /end FUNCTION
/begin FUNCTION System "System"
 /begin SUB_FUNCTION App_Triggers Application_Monitor CAN FaultManager Platform Timed_Triggers XCP /end SUB_FUNCTION
/end FUNCTION
/begin FUNCTION App_Triggers "App_Triggers" /end FUNCTION
/begin FUNCTION Application_Monitor "Application_Monitor" /end FUNCTION
/begin FUNCTION CAN "CAN" /end FUNCTION
/begin FUNCTION FaultManager "FaultManager" /end FUNCTION
/begin FUNCTION Platform "Platform" /begin SUB_FUNCTION EngineConfig /end SUB_FUNCTION /end FUNCTION
/begin FUNCTION EngineConfig "EngineConfig" /begin SUB_FUNCTION Fuel /end SUB_FUNCTION /end FUNCTION
/begin FUNCTION Fuel "Fuel" /end FUNCTION
/begin FUNCTION Timed_Triggers "Timed_Triggers" /end FUNCTION
/begin FUNCTION XCP "XCP" /end FUNCTION
/begin GROUP GroupAccess1
 /begin REF_CHARACTERISTIC IN_brakeVLowF_bool_X_Limit IN_brakeVLowF_bool_Y_Limit IN_brakeVHighF_bool_X_Limit IN_brakeVHighF_bool_Y_Limit IN_brakeErrorF_bool_X_Limit IN_brakeErrorF_bool_Y_Limit IN_brakeVLowR_bool_X_Limit IN_brakeVLowR_bool_Y_Limit IN_brakeVHighR_bool_X_Limit IN_brakeVHighR_bool_Y_Limit IN_brakeErrorR_bool_X_Limit IN_brakeErrorR_bool_Y_Limit IN_bspdBrakeError_bool_X_Limit IN_bspdBrakeError_bool_Y_Limit IN_bspdStatusError_bool_X_Limit IN_bspdStatusError_bool_Y_Limit IN_coolantTempVLowInverterIn_bool_X_Limit IN_coolantTempVLowInverterIn_bool_Y_Limit IN_coolantTempVHighInverterIn_bool_X_Limit IN_coolantTempVHighInverterIn_bool_Y_Limit IN_coolantTempErrorInverterIn_bool_X_Limit IN_coolantTempErrorInverterIn_bool_Y_Limit IN_coolantTempVLowInverterOut_bool_X_Limit IN_coolantTempVLowInverterOut_bool_Y_Limit IN_coolantTempVHighInverterOut_bool_X_Limit IN_coolantTempVHighInverterOut_bool_Y_Limit IN_coolantTempErrorInverterOut_bool_X_Limit IN_coolantTempErrorInverterOut_bool_Y_Limit IN_coolantTempVLowMotorIn_bool_X_Limit IN_coolantTempVLowMotorIn_bool_Y_Limit IN_coolantTempVHighMotorIn_bool_X_Limit IN_coolantTempVHighMotorIn_bool_Y_Limit IN_coolantTempErrorMotorIn_bool_X_Limit IN_coolantTempErrorMotorIn_bool_Y_Limit IN_rotorTempVLowFL_bool_X_Limit IN_rotorTempVLowFL_bool_Y_Limit IN_rotorTempVHighFL_bool_X_Limit IN_rotorTempVHighFL_bool_Y_Limit IN_rotorTempErrorFL_bool_X_Limit IN_rotorTempErrorFL_bool_Y_Limit IN_rotorTempVLowRL_bool_X_Limit IN_rotorTempVLowRL_bool_Y_Limit IN_rotorTempVHighRL_bool_X_Limit IN_rotorTempVHighRL_bool_Y_Limit IN_rotorTempErrorRL_bool_X_Limit IN_rotorTempErrorRL_bool_Y_Limit IN_rotorTempVLowFR_bool_X_Limit IN_rotorTempVLowFR_bool_Y_Limit IN_rotorTempVHighFR_bool_X_Limit IN_rotorTempVHighFR_bool_Y_Limit IN_rotorTempErrorFR_bool_X_Limit IN_rotorTempErrorFR_bool_Y_Limit IN_rotorTempVLowRR_bool_X_Limit IN_rotorTempVLowRR_bool_Y_Limit IN_rotorTempVHighRR_bool_X_Limit IN_rotorTempVHighRR_bool_Y_Limit IN_rotorTempErrorRR_bool_X_Limit IN_rotorTempErrorRR_bool_Y_Limit IN_appsError_bool_X_Limit IN_appsError_bool_Y_Limit IN_throttleVLow1_bool_X_Limit IN_throttleVLow1_bool_Y_Limit IN_throttleVHigh1_bool_X_Limit IN_throttleVHigh1_bool_Y_Limit IN_throttleError1_bool_X_Limit IN_throttleError1_bool_Y_Limit IN_throttleVLow2_bool_X_Limit IN_throttleVLow2_bool_Y_Limit IN_throttleVHigh2_bool_X_Limit IN_throttleVHigh2_bool_Y_Limit IN_throttleError2_bool_X_Limit IN_throttleError2_bool_Y_Limit IN_tireTempVLowFLI_bool_X_Limit IN_tireTempVLowFLI_bool_Y_Limit IN_tireTempVHighFLI_bool_X_Limit IN_tireTempVHighFLI_bool_Y_Limit IN_tireTempErrorFLI_bool_X_Limit IN_tireTempErrorFLI_bool_Y_Limit IN_tireTempVLowFLM_bool_X_Limit IN_tireTempVLowFLM_bool_Y_Limit IN_tireTempVHighFLM_bool_X_Limit IN_tireTempVHighFLM_bool_Y_Limit IN_tireTempErrorFLM_bool_X_Limit IN_tireTempErrorFLM_bool_Y_Limit IN_tireTempVLowFLO_bool_X_Limit IN_tireTempVLowFLO_bool_Y_Limit IN_tireTempVHighFLO_bool_X_Limit IN_tireTempVHighFLO_bool_Y_Limit IN_tireTempErrorFLO_bool_X_Limit IN_tireTempErrorFLO_bool_Y_Limit IN_tireTempVLowFRI_bool_X_Limit IN_tireTempVLowFRI_bool_Y_Limit IN_tireTempVHighFRI_bool_X_Limit IN_tireTempVHighFRI_bool_Y_Limit IN_tireTempErrorFRI_bool_X_Limit IN_tireTempErrorFRI_bool_Y_Limit IN_tireTempVLowFRM_bool_X_Limit IN_tireTempVLowFRM_bool_Y_Limit IN_tireTempVHighFRM_bool_X_Limit IN_tireTempVHighFRM_bool_Y_Limit IN_tireTempErrorFRM_bool_X_Limit IN_tireTempErrorFRM_bool_Y_Limit IN_tireTempVLowFRO_bool_X_Limit IN_tireTempVLowFRO_bool_Y_Limit IN_tireTempVHighFRO_bool_X_Limit IN_tireTempVHighFRO_bool_Y_Limit IN_tireTempErrorFRO_bool_X_Limit IN_tireTempErrorFRO_bool_Y_Limit IN_tireTempVLowRLI_bool_X_Limit IN_tireTempVLowRLI_bool_Y_Limit IN_tireTempVHighRLI_bool_X_Limit IN_tireTempVHighRLI_bool_Y_Limit IN_tireTempErrorRLI_bool_X_Limit IN_tireTempErrorRLI_bool_Y_Limit IN_tireTempLowRLM_v IN_tireTempVLowRLM_bool_X_Limit IN_tireTempVLowRLM_bool_Y_Limit IN_tireTempHighRLM_v IN_tireTempVHighRLM_bool_X_Limit IN_tireTempVHighRLM_bool_Y_Limit IN_tireTempErrorRLM_bool_X_Limit IN_tireTempErrorRLM_bool_Y_Limit IN_tireTempVToDegRLM_LookupX IN_tireTempVToDegRLM IN_tireTempRLM_deg_OvrVal IN_tireTempRLM_deg_OvrSts IN_tireTempRLM_bool IN_tireTempLowRLO_v IN_tireTempVLowRLO_bool_X_Limit IN_tireTempVLowRLO_bool_Y_Limit IN_tireTempHighRLO_v IN_tireTempVHighRLO_bool_X_Limit IN_tireTempVHighRLO_bool_Y_Limit IN_tireTempErrorRLO_bool_X_Limit IN_tireTempErrorRLO_bool_Y_Limit IN_tireTempVToDegRLO_LookupX IN_tireTempVToDegRLO IN_tireTempRLO_deg_OvrVal IN_tireTempRLO_deg_OvrSts IN_tireTempRLO_bool IN_tireTempLowRRI_v IN_tireTempVLowRRI_bool_X_Limit IN_tireTempVLowRRI_bool_Y_Limit IN_tireTempHighRRI_v IN_tireTempVHighRRI_bool_X_Limit IN_tireTempVHighRRI_bool_Y_Limit IN_tireTempErrorRRI_bool_X_Limit IN_tireTempErrorRRI_bool_Y_Limit IN_tireTempVToDegRRI_LookupX IN_tireTempVToDegRRI IN_tireTempRRI_deg_OvrVal IN_tireTempRRI_deg_OvrSts IN_tireTempRRI_bool IN_tireTempLowRRM_v IN_tireTempVLowRRM_bool_X_Limit IN_tireTempVLowRRM_bool_Y_Limit IN_tireTempHighRRM_v IN_tireTempVHighRRM_bool_X_Limit IN_tireTempVHighRRM_bool_Y_Limit IN_tireTempErrorRRM_bool_X_Limit IN_tireTempErrorRRM_bool_Y_Limit IN_tireTempVToDegRRM_LookupX IN_tireTempVToDegRRM IN_tireTempRRM_deg_OvrVal IN_tireTempRRM_deg_OvrSts IN_tireTempRRM_bool IN_tireTempLowRRO_v IN_tireTempVLowRRO_bool_X_Limit IN_tireTempVLowRRO_bool_Y_Limit IN_tireTempHighRRO_v IN_tireTempVHighRRO_bool_X_Limit IN_tireTempVHighRRO_bool_Y_Limit IN_tireTempErrorRRO_bool_X_Limit IN_tireTempErrorRRO_bool_Y_Limit IN_tireTempVToDegRRO_LookupX IN_tireTempVToDegRRO IN_tireTempRRO_deg_OvrVal IN_tireTempRRO_deg_OvrSts IN_tireTempRRO_bool IN_tsSwitchNOHighUpperThresh IN_tsSwitchNOHighLowerThresh IN_tsSwitchNOLowLowerThresh IN_hallEffectLowFL_hz IN_hallEffectVLowFL_bool_X_Limit IN_hallEffectVLowFL_bool_Y_Limit IN_hallEffectHighFL_hz IN_hallEffectVHighFL_bool_X_Limit IN_hallEffectVHighFL_bool_Y_Limit IN_hallEffectErrorFL_bool_X_Limit IN_hallEffectErrorFL_bool_Y_Limit IN_hallEffectLowFR_hz IN_hallEffectVLowFR_bool_X_Limit IN_hallEffectVLowFR_bool_Y_Limit IN_hallEffectHighFR_hz IN_hallEffectVHighFR_bool_X_Limit IN_hallEffectVHighFR_bool_Y_Limit IN_hallEffectErrorFR_bool_X_Limit IN_hallEffectErrorFR_bool_Y_Limit IN_hallEffectLowRL_hz IN_hallEffectVLowRL_bool_X_Limit IN_hallEffectVLowRL_bool_Y_Limit IN_hallEffectHighRL_hz IN_hallEffectVHighRL_bool_X_Limit IN_hallEffectVHighRL_bool_Y_Limit IN_hallEffectErrorRL_bool_X_Limit IN_hallEffectErrorRL_bool_Y_Limit IN_hallEffectLowRR_hz IN_hallEffectVLowRR_bool_X_Limit IN_hallEffectVLowRR_bool_Y_Limit IN_hallEffectHighRR_hz IN_hallEffectVHighRR_bool_X_Limit IN_hallEffectVHighRR_bool_Y_Limit IN_hallEffectErrorRR_bool_X_Limit IN_hallEffectErrorRR_bool_Y_Limit IN_coolPolarityOverride_bool IN_PolarityOverride_bool IN_markPolarityOverride_bool IN_pageDownPolarityOverride_bool IN_pageUpPolarityOverride_bool IN_pttPolarityOverride_bool IN_pwrDownPolarityOverride_bool IN_pwrUpPolarityOverride_bool OUT_speedModeEnable_bool OUT_dischargeEnable_bool OUT_inverterEnable_bool OUT_directionCommand_bool OUT_speedCommand_rpm XCP1__XCP_BC_ID XCP1__XCP_RX_ID XCP1__XCP_TX_ID ModelName BuildNumber MatlabVersion RaptorVersion SwIdTxt CalIdTxt BuildUID IdTableRev HardwareType DateStamp LiteModeKey INPUT29_ADCMon_HoldCount XCP1__XCP_Security CAN1_Startup_Delay CAN1_ErrorCheck_Interval CAN1_ErrorPassive_Delay CAN2_Startup_Delay CAN2_ErrorCheck_Interval CAN2_ErrorPassive_Delay IN_appsError_bool_FaultOperation IN_brakeErrorF_bool_FaultOperation IN_brakeErrorR_bool_FaultOperation IN_brakeVHighF_bool_FaultOperation IN_brakeVHighR_bool_FaultOperation IN_brakeVLowF_bool_FaultOperation IN_brakeVLowR_bool_FaultOperation IN_bspdBrakeError_bool_FaultOperation IN_bspdStatusError_bool_FaultOperation IN_coolantTempErrorInverterIn_bool_FaultOperation IN_coolantTempErrorInverterOut_bool_FaultOperation IN_coolantTempErrorMotorIn_bool_FaultOperation IN_coolantTempVHighInverterIn_bool_FaultOperation IN_coolantTempVHighInverterOut_bool_FaultOperation IN_coolantTempVHighMotorIn_bool_FaultOperation IN_coolantTempVLowInverterIn_bool_FaultOperation IN_coolantTempVLowInverterOut_bool_FaultOperation IN_coolantTempVLowMotorIn_bool_FaultOperation IN_hallEffectErrorFL_bool_FaultOperation IN_hallEffectErrorFR_bool_FaultOperation IN_hallEffectErrorRL_bool_FaultOperation IN_hallEffectErrorRR_bool_FaultOperation IN_hallEffectVHighFL_bool_FaultOperation IN_hallEffectVHighFR_bool_FaultOperation IN_hallEffectVHighRL_bool_FaultOperation IN_hallEffectVHighRR_bool_FaultOperation IN_hallEffectVLowFL_bool_FaultOperation IN_hallEffectVLowFR_bool_FaultOperation IN_hallEffectVLowRL_bool_FaultOperation IN_hallEffectVLowRR_bool_FaultOperation IN_rotorTempErrorFL_bool_FaultOperation IN_rotorTempErrorFR_bool_FaultOperation IN_rotorTempErrorRL_bool_FaultOperation IN_rotorTempErrorRR_bool_FaultOperation IN_rotorTempVHighFL_bool_FaultOperation IN_rotorTempVHighFR_bool_FaultOperation IN_rotorTempVHighRL_bool_FaultOperation IN_rotorTempVHighRR_bool_FaultOperation IN_rotorTempVLowFL_bool_FaultOperation IN_rotorTempVLowFR_bool_FaultOperation IN_rotorTempVLowRL_bool_FaultOperation IN_rotorTempVLowRR_bool_FaultOperation IN_throttleError1_bool_FaultOperation IN_throttleError2_bool_FaultOperation IN_throttleVHigh1_bool_FaultOperation IN_throttleVHigh2_bool_FaultOperation IN_throttleVLow1_bool_FaultOperation IN_throttleVLow2_bool_FaultOperation IN_tireTempErrorFLI_bool_FaultOperation IN_tireTempErrorFLM_bool_FaultOperation IN_tireTempErrorFLO_bool_FaultOperation IN_tireTempErrorFRI_bool_FaultOperation IN_tireTempErrorFRM_bool_FaultOperation IN_tireTempErrorFRO_bool_FaultOperation IN_tireTempErrorRLI_bool_FaultOperation IN_tireTempErrorRLM_bool_FaultOperation IN_tireTempErrorRLO_bool_FaultOperation IN_tireTempErrorRRI_bool_FaultOperation IN_tireTempErrorRRM_bool_FaultOperation IN_tireTempErrorRRO_bool_FaultOperation IN_tireTempVHighFLI_bool_FaultOperation IN_tireTempVHighFLM_bool_FaultOperation IN_tireTempVHighFLO_bool_FaultOperation IN_tireTempVHighFRI_bool_FaultOperation IN_tireTempVHighFRM_bool_FaultOperation IN_tireTempVHighFRO_bool_FaultOperation IN_tireTempVHighRLI_bool_FaultOperation IN_tireTempVHighRLM_bool_FaultOperation IN_tireTempVHighRLO_bool_FaultOperation IN_tireTempVHighRRI_bool_FaultOperation IN_tireTempVHighRRM_bool_FaultOperation IN_tireTempVHighRRO_bool_FaultOperation IN_tireTempVLowFLI_bool_FaultOperation IN_tireTempVLowFLM_bool_FaultOperation IN_tireTempVLowFLO_bool_FaultOperation IN_tireTempVLowFRI_bool_FaultOperation IN_tireTempVLowFRM_bool_FaultOperation IN_tireTempVLowFRO_bool_FaultOperation IN_tireTempVLowRLI_bool_FaultOperation IN_tireTempVLowRLM_bool_FaultOperation IN_tireTempVLowRLO_bool_FaultOperation IN_tireTempVLowRRI_bool_FaultOperation IN_tireTempVLowRRM_bool_FaultOperation IN_tireTempVLowRRO_bool_FaultOperation Timer_ooqlV_Steps Timer_BGND_G6Wyo_Steps AppMonitorState AppMonitorForegroundOverrunAction EVSR24_step_Steps SyC_tiPostDrvMax_C SyC_tiPostDrvMin_C SyC_tiPostDrvResv_C InjCDrv_EndOfStart EndOfStart /end REF_CHARACTERISTIC
 /begin REF_MEASUREMENT IN_tireTempVToDegRLM_LookupX_IN IN_tireTempRLM_deg IN_tireTempVToDegRLO_LookupX_IN IN_tireTempRLO_deg IN_tireTempVToDegRRI_LookupX_IN IN_tireTempRRI_deg IN_tireTempVToDegRRM_LookupX_IN IN_tireTempRRM_deg IN_tireTempVToDegRRO_LookupX_IN IN_tireTempRRO_deg IN_tsSwitchSig_v IN_wheelSpeedFL_rpm IN_wheelSpeedFL_mps IN_groundSpeedFL_mph IN_wheelSpeedFR_rpm IN_wheelSpeedFR_mps IN_groundSpeedFR_mph IN_wheelSpeedRL_rpm IN_wheelSpeedRL_mps IN_groundSpeedRL_mph IN_wheelSpeedRR_rpm IN_wheelSpeedRR_mps IN_groundSpeedRR_mph IN_coolPolarity_bool IN_Polarity_bool IN_markPolarity_bool IN_pageDownPolarity_bool IN_pageUpPolarity_bool IN_pttPolarity_bool IN_pwrDownPolarity_bool IN_pwrUpPolarity_bool XCP_DAQ_TotalUsage XCP_LongestRun XCP_Error_Count XCP_DAQ00_10ms_Pct_Usage XCP_DAQ01_100ms_Pct_Usage CAN1_CANTX_QueueOverrun CAN1_CANTX_QueueCount CAN1_CANTX_QueueMax CAN1_CANRX_QueueOverrun CAN1_CANRX_QueueCount CAN1_CANRX_QueueMax CAN2_CANTX_QueueOverrun CAN2_CANTX_QueueCount CAN2_CANTX_QueueMax AppMonitorLastError AppMonitorPctIdleTime AppMonitorExecutionCount AppMonitorPctOverrun AppMonitorNumForegroundOverruns Reset_xHistBuf OCWDA_stWDAPtt ResetReason ResetGroupId B_pwf NumberOfResetsSincePowerOnReset ContextSaveAreaSize SystemStackSize UserStackSize MaxContextSaveAreaSize MaxSystemStackSize MaxUserStackSize Foreground_Pct_Usage Foreground_Period Foreground_LongestRun Background_Pct_Usage Background_Period Background_LongestRun Second_Pct_Usage Second_Period Second_LongestRun Startup_Usage Shutdown_Usage SafetyMonitor_Usage EEPROM_State /end REF_MEASUREMENT
/end GROUP
/end MODULE
/end PROJECT
