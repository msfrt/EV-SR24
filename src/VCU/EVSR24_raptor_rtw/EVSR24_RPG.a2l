/************************************************
* ASAP2 file
* Generated by Raptor 17-Oct-23 9:08:25 PM
* New Eagle, LLC 2012
* Machine: IFONELAPTOP
* User : serga
* OS : Microsoft Windows NT 6.2.9200.0
************************************************/
ASAP2_VERSION 1 51
/begin PROJECT EVSR24_004 "A__Kv6KfdEe4w4m4A8_oz"
/*LongIdentifier (BUILD_UID) */
/begin MODULE EVSR24 "20038"
/*LongIdentifier (XCPProdID) */
/begin IF_DATA XCP
 /begin PROTOCOL_LAYER /* XCP protocol layer version */ 0x100 /* T1 [ms] */ 2000 /* T2 [ms] */ 2000 /* T3 [ms] */ 2000 /* T4 [ms] */ 2000 /* T5 [ms] */ 2000 /* T6 [ms] */ 0050 /* T7 [ms] */ 0050 /* MAX_CTO */ 8 /* MAX_DTO */ 8 /* BYTE_ORDER */ BYTE_ORDER_MSB_LAST /* ADDRESS_GRANULARITY */ ADDRESS_GRANULARITY_BYTE OPTIONAL_CMD SET_REQUEST OPTIONAL_CMD SET_MTA OPTIONAL_CMD UPLOAD OPTIONAL_CMD BUILD_CHECKSUM OPTIONAL_CMD TRANSPORT_LAYER_CMD OPTIONAL_CMD CLEAR_DAQ_LIST OPTIONAL_CMD SET_DAQ_PTR OPTIONAL_CMD WRITE_DAQ OPTIONAL_CMD SET_DAQ_LIST_MODE OPTIONAL_CMD START_STOP_DAQ_LIST OPTIONAL_CMD START_STOP_SYNCH OPTIONAL_CMD GET_DAQ_CLOCK OPTIONAL_CMD FREE_DAQ OPTIONAL_CMD ALLOC_DAQ OPTIONAL_CMD ALLOC_ODT OPTIONAL_CMD ALLOC_ODT_ENTRY OPTIONAL_CMD GET_SEED OPTIONAL_CMD UNLOCK OPTIONAL_CMD GET_DAQ_RESOLUTION_INFO OPTIONAL_CMD GET_DAQ_PROCESSOR_INFO OPTIONAL_CMD DOWNLOAD OPTIONAL_CMD GET_COMM_MODE_INFO
  /begin COMMUNICATION_MODE_SUPPORTED /begin BLOCK SLAVE MASTER /* MAX_BS */ 0xff /* MIN_ST */ 100 /end BLOCK /end COMMUNICATION_MODE_SUPPORTED
  SEED_AND_KEY_EXTERNAL_FUNCTION "raptor_XCPSecurity.dll" /end PROTOCOL_LAYER
 /begin DAQ /* DAQ_CONFIG_TYPE */ DYNAMIC /* MAX_DAQ */ 2 /* MAX_EVENT_CHANNEL */ 2 /* MIN_DAQ */ 0 /* OPTIMISATION_TYPE */ OPTIMISATION_TYPE_DEFAULT /* ADDRESS_EXTENSION */ ADDRESS_EXTENSION_DAQ /* IDENTIFICATION_FIELD */ IDENTIFICATION_FIELD_TYPE_ABSOLUTE /* GRANULARITY_ODT_ENTRY_SIZE_DAQ */ GRANULARITY_ODT_ENTRY_SIZE_DAQ_BYTE /* MAX_ODT_ENTRY_SIZE_DAQ */ 4 /* OVERLOAD_INDICATION */ NO_OVERLOAD_INDICATION
  /begin TIMESTAMP_SUPPORTED /* TIMESTAMP_TICKS */ 1 /* TIMESTAMP_SIZE */ SIZE_DWORD /* TIMESTAMP_RESOLUTION */ UNIT_1MS /end TIMESTAMP_SUPPORTED
  /begin EVENT /* EVENT_CHANNEL_NAME */ "List_10ms" /* EVENT_CHANNEL_SHORT_NAME */ "EV_0" /* EVENT_CHANNEL_NUMBER */ 0 /* EVENT_CHANNEL_DIRECTION */ DAQ /* MAX_DAQ_LIST */ 20 /* TIME_CYCLE */ 10 /* TIME_UNIT */ 6 /* PRIORITY */ 0 /end EVENT
  /begin EVENT /* EVENT_CHANNEL_NAME */ "List_100ms" /* EVENT_CHANNEL_SHORT_NAME */ "EV_1" /* EVENT_CHANNEL_NUMBER */ 1 /* EVENT_CHANNEL_DIRECTION */ DAQ /* MAX_DAQ_LIST */ 20 /* TIME_CYCLE */ 100 /* TIME_UNIT */ 6 /* PRIORITY */ 0 /end EVENT
 /end DAQ
 /begin XCP_ON_CAN /* XCP on CAN 1.0 */ 0x0100 /* auto-detection -- Bit31= 1: EXT */ CAN_ID_BROADCAST 0x100 /* CMD/STIM (master -> slave) -- Bit31= 1: EXT */ CAN_ID_MASTER 0x200 /* RES/ERR/EV/SERV/DAQ (slave -> master) -- Bit31= 1: EXT */ CAN_ID_SLAVE 0x300 /* In Hz */ BAUDRATE 500000 /* Percentage of complete bit time. */ SAMPLE_POINT 75 SAMPLE_RATE SINGLE /* Slots per bit time. */ BTL_CYCLES 0 /* Length of the synch segment. */ SJW 2 /* Sync Edge */ SYNC_EDGE SINGLE /end XCP_ON_CAN
/end IF_DATA
/begin MOD_PAR /* COMMENT */ "" ECU_CALIBRATION_OFFSET 0x00000000 ADDR_EPK 0x8003B0D9 EPK "A__Kv6KfdEe4w4m4A8_oz"
 /begin MEMORY_SEGMENT CODE1 "Interrupt & Reset Vectors, Version Infos, Checksum Info" RESERVED FLASH INTERN 0x80000000 0x00020000 -1 -1 -1 -1 -1
  /begin IF_DATA XCP
   /begin SEGMENT 0 0x01 0x00 0x00 0x00 /begin CHECKSUM XCP_CRC_16_CITT /end CHECKSUM /end SEGMENT
  /end IF_DATA
 /end MEMORY_SEGMENT
 /begin MEMORY_SEGMENT BSW "BSW" CODE FLASH INTERN 0x80020000 0x00018030 -1 -1 -1 -1 -1
  /begin IF_DATA XCP
   /begin SEGMENT 6 0x01 0x00 0x00 0x00 /begin CHECKSUM XCP_CRC_16_CITT /end CHECKSUM /end SEGMENT
  /end IF_DATA
 /end MEMORY_SEGMENT
 /begin MEMORY_SEGMENT EDIT_CALS "RAM Calibration Space" DATA FLASH INTERN 0x80038030 0x000000D4 -1 -1 -1 -1 -1
  /begin IF_DATA XCP
   /begin SEGMENT 1 0x01 0x00 0x00 0x00 /begin CHECKSUM XCP_CRC_16_CITT /end CHECKSUM /begin ADDRESS_MAPPING 0x80038030 0xB0003D90 0x000000D4 /end ADDRESS_MAPPING /end SEGMENT
  /end IF_DATA
 /end MEMORY_SEGMENT
 /begin MEMORY_SEGMENT EEPROM_CALS "Calibration Space" DATA EEPROM INTERN 0x80038104 0x00002F90 -1 -1 -1 -1 -1
  /begin IF_DATA XCP
   /begin SEGMENT 2 0x01 0x00 0x00 0x00 /begin CHECKSUM XCP_CRC_16_CITT /end CHECKSUM /begin ADDRESS_MAPPING 0x80038104 0xB0000E00 0x00002F90 /end ADDRESS_MAPPING /end SEGMENT
  /end IF_DATA
 /end MEMORY_SEGMENT
 /begin MEMORY_SEGMENT ConstFLASH "Const FLASH Space" CODE FLASH INTERN 0x8003B094 0x00000078 -1 -1 -1 -1 -1
  /begin IF_DATA XCP
   /begin SEGMENT 4 0x01 0x00 0x00 0x00 /begin CHECKSUM XCP_CRC_16_CITT /end CHECKSUM /end SEGMENT
  /end IF_DATA
 /end MEMORY_SEGMENT
 /begin MEMORY_SEGMENT CODE2 "Application Code" RESERVED FLASH INTERN 0x8003B10C 0x001C4EF4 -1 -1 -1 -1 -1
  /begin IF_DATA XCP
   /begin SEGMENT 5 0x01 0x00 0x00 0x00 /begin CHECKSUM XCP_CRC_16_CITT /end CHECKSUM /end SEGMENT
  /end IF_DATA
 /end MEMORY_SEGMENT
 /begin MEMORY_SEGMENT ASW2 "Application Code" CODE FLASH INTERN 0x80800000 0x00180000 -1 -1 -1 -1 -1
  /begin IF_DATA XCP
   /begin SEGMENT 7 0x01 0x00 0x00 0x00 /begin CHECKSUM XCP_CRC_16_CITT /end CHECKSUM /end SEGMENT
  /end IF_DATA
 /end MEMORY_SEGMENT
 /begin MEMORY_SEGMENT BSW_Cals "BSW Cals" DATA FLASH INTERN 0x80980000 0x0007C000 -1 -1 -1 -1 -1
  /begin IF_DATA XCP
   /begin SEGMENT 8 0x01 0x00 0x00 0x00 /begin CHECKSUM XCP_CRC_16_CITT /end CHECKSUM /end SEGMENT
  /end IF_DATA
 /end MEMORY_SEGMENT
 /begin MEMORY_SEGMENT MeasurmentRAM2 "Measurement Space2" VARIABLES RAM INTERN 0xB0000000 0x00020000 -1 -1 -1 -1 -1
  /begin IF_DATA XCP
   /begin SEGMENT 10 0x01 0x00 0x00 0x00 /begin CHECKSUM XCP_CRC_16_CITT /end CHECKSUM /end SEGMENT
  /end IF_DATA
 /end MEMORY_SEGMENT
 /begin MEMORY_SEGMENT MeasurmentRAM "Measurement Space" VARIABLES RAM INTERN 0xD0000000 0x00020000 -1 -1 -1 -1 -1
  /begin IF_DATA XCP
   /begin SEGMENT 9 0x01 0x00 0x00 0x00 /begin CHECKSUM XCP_CRC_16_CITT /end CHECKSUM /end SEGMENT
  /end IF_DATA
 /end MEMORY_SEGMENT
 /* 0x80000000 - 0x80020000 : CODE1 */ /* 0x80020000 - 0x80038030 : BSW */ /* 0x80038030 - 0x80038104 : EDIT_CALS */ /* 0x80038104 - 0x8003B094 : EEPROM_CALS */ /* 0x8003B094 - 0x8003B10C : ConstFLASH */ /* 0x8003B10C - 0x80200000 : CODE2 */ /* 0x80800000 - 0x80980000 : ASW2 */ /* 0x80980000 - 0x809FC000 : BSW_Cals */ /* 0xB0000000 - 0xB0020000 : MeasurmentRAM2 */ /* 0xD0000000 - 0xD0020000 : MeasurmentRAM */ /end MOD_PAR
/begin MOD_COMMON /* COMMENT */ "" BYTE_ORDER MSB_LAST ALIGNMENT_BYTE 1 ALIGNMENT_FLOAT32_IEEE 1 ALIGNMENT_FLOAT64_IEEE 1 ALIGNMENT_LONG 1 ALIGNMENT_WORD 1 /end MOD_COMMON
/begin RECORD_LAYOUT RECORD_LAYOUT__4 FNC_VALUES 1 FLOAT32_IEEE COLUMN_DIR DIRECT /end RECORD_LAYOUT
/begin RECORD_LAYOUT RECORD_LAYOUT__2 AXIS_PTS_X 1 FLOAT32_IEEE /* IndexIncr */ INDEX_INCR /* Addressing */ DIRECT /end RECORD_LAYOUT
/begin RECORD_LAYOUT RECORD_LAYOUT__1 FNC_VALUES 1 FLOAT32_IEEE ROW_DIR DIRECT /end RECORD_LAYOUT
/begin RECORD_LAYOUT RECORD_LAYOUT__3 FNC_VALUES 1 UBYTE ROW_DIR DIRECT /end RECORD_LAYOUT
/begin COMPU_METHOD COMPU_METHOD__5 "" RAT_FUNC "%5.0" "" COEFFS 0 1 0 0 0 1 /end COMPU_METHOD
/begin COMPU_METHOD COMPU_METHOD__1 "" RAT_FUNC "%5.0" "Bool" COEFFS 0 1 0 0 0 1 /end COMPU_METHOD
/begin COMPU_METHOD COMPU_METHOD__7 "" RAT_FUNC "%7.2" "%" COEFFS 0 1 0 0 0 1 /end COMPU_METHOD
/begin COMPU_METHOD COMPU_METHOD__3 "" RAT_FUNC "%7.2" "" COEFFS 0 1 0 0 0 1 /end COMPU_METHOD
/begin COMPU_METHOD COMPU_METHOD__16 "" RAT_FUNC "%7.2" "Deg_C" COEFFS 0 1 0 0 0 1 /end COMPU_METHOD
/begin COMPU_METHOD COMPU_METHOD__4 "" RAT_FUNC "%7.2" "degC" COEFFS 0 1 0 0 0 1 /end COMPU_METHOD
/begin COMPU_METHOD COMPU_METHOD__18 "" RAT_FUNC "%7.2" "m" COEFFS 0 1 0 0 0 1 /end COMPU_METHOD
/begin COMPU_METHOD COMPU_METHOD__12 "" RAT_FUNC "%7.2" "motorRPM" COEFFS 0 1 0 0 0 1 /end COMPU_METHOD
/begin COMPU_METHOD COMPU_METHOD__9 "" RAT_FUNC "%7.2" "mph" COEFFS 0 1 0 0 0 1 /end COMPU_METHOD
/begin COMPU_METHOD COMPU_METHOD__13 "" RAT_FUNC "%7.2" "mV" COEFFS 0 1 0 0 0 1 /end COMPU_METHOD
/begin COMPU_METHOD COMPU_METHOD__8 "" RAT_FUNC "%7.2" "Nm" COEFFS 0 1 0 0 0 1 /end COMPU_METHOD
/begin COMPU_METHOD COMPU_METHOD__11 "" RAT_FUNC "%7.2" "pdmVolt" COEFFS 0 1 0 0 0 1 /end COMPU_METHOD
/begin COMPU_METHOD COMPU_METHOD__10 "" RAT_FUNC "%7.2" "rad/s" COEFFS 0 1 0 0 0 1 /end COMPU_METHOD
/begin COMPU_METHOD COMPU_METHOD__2 "" RAT_FUNC "%7.2" "sec" COEFFS 0 1 0 0 0 1 /end COMPU_METHOD
/begin COMPU_METHOD COMPU_METHOD__14 "" RAT_FUNC "%7.2" "tcSet" COEFFS 0 1 0 0 0 1 /end COMPU_METHOD
/begin COMPU_METHOD COMPU_METHOD__15 "" RAT_FUNC "%7.2" "V" COEFFS 0 1 0 0 0 1 /end COMPU_METHOD
/begin COMPU_METHOD COMPU_METHOD__6 "" TAB_VERB "%3.0" "" COMPU_TAB_REF COMPU_VTAB__1 /end COMPU_METHOD
/begin COMPU_VTAB COMPU_VTAB__1 "" TAB_VERB 2 0 "Pass Through" 1 "Override" /end COMPU_VTAB
/begin MEASUREMENT CTRL_cellSegment1TempToHVDuty_LookupX_IN "Input for CTRL_cellSegment1TempToHVDuty_LookupX" FLOAT32_IEEE COMPU_METHOD__3 0 0 -1E+17 1E+17 ECU_ADDRESS 0xB00008AC /begin FUNCTION_LIST accFanDuty /end FUNCTION_LIST /end MEASUREMENT
/begin MEASUREMENT CTRL_cellSegment1TempToLVDuty_LookupX_IN "Input for CTRL_cellSegment1TempToLVDuty_LookupX" FLOAT32_IEEE COMPU_METHOD__3 0 0 -1E+17 1E+17 ECU_ADDRESS 0xB00008A4 /begin FUNCTION_LIST accFanDuty /end FUNCTION_LIST /end MEASUREMENT
/begin MEASUREMENT CTRL_cellSegment2TempToHVDuty_LookupX_IN "Input for CTRL_cellSegment2TempToHVDuty_LookupX" FLOAT32_IEEE COMPU_METHOD__3 0 0 -1E+17 1E+17 ECU_ADDRESS 0xB000087C /begin FUNCTION_LIST accFanDuty4 /end FUNCTION_LIST /end MEASUREMENT
/begin MEASUREMENT CTRL_cellSegment2TempToLVDuty_LookupX_IN "Input for CTRL_cellSegment2TempToLVDuty_LookupX" FLOAT32_IEEE COMPU_METHOD__3 0 0 -1E+17 1E+17 ECU_ADDRESS 0xB0000874 /begin FUNCTION_LIST accFanDuty4 /end FUNCTION_LIST /end MEASUREMENT
/begin MEASUREMENT CTRL_cellSegment3TempToHVDuty_LookupX_IN "Input for CTRL_cellSegment3TempToHVDuty_LookupX" FLOAT32_IEEE COMPU_METHOD__3 0 0 -1E+17 1E+17 ECU_ADDRESS 0xB000089C /begin FUNCTION_LIST accFanDuty1 /end FUNCTION_LIST /end MEASUREMENT
/begin MEASUREMENT CTRL_cellSegment3TempToLVDuty_LookupX_IN "Input for CTRL_cellSegment3TempToLVDuty_LookupX" FLOAT32_IEEE COMPU_METHOD__3 0 0 -1E+17 1E+17 ECU_ADDRESS 0xB0000894 /begin FUNCTION_LIST accFanDuty1 /end FUNCTION_LIST /end MEASUREMENT
/begin MEASUREMENT CTRL_cellSegment4TempToHVDuty_LookupX_IN "Input for CTRL_cellSegment4TempToHVDuty_LookupX" FLOAT32_IEEE COMPU_METHOD__3 0 0 -1E+17 1E+17 ECU_ADDRESS 0xB000086C /begin FUNCTION_LIST accFanDuty5 /end FUNCTION_LIST /end MEASUREMENT
/begin MEASUREMENT CTRL_cellSegment4TempToLVDuty_LookupX_IN "Input for CTRL_cellSegment4TempToLVDuty_LookupX" FLOAT32_IEEE COMPU_METHOD__3 0 0 -1E+17 1E+17 ECU_ADDRESS 0xB0000864 /begin FUNCTION_LIST accFanDuty5 /end FUNCTION_LIST /end MEASUREMENT
/begin MEASUREMENT CTRL_cellSegment5TempToHVDuty_LookupX_IN "Input for CTRL_cellSegment5TempToHVDuty_LookupX" FLOAT32_IEEE COMPU_METHOD__3 0 0 -1E+17 1E+17 ECU_ADDRESS 0xB000088C /begin FUNCTION_LIST accFanDuty2 /end FUNCTION_LIST /end MEASUREMENT
/begin MEASUREMENT CTRL_cellSegment5TempToLVDuty_LookupX_IN "Input for CTRL_cellSegment5TempToLVDuty_LookupX" FLOAT32_IEEE COMPU_METHOD__3 0 0 -1E+17 1E+17 ECU_ADDRESS 0xB0000884 /begin FUNCTION_LIST accFanDuty2 /end FUNCTION_LIST /end MEASUREMENT
/begin MEASUREMENT CTRL_cellSegment6TempToHVDuty_LookupX_IN "Input for CTRL_cellSegment6TempToHVDuty_LookupX" FLOAT32_IEEE COMPU_METHOD__3 0 0 -1E+17 1E+17 ECU_ADDRESS 0xB000085C /begin FUNCTION_LIST accFanDuty6 /end FUNCTION_LIST /end MEASUREMENT
/begin MEASUREMENT CTRL_cellSegment6TempToLVDuty_LookupX_IN "Input for CTRL_cellSegment6TempToLVDuty_LookupX" FLOAT32_IEEE COMPU_METHOD__3 0 0 -1E+17 1E+17 ECU_ADDRESS 0xB0000854 /begin FUNCTION_LIST accFanDuty6 /end FUNCTION_LIST /end MEASUREMENT
/begin MEASUREMENT CTRL_cellSegment7TempToHVDuty_LookupX_IN "Input for CTRL_cellSegment7TempToHVDuty_LookupX" FLOAT32_IEEE COMPU_METHOD__3 0 0 -1E+17 1E+17 ECU_ADDRESS 0xB000083C /begin FUNCTION_LIST accFanDuty3 /end FUNCTION_LIST /end MEASUREMENT
/begin MEASUREMENT CTRL_cellSegment7TempToLVDuty_LookupX_IN "Input for CTRL_cellSegment7TempToLVDuty_LookupX" FLOAT32_IEEE COMPU_METHOD__3 0 0 -1E+17 1E+17 ECU_ADDRESS 0xB0000834 /begin FUNCTION_LIST accFanDuty3 /end FUNCTION_LIST /end MEASUREMENT
/begin MEASUREMENT CTRL_cellSegment8TempToHVDuty_LookupX_IN "Input for CTRL_cellSegment8TempToHVDuty_LookupX" FLOAT32_IEEE COMPU_METHOD__3 0 0 -1E+17 1E+17 ECU_ADDRESS 0xB000084C /begin FUNCTION_LIST accFanDuty7 /end FUNCTION_LIST /end MEASUREMENT
/begin MEASUREMENT CTRL_cellSegment8TempToLVDuty_LookupX_IN "Input for CTRL_cellSegment8TempToLVDuty_LookupX" FLOAT32_IEEE COMPU_METHOD__3 0 0 -1E+17 1E+17 ECU_ADDRESS 0xB0000844 /begin FUNCTION_LIST accFanDuty7 /end FUNCTION_LIST /end MEASUREMENT
/begin MEASUREMENT CTRL_coolantTempInverterInToLeftHVDuty_LookupX_IN "Input for CTRL_coolantTempInverterInToLeftHVDuty_LookupX" FLOAT32_IEEE COMPU_METHOD__3 0 0 -1E+17 1E+17 ECU_ADDRESS 0xB00008E4 /begin FUNCTION_LIST fanDutyLeft /end FUNCTION_LIST /end MEASUREMENT
/begin MEASUREMENT CTRL_coolantTempInverterInToLeftLVDuty_LookupX_IN "Input for CTRL_coolantTempInverterInToLeftLVDuty_LookupX" FLOAT32_IEEE COMPU_METHOD__3 0 0 -1E+17 1E+17 ECU_ADDRESS 0xB0000904 /begin FUNCTION_LIST fanDutyLeft /end FUNCTION_LIST /end MEASUREMENT
/begin MEASUREMENT CTRL_coolantTempInverterInToLeftLVDuty_LookupY_IN "Input for CTRL_coolantTempInverterInToLeftLVDuty_LookupY" FLOAT32_IEEE COMPU_METHOD__3 0 0 -1E+17 1E+17 ECU_ADDRESS 0xB0000908 /begin FUNCTION_LIST fanDutyLeft /end FUNCTION_LIST /end MEASUREMENT
/begin MEASUREMENT CTRL_coolantTempInverterInToRightHVDuty_LookupX_IN "Input for CTRL_coolantTempInverterInToRightHVDuty_LookupX" FLOAT32_IEEE COMPU_METHOD__3 0 0 -1E+17 1E+17 ECU_ADDRESS 0xB000092C /begin FUNCTION_LIST fanDutyRight /end FUNCTION_LIST /end MEASUREMENT
/begin MEASUREMENT CTRL_coolantTempInverterInToRightLVDuty_LookupX_IN "Input for CTRL_coolantTempInverterInToRightLVDuty_LookupX" FLOAT32_IEEE COMPU_METHOD__3 0 0 -1E+17 1E+17 ECU_ADDRESS 0xB000094C /begin FUNCTION_LIST fanDutyRight /end FUNCTION_LIST /end MEASUREMENT
/begin MEASUREMENT CTRL_coolantTempInverterInToRightLVDuty_LookupY_IN "Input for CTRL_coolantTempInverterInToRightLVDuty_LookupY" FLOAT32_IEEE COMPU_METHOD__3 0 0 -1E+17 1E+17 ECU_ADDRESS 0xB0000950 /begin FUNCTION_LIST fanDutyRight /end FUNCTION_LIST /end MEASUREMENT
/begin MEASUREMENT CTRL_coolantTempInverterInToWpDuty_LookupX_IN "Input for CTRL_coolantTempInverterInToWpDuty_LookupX" FLOAT32_IEEE COMPU_METHOD__3 0 0 -1E+17 1E+17 ECU_ADDRESS 0xB000097C /begin FUNCTION_LIST wpDuty /end FUNCTION_LIST /end MEASUREMENT
/begin MEASUREMENT CTRL_coolantTempInverterInToWpDuty_LookupY_IN "Input for CTRL_coolantTempInverterInToWpDuty_LookupY" FLOAT32_IEEE COMPU_METHOD__3 0 0 -1E+17 1E+17 ECU_ADDRESS 0xB0000980 /begin FUNCTION_LIST wpDuty /end FUNCTION_LIST /end MEASUREMENT
/begin MEASUREMENT CTRL_coolantTempInverterOutToLeftHVDuty_LookupX_IN "Input for CTRL_coolantTempInverterOutToLeftHVDuty_LookupX" FLOAT32_IEEE COMPU_METHOD__3 0 0 -1E+17 1E+17 ECU_ADDRESS 0xB00008EC /begin FUNCTION_LIST fanDutyLeft /end FUNCTION_LIST /end MEASUREMENT
/begin MEASUREMENT CTRL_coolantTempInverterOutToLeftLVDuty_LookupX_IN "Input for CTRL_coolantTempInverterOutToLeftLVDuty_LookupX" FLOAT32_IEEE COMPU_METHOD__3 0 0 -1E+17 1E+17 ECU_ADDRESS 0xB0000914 /begin FUNCTION_LIST fanDutyLeft /end FUNCTION_LIST /end MEASUREMENT
/begin MEASUREMENT CTRL_coolantTempInverterOutToLeftLVDuty_LookupY_IN "Input for CTRL_coolantTempInverterOutToLeftLVDuty_LookupY" FLOAT32_IEEE COMPU_METHOD__3 0 0 -1E+17 1E+17 ECU_ADDRESS 0xB0000918 /begin FUNCTION_LIST fanDutyLeft /end FUNCTION_LIST /end MEASUREMENT
/begin MEASUREMENT CTRL_coolantTempInverterOutToRightHVDuty_LookupX_IN "Input for CTRL_coolantTempInverterOutToRightHVDuty_LookupX" FLOAT32_IEEE COMPU_METHOD__3 0 0 -1E+17 1E+17 ECU_ADDRESS 0xB0000934 /begin FUNCTION_LIST fanDutyRight /end FUNCTION_LIST /end MEASUREMENT
/begin MEASUREMENT CTRL_coolantTempInverterOutToRightLVDuty_LookupX_IN "Input for CTRL_coolantTempInverterOutToRightLVDuty_LookupX" FLOAT32_IEEE COMPU_METHOD__3 0 0 -1E+17 1E+17 ECU_ADDRESS 0xB000095C /begin FUNCTION_LIST fanDutyRight /end FUNCTION_LIST /end MEASUREMENT
/begin MEASUREMENT CTRL_coolantTempInverterOutToRightLVDuty_LookupY_IN "Input for CTRL_coolantTempInverterOutToRightLVDuty_LookupY" FLOAT32_IEEE COMPU_METHOD__3 0 0 -1E+17 1E+17 ECU_ADDRESS 0xB0000960 /begin FUNCTION_LIST fanDutyRight /end FUNCTION_LIST /end MEASUREMENT
/begin MEASUREMENT CTRL_coolantTempInverterOutToWpDuty_LookupX_IN "Input for CTRL_coolantTempInverterOutToWpDuty_LookupX" FLOAT32_IEEE COMPU_METHOD__3 0 0 -1E+17 1E+17 ECU_ADDRESS 0xB000098C /begin FUNCTION_LIST wpDuty /end FUNCTION_LIST /end MEASUREMENT
/begin MEASUREMENT CTRL_coolantTempInverterOutToWpDuty_LookupY_IN "Input for CTRL_coolantTempInverterOutToWpDuty_LookupY" FLOAT32_IEEE COMPU_METHOD__3 0 0 -1E+17 1E+17 ECU_ADDRESS 0xB0000990 /begin FUNCTION_LIST wpDuty /end FUNCTION_LIST /end MEASUREMENT
/begin MEASUREMENT CTRL_coolantTempMotorInToLeftHVDuty_LookupX_IN "Input for CTRL_coolantTempMotorInToLeftHVDuty_LookupX" FLOAT32_IEEE COMPU_METHOD__3 0 0 -1E+17 1E+17 ECU_ADDRESS 0xB00008DC /begin FUNCTION_LIST fanDutyLeft /end FUNCTION_LIST /end MEASUREMENT
/begin MEASUREMENT CTRL_coolantTempMotorInToLeftLVDuty_LookupX_IN "Input for CTRL_coolantTempMotorInToLeftLVDuty_LookupX" FLOAT32_IEEE COMPU_METHOD__3 0 0 -1E+17 1E+17 ECU_ADDRESS 0xB00008F4 /begin FUNCTION_LIST fanDutyLeft /end FUNCTION_LIST /end MEASUREMENT
/begin MEASUREMENT CTRL_coolantTempMotorInToLeftLVDuty_LookupY_IN "Input for CTRL_coolantTempMotorInToLeftLVDuty_LookupY" FLOAT32_IEEE COMPU_METHOD__3 0 0 -1E+17 1E+17 ECU_ADDRESS 0xB00008F8 /begin FUNCTION_LIST fanDutyLeft /end FUNCTION_LIST /end MEASUREMENT
/begin MEASUREMENT CTRL_coolantTempMotorInToRightHVDuty_LookupX_IN "Input for CTRL_coolantTempMotorInToRightHVDuty_LookupX" FLOAT32_IEEE COMPU_METHOD__3 0 0 -1E+17 1E+17 ECU_ADDRESS 0xB0000924 /begin FUNCTION_LIST fanDutyRight /end FUNCTION_LIST /end MEASUREMENT
/begin MEASUREMENT CTRL_coolantTempMotorInToRightLVDuty_LookupX_IN "Input for CTRL_coolantTempMotorInToRightLVDuty_LookupX" FLOAT32_IEEE COMPU_METHOD__3 0 0 -1E+17 1E+17 ECU_ADDRESS 0xB000093C /begin FUNCTION_LIST fanDutyRight /end FUNCTION_LIST /end MEASUREMENT
/begin MEASUREMENT CTRL_coolantTempMotorInToRightLVDuty_LookupY_IN "Input for CTRL_coolantTempMotorInToRightLVDuty_LookupY" FLOAT32_IEEE COMPU_METHOD__3 0 0 -1E+17 1E+17 ECU_ADDRESS 0xB0000940 /begin FUNCTION_LIST fanDutyRight /end FUNCTION_LIST /end MEASUREMENT
/begin MEASUREMENT CTRL_coolantTempMotorInToWpDuty_LookupX_IN "Input for CTRL_coolantTempMotorInToWpDuty_LookupX" FLOAT32_IEEE COMPU_METHOD__3 0 0 -1E+17 1E+17 ECU_ADDRESS 0xB000096C /begin FUNCTION_LIST wpDuty /end FUNCTION_LIST /end MEASUREMENT
/begin MEASUREMENT CTRL_coolantTempMotorInToWpDuty_LookupY_IN "Input for CTRL_coolantTempMotorInToWpDuty_LookupY" FLOAT32_IEEE COMPU_METHOD__3 0 0 -1E+17 1E+17 ECU_ADDRESS 0xB0000970 /begin FUNCTION_LIST wpDuty /end FUNCTION_LIST /end MEASUREMENT
/begin MEASUREMENT CTRL_driveSpeed_mph "" FLOAT32_IEEE COMPU_METHOD__3 0 0 -1E+17 1E+17 ECU_ADDRESS 0xB000099C /begin FUNCTION_LIST driveSpeed /end FUNCTION_LIST /end MEASUREMENT
/begin MEASUREMENT CTRL_groundSpeed_mph "" FLOAT32_IEEE COMPU_METHOD__3 0 0 -1E+17 1E+17 ECU_ADDRESS 0xB00009A0 /begin FUNCTION_LIST groundSpeed /end FUNCTION_LIST /end MEASUREMENT
/begin MEASUREMENT CTRL_slipAim "" FLOAT32_IEEE COMPU_METHOD__3 0 0 -1E+17 1E+17 ECU_ADDRESS 0xB00008D0 /begin FUNCTION_LIST tractionControl_1_ /end FUNCTION_LIST /end MEASUREMENT
/begin MEASUREMENT CTRL_slipAimError "" FLOAT32_IEEE COMPU_METHOD__3 0 0 -1E+17 1E+17 ECU_ADDRESS 0xB00008D4 /begin FUNCTION_LIST tractionControl_1_ /end FUNCTION_LIST /end MEASUREMENT
/begin MEASUREMENT CTRL_slipRatio "" FLOAT32_IEEE COMPU_METHOD__3 0 0 -1E+17 1E+17 ECU_ADDRESS 0xB00009A4 /begin FUNCTION_LIST slipRatio /end FUNCTION_LIST /end MEASUREMENT
/begin MEASUREMENT CTRL_tcPowerReduction_pct "" FLOAT32_IEEE COMPU_METHOD__3 0 0 -1E+17 1E+17 ECU_ADDRESS 0xB00008D8 /begin FUNCTION_LIST tractionControl_1_ /end FUNCTION_LIST /end MEASUREMENT
/begin MEASUREMENT CTRL_throttleToNm_LookupX_IN "Input for CTRL_throttleToNm_LookupX" FLOAT32_IEEE COMPU_METHOD__3 0 0 -1E+17 1E+17 ECU_ADDRESS 0xB00008B4 /begin FUNCTION_LIST torqueCommand_1_ /end FUNCTION_LIST /end MEASUREMENT
/begin MEASUREMENT CTRL_torqueCommand_Nm "" FLOAT32_IEEE COMPU_METHOD__3 0 0 -1E+17 1E+17 ECU_ADDRESS 0xB00008BC /begin FUNCTION_LIST Override_1_ /end FUNCTION_LIST /end MEASUREMENT
/begin MEASUREMENT CTRL_yawRateToAimSlip_LookupX_IN "Input for CTRL_yawRateToAimSlip_LookupX" FLOAT32_IEEE COMPU_METHOD__3 0 0 -1E+17 1E+17 ECU_ADDRESS 0xB00008C4 /begin FUNCTION_LIST tractionControl_1_ /end FUNCTION_LIST /end MEASUREMENT
/begin MEASUREMENT CTRL_yawRateToAimSlip_LookupY_IN "Input for CTRL_yawRateToAimSlip_LookupY" FLOAT32_IEEE COMPU_METHOD__3 0 0 -1E+17 1E+17 ECU_ADDRESS 0xB00008C0 /begin FUNCTION_LIST tractionControl_1_ /end FUNCTION_LIST /end MEASUREMENT
/begin MEASUREMENT FgndTasksStopped "Boolean indicating foreground tasks stopped" UBYTE COMPU_METHOD__1 0 0 0 1 ECU_ADDRESS 0xB0000831 /begin FUNCTION_LIST PowerUp_Down /end FUNCTION_LIST /end MEASUREMENT
/begin MEASUREMENT IN_brakePressureF_psi "" FLOAT32_IEEE COMPU_METHOD__3 0 0 -1E+17 1E+17 ECU_ADDRESS 0xB00009DC /begin FUNCTION_LIST brakePressureF /end FUNCTION_LIST /end MEASUREMENT
/begin MEASUREMENT IN_brakePressureR_psi "" FLOAT32_IEEE COMPU_METHOD__3 0 0 -1E+17 1E+17 ECU_ADDRESS 0xB00009E0 /begin FUNCTION_LIST brakePressureR /end FUNCTION_LIST /end MEASUREMENT
/begin MEASUREMENT IN_bspdBrakeError_v "" FLOAT32_IEEE COMPU_METHOD__3 0 0 -1E+17 1E+17 ECU_ADDRESS 0xB00009E4 /begin FUNCTION_LIST bspdBrakeError /end FUNCTION_LIST /end MEASUREMENT
/begin MEASUREMENT IN_bspdStatusError_v "" FLOAT32_IEEE COMPU_METHOD__3 0 0 -1E+17 1E+17 ECU_ADDRESS 0xB00009E8 /begin FUNCTION_LIST bspdStatusError /end FUNCTION_LIST /end MEASUREMENT
/begin MEASUREMENT IN_coolantTempInverterIn_deg "" FLOAT32_IEEE COMPU_METHOD__3 0 0 -1E+17 1E+17 ECU_ADDRESS 0xB00009A8 /begin FUNCTION_LIST Override_5_ /end FUNCTION_LIST /end MEASUREMENT
/begin MEASUREMENT IN_coolantTempInverterOut_deg "" FLOAT32_IEEE COMPU_METHOD__3 0 0 -1E+17 1E+17 ECU_ADDRESS 0xB00009AC /begin FUNCTION_LIST Override_6_ /end FUNCTION_LIST /end MEASUREMENT
/begin MEASUREMENT IN_coolantTempMotorIn_deg "" FLOAT32_IEEE COMPU_METHOD__3 0 0 -1E+17 1E+17 ECU_ADDRESS 0xB00009B0 /begin FUNCTION_LIST Override_7_ /end FUNCTION_LIST /end MEASUREMENT
/begin MEASUREMENT IN_coolantTempVToDegInverterIn_LookupX_IN "Input for IN_coolantTempVToDegInverterIn_LookupX" FLOAT32_IEEE COMPU_METHOD__3 0 0 -1E+17 1E+17 ECU_ADDRESS 0xB00009CC /begin FUNCTION_LIST coolantTempInverterIn /end FUNCTION_LIST /end MEASUREMENT
/begin MEASUREMENT IN_coolantTempVToDegInverterOut_LookupX_IN "Input for IN_coolantTempVToDegInverterOut_LookupX" FLOAT32_IEEE COMPU_METHOD__3 0 0 -1E+17 1E+17 ECU_ADDRESS 0xB00009D4 /begin FUNCTION_LIST coolantTempInverterOut /end FUNCTION_LIST /end MEASUREMENT
/begin MEASUREMENT IN_coolantTempVToDegMotorIn_LookupX_IN "Input for IN_coolantTempVToDegMotorIn_LookupX" FLOAT32_IEEE COMPU_METHOD__3 0 0 -1E+17 1E+17 ECU_ADDRESS 0xB00009C4 /begin FUNCTION_LIST coolantTempMotorIn /end FUNCTION_LIST /end MEASUREMENT
/begin MEASUREMENT IN_rotorTempFL_deg "" FLOAT32_IEEE COMPU_METHOD__3 0 0 -1E+17 1E+17 ECU_ADDRESS 0xB00009F4 /begin FUNCTION_LIST Override_10_ /end FUNCTION_LIST /end MEASUREMENT
/begin MEASUREMENT IN_rotorTempFR_deg "" FLOAT32_IEEE COMPU_METHOD__3 0 0 -1E+17 1E+17 ECU_ADDRESS 0xB0000A0C /begin FUNCTION_LIST Override_12_ /end FUNCTION_LIST /end MEASUREMENT
/begin MEASUREMENT IN_rotorTempRL_deg "" FLOAT32_IEEE COMPU_METHOD__3 0 0 -1E+17 1E+17 ECU_ADDRESS 0xB0000A00 /begin FUNCTION_LIST Override_11_ /end FUNCTION_LIST /end MEASUREMENT
/begin MEASUREMENT IN_rotorTempRR_deg "" FLOAT32_IEEE COMPU_METHOD__3 0 0 -1E+17 1E+17 ECU_ADDRESS 0xB0000A18 /begin FUNCTION_LIST Override_13_ /end FUNCTION_LIST /end MEASUREMENT
/begin MEASUREMENT IN_rotorTempVToDegFL_LookupX_IN "Input for IN_rotorTempVToDegFL_LookupX" FLOAT32_IEEE COMPU_METHOD__3 0 0 -1E+17 1E+17 ECU_ADDRESS 0xB00009EC /begin FUNCTION_LIST rotorTemp_1_ /end FUNCTION_LIST /end MEASUREMENT
/begin MEASUREMENT IN_rotorTempVToDegFR_LookupX_IN "Input for IN_rotorTempVToDegFR_LookupX" FLOAT32_IEEE COMPU_METHOD__3 0 0 -1E+17 1E+17 ECU_ADDRESS 0xB0000A04 /begin FUNCTION_LIST rotorTemp2 /end FUNCTION_LIST /end MEASUREMENT
/begin MEASUREMENT IN_rotorTempVToDegRL_LookupX_IN "Input for IN_rotorTempVToDegRL_LookupX" FLOAT32_IEEE COMPU_METHOD__3 0 0 -1E+17 1E+17 ECU_ADDRESS 0xB00009F8 /begin FUNCTION_LIST rotorTemp1 /end FUNCTION_LIST /end MEASUREMENT
/begin MEASUREMENT IN_rotorTempVToDegRR_LookupX_IN "Input for IN_rotorTempVToDegRR_LookupX" FLOAT32_IEEE COMPU_METHOD__3 0 0 -1E+17 1E+17 ECU_ADDRESS 0xB0000A10 /begin FUNCTION_LIST rotorTemp3 /end FUNCTION_LIST /end MEASUREMENT
/begin MEASUREMENT IN_startSwitchSig_v "" UWORD COMPU_METHOD__5 0 0 0 65535 ECU_ADDRESS 0xB0000A1C /begin FUNCTION_LIST Subsystem /end FUNCTION_LIST /end MEASUREMENT
/begin MEASUREMENT IN_tcSetInput "" FLOAT32_IEEE COMPU_METHOD__3 0 0 -1E+17 1E+17 ECU_ADDRESS 0xB0000A20 /begin FUNCTION_LIST tcDial_1_ /end FUNCTION_LIST /end MEASUREMENT
/begin MEASUREMENT IN_tcSetTable_LookupX_IN "Input for IN_tcSetTable_LookupX" FLOAT32_IEEE COMPU_METHOD__3 0 0 -1E+17 1E+17 ECU_ADDRESS 0xB00009BC /begin FUNCTION_LIST tcDial_1_ /end FUNCTION_LIST /end MEASUREMENT
/begin MEASUREMENT IN_throttleOverride1_pct "" FLOAT32_IEEE COMPU_METHOD__3 0 0 -1E+17 1E+17 ECU_ADDRESS 0xB00009B4 /begin FUNCTION_LIST Override_8_ /end FUNCTION_LIST /end MEASUREMENT
/begin MEASUREMENT IN_throttleOverride2_pct "" FLOAT32_IEEE COMPU_METHOD__3 0 0 -1E+17 1E+17 ECU_ADDRESS 0xB00009B8 /begin FUNCTION_LIST Override_9_ /end FUNCTION_LIST /end MEASUREMENT
/begin MEASUREMENT IN_throttlePos1_deg "" FLOAT32_IEEE COMPU_METHOD__3 0 0 -1E+17 1E+17 ECU_ADDRESS 0xB0000A24 /begin FUNCTION_LIST throttle1Input /end FUNCTION_LIST /end MEASUREMENT
/begin MEASUREMENT IN_throttlePos2_deg "" FLOAT32_IEEE COMPU_METHOD__3 0 0 -1E+17 1E+17 ECU_ADDRESS 0xB0000A28 /begin FUNCTION_LIST throttle2Input /end FUNCTION_LIST /end MEASUREMENT
/begin MEASUREMENT IN_tireTempFLI_deg "" FLOAT32_IEEE COMPU_METHOD__3 0 0 -1E+17 1E+17 ECU_ADDRESS 0xB0000A34 /begin FUNCTION_LIST Override_14_ /end FUNCTION_LIST /end MEASUREMENT
/begin MEASUREMENT IN_tireTempFLM_deg "" FLOAT32_IEEE COMPU_METHOD__3 0 0 -1E+17 1E+17 ECU_ADDRESS 0xB0000A40 /begin FUNCTION_LIST Override_15_ /end FUNCTION_LIST /end MEASUREMENT
/begin MEASUREMENT IN_tireTempFLO_deg "" FLOAT32_IEEE COMPU_METHOD__3 0 0 -1E+17 1E+17 ECU_ADDRESS 0xB0000A4C /begin FUNCTION_LIST Override_16_ /end FUNCTION_LIST /end MEASUREMENT
/begin MEASUREMENT IN_tireTempFRI_deg "" FLOAT32_IEEE COMPU_METHOD__3 0 0 -1E+17 1E+17 ECU_ADDRESS 0xB0000A58 /begin FUNCTION_LIST Override_17_ /end FUNCTION_LIST /end MEASUREMENT
/begin MEASUREMENT IN_tireTempFRM_deg "" FLOAT32_IEEE COMPU_METHOD__3 0 0 -1E+17 1E+17 ECU_ADDRESS 0xB0000A64 /begin FUNCTION_LIST Override_18_ /end FUNCTION_LIST /end MEASUREMENT
/begin MEASUREMENT IN_tireTempFRO_deg "" FLOAT32_IEEE COMPU_METHOD__3 0 0 -1E+17 1E+17 ECU_ADDRESS 0xB0000A70 /begin FUNCTION_LIST Override_19_ /end FUNCTION_LIST /end MEASUREMENT
/begin MEASUREMENT IN_tireTempRLI_deg "" FLOAT32_IEEE COMPU_METHOD__3 0 0 -1E+17 1E+17 ECU_ADDRESS 0xB0000A7C /begin FUNCTION_LIST Override_20_ /end FUNCTION_LIST /end MEASUREMENT
/begin MEASUREMENT IN_tireTempVToDegFLI_LookupX_IN "Input for IN_tireTempVToDegFLI_LookupX" FLOAT32_IEEE COMPU_METHOD__3 0 0 -1E+17 1E+17 ECU_ADDRESS 0xB0000A2C /begin FUNCTION_LIST tireTempFLI /end FUNCTION_LIST /end MEASUREMENT
/begin MEASUREMENT IN_tireTempVToDegFLM_LookupX_IN "Input for IN_tireTempVToDegFLM_LookupX" FLOAT32_IEEE COMPU_METHOD__3 0 0 -1E+17 1E+17 ECU_ADDRESS 0xB0000A38 /begin FUNCTION_LIST tireTempFLM /end FUNCTION_LIST /end MEASUREMENT
/begin MEASUREMENT IN_tireTempVToDegFLO_LookupX_IN "Input for IN_tireTempVToDegFLO_LookupX" FLOAT32_IEEE COMPU_METHOD__3 0 0 -1E+17 1E+17 ECU_ADDRESS 0xB0000A44 /begin FUNCTION_LIST tireTempFLO /end FUNCTION_LIST /end MEASUREMENT
/begin MEASUREMENT IN_tireTempVToDegFRI_LookupX_IN "Input for IN_tireTempVToDegFRI_LookupX" FLOAT32_IEEE COMPU_METHOD__3 0 0 -1E+17 1E+17 ECU_ADDRESS 0xB0000A50 /begin FUNCTION_LIST tireTempFRI /end FUNCTION_LIST /end MEASUREMENT
/begin MEASUREMENT IN_tireTempVToDegFRM_LookupX_IN "Input for IN_tireTempVToDegFRM_LookupX" FLOAT32_IEEE COMPU_METHOD__3 0 0 -1E+17 1E+17 ECU_ADDRESS 0xB0000A5C /begin FUNCTION_LIST tireTempFRM /end FUNCTION_LIST /end MEASUREMENT
/begin MEASUREMENT IN_tireTempVToDegFRO_LookupX_IN "Input for IN_tireTempVToDegFRO_LookupX" FLOAT32_IEEE COMPU_METHOD__3 0 0 -1E+17 1E+17 ECU_ADDRESS 0xB0000A68 /begin FUNCTION_LIST tireTempFRO /end FUNCTION_LIST /end MEASUREMENT
/begin MEASUREMENT IN_tireTempVToDegRLI_LookupX_IN "Input for IN_tireTempVToDegRLI_LookupX" FLOAT32_IEEE COMPU_METHOD__3 0 0 -1E+17 1E+17 ECU_ADDRESS 0xB0000A74 /begin FUNCTION_LIST tireTempRLI /end FUNCTION_LIST /end MEASUREMENT
/begin MEASUREMENT KeepModuleOn "Boolean indicating module to be kept on" UBYTE COMPU_METHOD__1 0 0 0 1 ECU_ADDRESS 0xB0000833 /begin FUNCTION_LIST PowerUp_Down /end FUNCTION_LIST /end MEASUREMENT
/begin MEASUREMENT KeySw_Bgnd "Key switch reading from background task" UBYTE COMPU_METHOD__1 0 0 0 1 ECU_ADDRESS 0xB0000832 /begin FUNCTION_LIST PowerUp_Down /end FUNCTION_LIST /end MEASUREMENT
/begin CHARACTERISTIC CTRL_brakelight_bool "" VALUE 0x80038738 RECORD_LAYOUT__3 0 COMPU_METHOD__5 0 1 /begin FUNCTION_LIST brakelight_1_ /end FUNCTION_LIST /end CHARACTERISTIC
/begin CHARACTERISTIC CTRL_brakelight_bool_OvrSts "Controls status of value override." VALUE 0x80038032 RECORD_LAYOUT__3 0 COMPU_METHOD__6 0 255 /begin FUNCTION_LIST Override /end FUNCTION_LIST /end CHARACTERISTIC
/begin CHARACTERISTIC CTRL_brakelight_bool_OvrVal "" VALUE 0x80038031 RECORD_LAYOUT__3 0 COMPU_METHOD__5 0 1 /begin FUNCTION_LIST Override /end FUNCTION_LIST /end CHARACTERISTIC
/begin CHARACTERISTIC CTRL_bspcBrakeThresh_pct "" VALUE 0x8003A4B8 RECORD_LAYOUT__1 0 COMPU_METHOD__3 -1E+17 1E+17 /begin FUNCTION_LIST bspc /end FUNCTION_LIST /end CHARACTERISTIC
/begin CHARACTERISTIC CTRL_bspcThrottleThresh_pct "" VALUE 0x8003A4A0 RECORD_LAYOUT__1 0 COMPU_METHOD__3 -1E+17 1E+17 /begin FUNCTION_LIST bspc /end FUNCTION_LIST /end CHARACTERISTIC
/begin CHARACTERISTIC CTRL_bspcTorqueOverride_Nm "" VALUE 0x80038740 RECORD_LAYOUT__1 0 COMPU_METHOD__3 -1E+17 1E+17 /begin FUNCTION_LIST torqueCommand_1_ /end FUNCTION_LIST /end CHARACTERISTIC
/begin CHARACTERISTIC CTRL_cellSegment1TempToHVDuty "" CURVE 0x80038704 RECORD_LAYOUT__1 0 COMPU_METHOD__3 -1E+17 1E+17
 /begin AXIS_DESCR COM_AXIS CTRL_cellSegment1TempToHVDuty_LookupX_IN COMPU_METHOD__4 11 -1E+17 1E+17 AXIS_PTS_REF CTRL_cellSegment1TempToHVDuty_LookupX /end AXIS_DESCR
 /begin FUNCTION_LIST accFanDuty /end FUNCTION_LIST
/end CHARACTERISTIC
/begin CHARACTERISTIC CTRL_cellSegment1TempToLVDuty "" CURVE 0x800386AC RECORD_LAYOUT__1 0 COMPU_METHOD__3 -1E+17 1E+17
 /begin AXIS_DESCR COM_AXIS CTRL_cellSegment1TempToLVDuty_LookupX_IN COMPU_METHOD__4 11 -1E+17 1E+17 AXIS_PTS_REF CTRL_cellSegment1TempToLVDuty_LookupX /end AXIS_DESCR
 /begin FUNCTION_LIST accFanDuty /end FUNCTION_LIST
/end CHARACTERISTIC
/begin CHARACTERISTIC CTRL_cellSegment2TempToHVDuty "" CURVE 0x800384DC RECORD_LAYOUT__1 0 COMPU_METHOD__3 -1E+17 1E+17
 /begin AXIS_DESCR COM_AXIS CTRL_cellSegment2TempToHVDuty_LookupX_IN COMPU_METHOD__4 11 -1E+17 1E+17 AXIS_PTS_REF CTRL_cellSegment2TempToHVDuty_LookupX /end AXIS_DESCR
 /begin FUNCTION_LIST accFanDuty4 /end FUNCTION_LIST
/end CHARACTERISTIC
/begin CHARACTERISTIC CTRL_cellSegment2TempToLVDuty "" CURVE 0x80038484 RECORD_LAYOUT__1 0 COMPU_METHOD__3 -1E+17 1E+17
 /begin AXIS_DESCR COM_AXIS CTRL_cellSegment2TempToLVDuty_LookupX_IN COMPU_METHOD__4 11 -1E+17 1E+17 AXIS_PTS_REF CTRL_cellSegment2TempToLVDuty_LookupX /end AXIS_DESCR
 /begin FUNCTION_LIST accFanDuty4 /end FUNCTION_LIST
/end CHARACTERISTIC
/begin CHARACTERISTIC CTRL_cellSegment3TempToHVDuty "" CURVE 0x8003864C RECORD_LAYOUT__1 0 COMPU_METHOD__3 -1E+17 1E+17
 /begin AXIS_DESCR COM_AXIS CTRL_cellSegment3TempToHVDuty_LookupX_IN COMPU_METHOD__4 11 -1E+17 1E+17 AXIS_PTS_REF CTRL_cellSegment3TempToHVDuty_LookupX /end AXIS_DESCR
 /begin FUNCTION_LIST accFanDuty1 /end FUNCTION_LIST
/end CHARACTERISTIC
/begin CHARACTERISTIC CTRL_cellSegment3TempToLVDuty "" CURVE 0x800385F4 RECORD_LAYOUT__1 0 COMPU_METHOD__3 -1E+17 1E+17
 /begin AXIS_DESCR COM_AXIS CTRL_cellSegment3TempToLVDuty_LookupX_IN COMPU_METHOD__4 11 -1E+17 1E+17 AXIS_PTS_REF CTRL_cellSegment3TempToLVDuty_LookupX /end AXIS_DESCR
 /begin FUNCTION_LIST accFanDuty1 /end FUNCTION_LIST
/end CHARACTERISTIC
/begin CHARACTERISTIC CTRL_cellSegment4TempToHVDuty "" CURVE 0x80038424 RECORD_LAYOUT__1 0 COMPU_METHOD__3 -1E+17 1E+17
 /begin AXIS_DESCR COM_AXIS CTRL_cellSegment4TempToHVDuty_LookupX_IN COMPU_METHOD__4 11 -1E+17 1E+17 AXIS_PTS_REF CTRL_cellSegment4TempToHVDuty_LookupX /end AXIS_DESCR
 /begin FUNCTION_LIST accFanDuty5 /end FUNCTION_LIST
/end CHARACTERISTIC
/begin CHARACTERISTIC CTRL_cellSegment4TempToLVDuty "" CURVE 0x800383CC RECORD_LAYOUT__1 0 COMPU_METHOD__3 -1E+17 1E+17
 /begin AXIS_DESCR COM_AXIS CTRL_cellSegment4TempToLVDuty_LookupX_IN COMPU_METHOD__4 11 -1E+17 1E+17 AXIS_PTS_REF CTRL_cellSegment4TempToLVDuty_LookupX /end AXIS_DESCR
 /begin FUNCTION_LIST accFanDuty5 /end FUNCTION_LIST
/end CHARACTERISTIC
/begin CHARACTERISTIC CTRL_cellSegment5TempToHVDuty "" CURVE 0x80038594 RECORD_LAYOUT__1 0 COMPU_METHOD__3 -1E+17 1E+17
 /begin AXIS_DESCR COM_AXIS CTRL_cellSegment5TempToHVDuty_LookupX_IN COMPU_METHOD__4 11 -1E+17 1E+17 AXIS_PTS_REF CTRL_cellSegment5TempToHVDuty_LookupX /end AXIS_DESCR
 /begin FUNCTION_LIST accFanDuty2 /end FUNCTION_LIST
/end CHARACTERISTIC
/begin CHARACTERISTIC CTRL_cellSegment5TempToLVDuty "" CURVE 0x8003853C RECORD_LAYOUT__1 0 COMPU_METHOD__3 -1E+17 1E+17
 /begin AXIS_DESCR COM_AXIS CTRL_cellSegment5TempToLVDuty_LookupX_IN COMPU_METHOD__4 11 -1E+17 1E+17 AXIS_PTS_REF CTRL_cellSegment5TempToLVDuty_LookupX /end AXIS_DESCR
 /begin FUNCTION_LIST accFanDuty2 /end FUNCTION_LIST
/end CHARACTERISTIC
/begin CHARACTERISTIC CTRL_cellSegment6TempToHVDuty "" CURVE 0x8003836C RECORD_LAYOUT__1 0 COMPU_METHOD__3 -1E+17 1E+17
 /begin AXIS_DESCR COM_AXIS CTRL_cellSegment6TempToHVDuty_LookupX_IN COMPU_METHOD__4 11 -1E+17 1E+17 AXIS_PTS_REF CTRL_cellSegment6TempToHVDuty_LookupX /end AXIS_DESCR
 /begin FUNCTION_LIST accFanDuty6 /end FUNCTION_LIST
/end CHARACTERISTIC
/begin CHARACTERISTIC CTRL_cellSegment6TempToLVDuty "" CURVE 0x80038314 RECORD_LAYOUT__1 0 COMPU_METHOD__3 -1E+17 1E+17
 /begin AXIS_DESCR COM_AXIS CTRL_cellSegment6TempToLVDuty_LookupX_IN COMPU_METHOD__4 11 -1E+17 1E+17 AXIS_PTS_REF CTRL_cellSegment6TempToLVDuty_LookupX /end AXIS_DESCR
 /begin FUNCTION_LIST accFanDuty6 /end FUNCTION_LIST
/end CHARACTERISTIC
/begin CHARACTERISTIC CTRL_cellSegment7TempToHVDuty "" CURVE 0x800381FC RECORD_LAYOUT__1 0 COMPU_METHOD__3 -1E+17 1E+17
 /begin AXIS_DESCR COM_AXIS CTRL_cellSegment7TempToHVDuty_LookupX_IN COMPU_METHOD__4 11 -1E+17 1E+17 AXIS_PTS_REF CTRL_cellSegment7TempToHVDuty_LookupX /end AXIS_DESCR
 /begin FUNCTION_LIST accFanDuty3 /end FUNCTION_LIST
/end CHARACTERISTIC
/begin CHARACTERISTIC CTRL_cellSegment7TempToLVDuty "" CURVE 0x800381A4 RECORD_LAYOUT__1 0 COMPU_METHOD__3 -1E+17 1E+17
 /begin AXIS_DESCR COM_AXIS CTRL_cellSegment7TempToLVDuty_LookupX_IN COMPU_METHOD__4 11 -1E+17 1E+17 AXIS_PTS_REF CTRL_cellSegment7TempToLVDuty_LookupX /end AXIS_DESCR
 /begin FUNCTION_LIST accFanDuty3 /end FUNCTION_LIST
/end CHARACTERISTIC
/begin CHARACTERISTIC CTRL_cellSegment8TempToHVDuty "" CURVE 0x800382B4 RECORD_LAYOUT__1 0 COMPU_METHOD__3 -1E+17 1E+17
 /begin AXIS_DESCR COM_AXIS CTRL_cellSegment8TempToHVDuty_LookupX_IN COMPU_METHOD__4 11 -1E+17 1E+17 AXIS_PTS_REF CTRL_cellSegment8TempToHVDuty_LookupX /end AXIS_DESCR
 /begin FUNCTION_LIST accFanDuty7 /end FUNCTION_LIST
/end CHARACTERISTIC
/begin CHARACTERISTIC CTRL_cellSegment8TempToLVDuty "" CURVE 0x8003825C RECORD_LAYOUT__1 0 COMPU_METHOD__3 -1E+17 1E+17
 /begin AXIS_DESCR COM_AXIS CTRL_cellSegment8TempToLVDuty_LookupX_IN COMPU_METHOD__4 11 -1E+17 1E+17 AXIS_PTS_REF CTRL_cellSegment8TempToLVDuty_LookupX /end AXIS_DESCR
 /begin FUNCTION_LIST accFanDuty7 /end FUNCTION_LIST
/end CHARACTERISTIC
/begin CHARACTERISTIC CTRL_coolantTempInverterInToLeftHVDuty "" CURVE 0x80038CE0 RECORD_LAYOUT__1 0 COMPU_METHOD__3 -1E+17 1E+17
 /begin AXIS_DESCR COM_AXIS CTRL_coolantTempInverterInToLeftHVDuty_LookupX_IN COMPU_METHOD__4 11 -1E+17 1E+17 AXIS_PTS_REF CTRL_coolantTempInverterInToLeftHVDuty_LookupX /end AXIS_DESCR
 /begin FUNCTION_LIST fanDutyLeft /end FUNCTION_LIST
/end CHARACTERISTIC
/begin CHARACTERISTIC CTRL_coolantTempInverterInToLeftLVDuty "" MAP 0x80039094 RECORD_LAYOUT__4 0 COMPU_METHOD__3 -1E+17 1E+17
 /begin AXIS_DESCR COM_AXIS CTRL_coolantTempInverterInToLeftLVDuty_LookupX_IN COMPU_METHOD__11 14 -1E+17 1E+17 AXIS_PTS_REF CTRL_coolantTempInverterInToLeftLVDuty_LookupX /end AXIS_DESCR
 /begin AXIS_DESCR COM_AXIS CTRL_coolantTempInverterInToLeftLVDuty_LookupY_IN COMPU_METHOD__4 11 -1E+17 1E+17 AXIS_PTS_REF CTRL_coolantTempInverterInToLeftLVDuty_LookupY /end AXIS_DESCR
 /begin FUNCTION_LIST fanDutyLeft /end FUNCTION_LIST
/end CHARACTERISTIC
/begin CHARACTERISTIC CTRL_coolantTempInverterInToRightHVDuty "" CURVE 0x80039664 RECORD_LAYOUT__1 0 COMPU_METHOD__3 -1E+17 1E+17
 /begin AXIS_DESCR COM_AXIS CTRL_coolantTempInverterInToRightHVDuty_LookupX_IN COMPU_METHOD__4 11 -1E+17 1E+17 AXIS_PTS_REF CTRL_coolantTempInverterInToRightHVDuty_LookupX /end AXIS_DESCR
 /begin FUNCTION_LIST fanDutyRight /end FUNCTION_LIST
/end CHARACTERISTIC
/begin CHARACTERISTIC CTRL_coolantTempInverterInToRightLVDuty "" MAP 0x80039A18 RECORD_LAYOUT__4 0 COMPU_METHOD__3 -1E+17 1E+17
 /begin AXIS_DESCR COM_AXIS CTRL_coolantTempInverterInToRightLVDuty_LookupX_IN COMPU_METHOD__11 14 -1E+17 1E+17 AXIS_PTS_REF CTRL_coolantTempInverterInToRightLVDuty_LookupX /end AXIS_DESCR
 /begin AXIS_DESCR COM_AXIS CTRL_coolantTempInverterInToRightLVDuty_LookupY_IN COMPU_METHOD__4 11 -1E+17 1E+17 AXIS_PTS_REF CTRL_coolantTempInverterInToRightLVDuty_LookupY /end AXIS_DESCR
 /begin FUNCTION_LIST fanDutyRight /end FUNCTION_LIST
/end CHARACTERISTIC
/begin CHARACTERISTIC CTRL_coolantTempInverterInToWpDuty "" MAP 0x8003A150 RECORD_LAYOUT__4 0 COMPU_METHOD__3 -1E+17 1E+17
 /begin AXIS_DESCR COM_AXIS CTRL_coolantTempInverterInToWpDuty_LookupX_IN COMPU_METHOD__12 8 -1E+17 1E+17 AXIS_PTS_REF CTRL_coolantTempInverterInToWpDuty_LookupX /end AXIS_DESCR
 /begin AXIS_DESCR COM_AXIS CTRL_coolantTempInverterInToWpDuty_LookupY_IN COMPU_METHOD__4 11 -1E+17 1E+17 AXIS_PTS_REF CTRL_coolantTempInverterInToWpDuty_LookupY /end AXIS_DESCR
 /begin FUNCTION_LIST wpDuty /end FUNCTION_LIST
/end CHARACTERISTIC
/begin CHARACTERISTIC CTRL_coolantTempInverterOutToLeftHVDuty "" CURVE 0x80038D38 RECORD_LAYOUT__1 0 COMPU_METHOD__3 -1E+17 1E+17
 /begin AXIS_DESCR COM_AXIS CTRL_coolantTempInverterOutToLeftHVDuty_LookupX_IN COMPU_METHOD__4 11 -1E+17 1E+17 AXIS_PTS_REF CTRL_coolantTempInverterOutToLeftHVDuty_LookupX /end AXIS_DESCR
 /begin FUNCTION_LIST fanDutyLeft /end FUNCTION_LIST
/end CHARACTERISTIC
/begin CHARACTERISTIC CTRL_coolantTempInverterOutToLeftLVDuty "" MAP 0x80039360 RECORD_LAYOUT__4 0 COMPU_METHOD__3 -1E+17 1E+17
 /begin AXIS_DESCR COM_AXIS CTRL_coolantTempInverterOutToLeftLVDuty_LookupX_IN COMPU_METHOD__11 14 -1E+17 1E+17 AXIS_PTS_REF CTRL_coolantTempInverterOutToLeftLVDuty_LookupX /end AXIS_DESCR
 /begin AXIS_DESCR COM_AXIS CTRL_coolantTempInverterOutToLeftLVDuty_LookupY_IN COMPU_METHOD__4 11 -1E+17 1E+17 AXIS_PTS_REF CTRL_coolantTempInverterOutToLeftLVDuty_LookupY /end AXIS_DESCR
 /begin FUNCTION_LIST fanDutyLeft /end FUNCTION_LIST
/end CHARACTERISTIC
/begin CHARACTERISTIC CTRL_coolantTempInverterOutToRightHVDuty "" CURVE 0x800396BC RECORD_LAYOUT__1 0 COMPU_METHOD__3 -1E+17 1E+17
 /begin AXIS_DESCR COM_AXIS CTRL_coolantTempInverterOutToRightHVDuty_LookupX_IN COMPU_METHOD__4 11 -1E+17 1E+17 AXIS_PTS_REF CTRL_coolantTempInverterOutToRightHVDuty_LookupX /end AXIS_DESCR
 /begin FUNCTION_LIST fanDutyRight /end FUNCTION_LIST
/end CHARACTERISTIC
/begin CHARACTERISTIC CTRL_coolantTempInverterOutToRightLVDuty "" MAP 0x80039CE4 RECORD_LAYOUT__4 0 COMPU_METHOD__3 -1E+17 1E+17
 /begin AXIS_DESCR COM_AXIS CTRL_coolantTempInverterOutToRightLVDuty_LookupX_IN COMPU_METHOD__11 14 -1E+17 1E+17 AXIS_PTS_REF CTRL_coolantTempInverterOutToRightLVDuty_LookupX /end AXIS_DESCR
 /begin AXIS_DESCR COM_AXIS CTRL_coolantTempInverterOutToRightLVDuty_LookupY_IN COMPU_METHOD__4 11 -1E+17 1E+17 AXIS_PTS_REF CTRL_coolantTempInverterOutToRightLVDuty_LookupY /end AXIS_DESCR
 /begin FUNCTION_LIST fanDutyRight /end FUNCTION_LIST
/end CHARACTERISTIC
/begin CHARACTERISTIC CTRL_coolantTempInverterOutToWpDuty "" MAP 0x8003A2FC RECORD_LAYOUT__4 0 COMPU_METHOD__3 -1E+17 1E+17
 /begin AXIS_DESCR COM_AXIS CTRL_coolantTempInverterOutToWpDuty_LookupX_IN COMPU_METHOD__12 8 -1E+17 1E+17 AXIS_PTS_REF CTRL_coolantTempInverterOutToWpDuty_LookupX /end AXIS_DESCR
 /begin AXIS_DESCR COM_AXIS CTRL_coolantTempInverterOutToWpDuty_LookupY_IN COMPU_METHOD__4 11 -1E+17 1E+17 AXIS_PTS_REF CTRL_coolantTempInverterOutToWpDuty_LookupY /end AXIS_DESCR
 /begin FUNCTION_LIST wpDuty /end FUNCTION_LIST
/end CHARACTERISTIC
/begin CHARACTERISTIC CTRL_coolantTempMotorInToLeftHVDuty "" CURVE 0x80038C88 RECORD_LAYOUT__1 0 COMPU_METHOD__3 -1E+17 1E+17
 /begin AXIS_DESCR COM_AXIS CTRL_coolantTempMotorInToLeftHVDuty_LookupX_IN COMPU_METHOD__4 11 -1E+17 1E+17 AXIS_PTS_REF CTRL_coolantTempMotorInToLeftHVDuty_LookupX /end AXIS_DESCR
 /begin FUNCTION_LIST fanDutyLeft /end FUNCTION_LIST
/end CHARACTERISTIC
/begin CHARACTERISTIC CTRL_coolantTempMotorInToLeftLVDuty "" MAP 0x80038DC8 RECORD_LAYOUT__4 0 COMPU_METHOD__3 -1E+17 1E+17
 /begin AXIS_DESCR COM_AXIS CTRL_coolantTempMotorInToLeftLVDuty_LookupX_IN COMPU_METHOD__11 14 -1E+17 1E+17 AXIS_PTS_REF CTRL_coolantTempMotorInToLeftLVDuty_LookupX /end AXIS_DESCR
 /begin AXIS_DESCR COM_AXIS CTRL_coolantTempMotorInToLeftLVDuty_LookupY_IN COMPU_METHOD__4 11 -1E+17 1E+17 AXIS_PTS_REF CTRL_coolantTempMotorInToLeftLVDuty_LookupY /end AXIS_DESCR
 /begin FUNCTION_LIST fanDutyLeft /end FUNCTION_LIST
/end CHARACTERISTIC
/begin CHARACTERISTIC CTRL_coolantTempMotorInToRightHVDuty "" CURVE 0x8003960C RECORD_LAYOUT__1 0 COMPU_METHOD__3 -1E+17 1E+17
 /begin AXIS_DESCR COM_AXIS CTRL_coolantTempMotorInToRightHVDuty_LookupX_IN COMPU_METHOD__4 11 -1E+17 1E+17 AXIS_PTS_REF CTRL_coolantTempMotorInToRightHVDuty_LookupX /end AXIS_DESCR
 /begin FUNCTION_LIST fanDutyRight /end FUNCTION_LIST
/end CHARACTERISTIC
/begin CHARACTERISTIC CTRL_coolantTempMotorInToRightLVDuty "" MAP 0x8003974C RECORD_LAYOUT__4 0 COMPU_METHOD__3 -1E+17 1E+17
 /begin AXIS_DESCR COM_AXIS CTRL_coolantTempMotorInToRightLVDuty_LookupX_IN COMPU_METHOD__11 14 -1E+17 1E+17 AXIS_PTS_REF CTRL_coolantTempMotorInToRightLVDuty_LookupX /end AXIS_DESCR
 /begin AXIS_DESCR COM_AXIS CTRL_coolantTempMotorInToRightLVDuty_LookupY_IN COMPU_METHOD__4 11 -1E+17 1E+17 AXIS_PTS_REF CTRL_coolantTempMotorInToRightLVDuty_LookupY /end AXIS_DESCR
 /begin FUNCTION_LIST fanDutyRight /end FUNCTION_LIST
/end CHARACTERISTIC
/begin CHARACTERISTIC CTRL_coolantTempMotorInToWpDuty "" MAP 0x80039FA4 RECORD_LAYOUT__4 0 COMPU_METHOD__3 -1E+17 1E+17
 /begin AXIS_DESCR COM_AXIS CTRL_coolantTempMotorInToWpDuty_LookupX_IN COMPU_METHOD__12 8 -1E+17 1E+17 AXIS_PTS_REF CTRL_coolantTempMotorInToWpDuty_LookupX /end AXIS_DESCR
 /begin AXIS_DESCR COM_AXIS CTRL_coolantTempMotorInToWpDuty_LookupY_IN COMPU_METHOD__4 11 -1E+17 1E+17 AXIS_PTS_REF CTRL_coolantTempMotorInToWpDuty_LookupY /end AXIS_DESCR
 /begin FUNCTION_LIST wpDuty /end FUNCTION_LIST
/end CHARACTERISTIC
/begin CHARACTERISTIC CTRL_dbzBrakeBias "" VALUE 0x80038734 RECORD_LAYOUT__1 0 COMPU_METHOD__3 -1E+17 1E+17 /begin FUNCTION_LIST brakeBias_1_ /end FUNCTION_LIST /end CHARACTERISTIC
/begin CHARACTERISTIC CTRL_slipConstant "" VALUE 0x8003A460 RECORD_LAYOUT__1 0 COMPU_METHOD__3 -1E+17 1E+17 /begin FUNCTION_LIST slipRatio /end FUNCTION_LIST /end CHARACTERISTIC
/begin CHARACTERISTIC CTRL_slipRatioUpperThresh "" VALUE 0x8003A45C RECORD_LAYOUT__1 0 COMPU_METHOD__3 -1E+17 1E+17 /begin FUNCTION_LIST slipRatio /end FUNCTION_LIST /end CHARACTERISTIC
/begin CHARACTERISTIC CTRL_tcOverride_bool "" VALUE 0x800389D0 RECORD_LAYOUT__1 0 COMPU_METHOD__3 -1E+17 1E+17 /begin FUNCTION_LIST tractionControl_1_ /end FUNCTION_LIST /end CHARACTERISTIC
/begin CHARACTERISTIC CTRL_throttleToNm "" CURVE 0x80038888 RECORD_LAYOUT__1 0 COMPU_METHOD__8 -1E+17 1E+17
 /begin AXIS_DESCR COM_AXIS CTRL_throttleToNm_LookupX_IN COMPU_METHOD__7 81 -1E+17 1E+17 AXIS_PTS_REF CTRL_throttleToNm_LookupX /end AXIS_DESCR
 /begin FUNCTION_LIST torqueCommand_1_ /end FUNCTION_LIST
/end CHARACTERISTIC
/begin CHARACTERISTIC CTRL_torqueCommand_Nm_OvrSts "Controls status of value override." VALUE 0x80038038 RECORD_LAYOUT__3 0 COMPU_METHOD__6 0 255 /begin FUNCTION_LIST Override_1_ /end FUNCTION_LIST /end CHARACTERISTIC
/begin CHARACTERISTIC CTRL_torqueCommand_Nm_OvrVal "" VALUE 0x80038034 RECORD_LAYOUT__1 0 COMPU_METHOD__3 -1E+17 1E+17 /begin FUNCTION_LIST Override_1_ /end FUNCTION_LIST /end CHARACTERISTIC
/begin CHARACTERISTIC CTRL_torqueCommandOverride_bool "" VALUE 0x800389CC RECORD_LAYOUT__1 0 COMPU_METHOD__3 -1E+17 1E+17 /begin FUNCTION_LIST torqueCommand_1_ /end FUNCTION_LIST /end CHARACTERISTIC
/begin CHARACTERISTIC CTRL_upperThreshBrakeBias "" VALUE 0x80038730 RECORD_LAYOUT__1 0 COMPU_METHOD__3 -1E+17 1E+17 /begin FUNCTION_LIST brakeBias_1_ /end FUNCTION_LIST /end CHARACTERISTIC
/begin CHARACTERISTIC CTRL_upperThreshBrakelight "" VALUE 0x8003873C RECORD_LAYOUT__1 0 COMPU_METHOD__3 -1E+17 1E+17 /begin FUNCTION_LIST brakelight_1_ /end FUNCTION_LIST /end CHARACTERISTIC
/begin CHARACTERISTIC CTRL_upperThreshCellSeg1HV "" VALUE 0x8003867C RECORD_LAYOUT__1 0 COMPU_METHOD__3 -1E+17 1E+17 /begin FUNCTION_LIST accFanDuty /end FUNCTION_LIST /end CHARACTERISTIC
/begin CHARACTERISTIC CTRL_upperThreshCellSeg1LV "" VALUE 0x80038678 RECORD_LAYOUT__1 0 COMPU_METHOD__3 -1E+17 1E+17 /begin FUNCTION_LIST accFanDuty /end FUNCTION_LIST /end CHARACTERISTIC
/begin CHARACTERISTIC CTRL_upperThreshCellSeg2HV "" VALUE 0x80038454 RECORD_LAYOUT__1 0 COMPU_METHOD__3 -1E+17 1E+17 /begin FUNCTION_LIST accFanDuty4 /end FUNCTION_LIST /end CHARACTERISTIC
/begin CHARACTERISTIC CTRL_upperThreshCellSeg2LV "" VALUE 0x80038450 RECORD_LAYOUT__1 0 COMPU_METHOD__3 -1E+17 1E+17 /begin FUNCTION_LIST accFanDuty4 /end FUNCTION_LIST /end CHARACTERISTIC
/begin CHARACTERISTIC CTRL_upperThreshCellSeg3HV "" VALUE 0x800385C4 RECORD_LAYOUT__1 0 COMPU_METHOD__3 -1E+17 1E+17 /begin FUNCTION_LIST accFanDuty1 /end FUNCTION_LIST /end CHARACTERISTIC
/begin CHARACTERISTIC CTRL_upperThreshCellSeg3LV "" VALUE 0x800385C0 RECORD_LAYOUT__1 0 COMPU_METHOD__3 -1E+17 1E+17 /begin FUNCTION_LIST accFanDuty1 /end FUNCTION_LIST /end CHARACTERISTIC
/begin CHARACTERISTIC CTRL_upperThreshCellSeg4HV "" VALUE 0x8003839C RECORD_LAYOUT__1 0 COMPU_METHOD__3 -1E+17 1E+17 /begin FUNCTION_LIST accFanDuty5 /end FUNCTION_LIST /end CHARACTERISTIC
/begin CHARACTERISTIC CTRL_upperThreshCellSeg4LV "" VALUE 0x80038398 RECORD_LAYOUT__1 0 COMPU_METHOD__3 -1E+17 1E+17 /begin FUNCTION_LIST accFanDuty5 /end FUNCTION_LIST /end CHARACTERISTIC
/begin CHARACTERISTIC CTRL_upperThreshCellSeg5HV "" VALUE 0x8003850C RECORD_LAYOUT__1 0 COMPU_METHOD__3 -1E+17 1E+17 /begin FUNCTION_LIST accFanDuty2 /end FUNCTION_LIST /end CHARACTERISTIC
/begin CHARACTERISTIC CTRL_upperThreshCellSeg5LV "" VALUE 0x80038508 RECORD_LAYOUT__1 0 COMPU_METHOD__3 -1E+17 1E+17 /begin FUNCTION_LIST accFanDuty2 /end FUNCTION_LIST /end CHARACTERISTIC
/begin CHARACTERISTIC CTRL_upperThreshCellSeg6HV "" VALUE 0x800382E4 RECORD_LAYOUT__1 0 COMPU_METHOD__3 -1E+17 1E+17 /begin FUNCTION_LIST accFanDuty6 /end FUNCTION_LIST /end CHARACTERISTIC
/begin CHARACTERISTIC CTRL_upperThreshCellSeg6LV "" VALUE 0x800382E0 RECORD_LAYOUT__1 0 COMPU_METHOD__3 -1E+17 1E+17 /begin FUNCTION_LIST accFanDuty6 /end FUNCTION_LIST /end CHARACTERISTIC
/begin CHARACTERISTIC CTRL_upperThreshCellSeg7HV "" VALUE 0x80038174 RECORD_LAYOUT__1 0 COMPU_METHOD__3 -1E+17 1E+17 /begin FUNCTION_LIST accFanDuty3 /end FUNCTION_LIST /end CHARACTERISTIC
/begin CHARACTERISTIC CTRL_upperThreshCellSeg7LV "" VALUE 0x80038170 RECORD_LAYOUT__1 0 COMPU_METHOD__3 -1E+17 1E+17 /begin FUNCTION_LIST accFanDuty3 /end FUNCTION_LIST /end CHARACTERISTIC
/begin CHARACTERISTIC CTRL_upperThreshCellSeg8HV "" VALUE 0x8003822C RECORD_LAYOUT__1 0 COMPU_METHOD__3 -1E+17 1E+17 /begin FUNCTION_LIST accFanDuty7 /end FUNCTION_LIST /end CHARACTERISTIC
/begin CHARACTERISTIC CTRL_upperThreshCellSeg8LV "" VALUE 0x80038228 RECORD_LAYOUT__1 0 COMPU_METHOD__3 -1E+17 1E+17 /begin FUNCTION_LIST accFanDuty7 /end FUNCTION_LIST /end CHARACTERISTIC
/begin CHARACTERISTIC CTRL_upperThreshCoolantInverterIn "" VALUE 0x80039F4C RECORD_LAYOUT__1 0 COMPU_METHOD__3 -1E+17 1E+17 /begin FUNCTION_LIST wpDuty /end FUNCTION_LIST /end CHARACTERISTIC
/begin CHARACTERISTIC CTRL_upperThreshCoolantInverterInHVLeft "" VALUE 0x80038C50 RECORD_LAYOUT__1 0 COMPU_METHOD__3 -1E+17 1E+17 /begin FUNCTION_LIST fanDutyLeft /end FUNCTION_LIST /end CHARACTERISTIC
/begin CHARACTERISTIC CTRL_upperThreshCoolantInverterInHVRight "" VALUE 0x800395D4 RECORD_LAYOUT__1 0 COMPU_METHOD__3 -1E+17 1E+17 /begin FUNCTION_LIST fanDutyRight /end FUNCTION_LIST /end CHARACTERISTIC
/begin CHARACTERISTIC CTRL_upperThreshCoolantInverterInLVLeft "" VALUE 0x80038C44 RECORD_LAYOUT__1 0 COMPU_METHOD__3 -1E+17 1E+17 /begin FUNCTION_LIST fanDutyLeft /end FUNCTION_LIST /end CHARACTERISTIC
/begin CHARACTERISTIC CTRL_upperThreshCoolantInverterInLVRight "" VALUE 0x800395C8 RECORD_LAYOUT__1 0 COMPU_METHOD__3 -1E+17 1E+17 /begin FUNCTION_LIST fanDutyRight /end FUNCTION_LIST /end CHARACTERISTIC
/begin CHARACTERISTIC CTRL_upperThreshCoolantInverterOut "" VALUE 0x80039F54 RECORD_LAYOUT__1 0 COMPU_METHOD__3 -1E+17 1E+17 /begin FUNCTION_LIST wpDuty /end FUNCTION_LIST /end CHARACTERISTIC
/begin CHARACTERISTIC CTRL_upperThreshCoolantInverterOutHVLeft "" VALUE 0x80038C58 RECORD_LAYOUT__1 0 COMPU_METHOD__3 -1E+17 1E+17 /begin FUNCTION_LIST fanDutyLeft /end FUNCTION_LIST /end CHARACTERISTIC
/begin CHARACTERISTIC CTRL_upperThreshCoolantInverterOutHVRight "" VALUE 0x800395DC RECORD_LAYOUT__1 0 COMPU_METHOD__3 -1E+17 1E+17 /begin FUNCTION_LIST fanDutyRight /end FUNCTION_LIST /end CHARACTERISTIC
/begin CHARACTERISTIC CTRL_upperThreshCoolantInverterOutLVLeft "" VALUE 0x80038C4C RECORD_LAYOUT__1 0 COMPU_METHOD__3 -1E+17 1E+17 /begin FUNCTION_LIST fanDutyLeft /end FUNCTION_LIST /end CHARACTERISTIC
/begin CHARACTERISTIC CTRL_upperThreshCoolantInverterOutLVRight "" VALUE 0x800395D0 RECORD_LAYOUT__1 0 COMPU_METHOD__3 -1E+17 1E+17 /begin FUNCTION_LIST fanDutyRight /end FUNCTION_LIST /end CHARACTERISTIC
/begin CHARACTERISTIC CTRL_upperThreshCoolantMotorIn "" VALUE 0x80039F50 RECORD_LAYOUT__1 0 COMPU_METHOD__3 -1E+17 1E+17 /begin FUNCTION_LIST wpDuty /end FUNCTION_LIST /end CHARACTERISTIC
/begin CHARACTERISTIC CTRL_upperThreshCoolantMotorInHVLeft "" VALUE 0x80038C54 RECORD_LAYOUT__1 0 COMPU_METHOD__3 -1E+17 1E+17 /begin FUNCTION_LIST fanDutyLeft /end FUNCTION_LIST /end CHARACTERISTIC
/begin CHARACTERISTIC CTRL_upperThreshCoolantMotorInHVRight "" VALUE 0x800395D8 RECORD_LAYOUT__1 0 COMPU_METHOD__3 -1E+17 1E+17 /begin FUNCTION_LIST fanDutyRight /end FUNCTION_LIST /end CHARACTERISTIC
/begin CHARACTERISTIC CTRL_upperThreshCoolantMotorInLVLeft "" VALUE 0x80038C48 RECORD_LAYOUT__1 0 COMPU_METHOD__3 -1E+17 1E+17 /begin FUNCTION_LIST fanDutyLeft /end FUNCTION_LIST /end CHARACTERISTIC
/begin CHARACTERISTIC CTRL_upperThreshCoolantMotorInLVRight "" VALUE 0x800395CC RECORD_LAYOUT__1 0 COMPU_METHOD__3 -1E+17 1E+17 /begin FUNCTION_LIST fanDutyRight /end FUNCTION_LIST /end CHARACTERISTIC
/begin CHARACTERISTIC CTRL_upperThreshPIDIn "" VALUE 0x80038C38 RECORD_LAYOUT__1 0 COMPU_METHOD__3 -1E+17 1E+17 /begin FUNCTION_LIST tractionControl_1_ /end FUNCTION_LIST /end CHARACTERISTIC
/begin CHARACTERISTIC CTRL_upperThreshPwrReduction "" VALUE 0x80038C3C RECORD_LAYOUT__1 0 COMPU_METHOD__3 -1E+17 1E+17 /begin FUNCTION_LIST tractionControl_1_ /end FUNCTION_LIST /end CHARACTERISTIC
/begin CHARACTERISTIC CTRL_yawRateToAimSlip "" MAP 0x80038A30 RECORD_LAYOUT__4 0 COMPU_METHOD__3 -1E+17 1E+17
 /begin AXIS_DESCR COM_AXIS CTRL_yawRateToAimSlip_LookupX_IN COMPU_METHOD__10 13 -1E+17 1E+17 AXIS_PTS_REF CTRL_yawRateToAimSlip_LookupX /end AXIS_DESCR
 /begin AXIS_DESCR COM_AXIS CTRL_yawRateToAimSlip_LookupY_IN COMPU_METHOD__9 10 -1E+17 1E+17 AXIS_PTS_REF CTRL_yawRateToAimSlip_LookupY /end AXIS_DESCR
 /begin FUNCTION_LIST tractionControl_1_ /end FUNCTION_LIST
/end CHARACTERISTIC
/begin CHARACTERISTIC DATA_maxMotorTorque_Nm "" VALUE 0x8003B02C RECORD_LAYOUT__1 0 COMPU_METHOD__3 -1E+17 1E+17 /begin FUNCTION_LIST EVSR24 /end FUNCTION_LIST /end CHARACTERISTIC
/begin CHARACTERISTIC DATA_unloadedWheelRadius_m "" VALUE 0x8003B024 RECORD_LAYOUT__1 0 COMPU_METHOD__18 -1E+17 1E+17 /begin FUNCTION_LIST EVSR24 /end FUNCTION_LIST /end CHARACTERISTIC
/begin CHARACTERISTIC DATA_wheelTooth_ct "" VALUE 0x8003B028 RECORD_LAYOUT__1 0 COMPU_METHOD__3 -1E+17 1E+17 /begin FUNCTION_LIST EVSR24 /end FUNCTION_LIST /end CHARACTERISTIC
/begin CHARACTERISTIC IN_appsThreshold "" VALUE 0x8003AA90 RECORD_LAYOUT__1 0 COMPU_METHOD__3 -1E+17 1E+17 /begin FUNCTION_LIST APPS /end FUNCTION_LIST /end CHARACTERISTIC
/begin CHARACTERISTIC IN_brakeHighF_v "" VALUE 0x8003A480 RECORD_LAYOUT__1 0 COMPU_METHOD__3 -1E+17 1E+17 /begin FUNCTION_LIST brakePressureF /end FUNCTION_LIST /end CHARACTERISTIC
/begin CHARACTERISTIC IN_brakeHighR_v "" VALUE 0x8003A4BC RECORD_LAYOUT__1 0 COMPU_METHOD__3 -1E+17 1E+17 /begin FUNCTION_LIST brakePressureR /end FUNCTION_LIST /end CHARACTERISTIC
/begin CHARACTERISTIC IN_brakeLowF_v "" VALUE 0x8003A484 RECORD_LAYOUT__1 0 COMPU_METHOD__3 -1E+17 1E+17 /begin FUNCTION_LIST brakePressureF /end FUNCTION_LIST /end CHARACTERISTIC
/begin CHARACTERISTIC IN_brakeLowR_v "" VALUE 0x8003A4C0 RECORD_LAYOUT__1 0 COMPU_METHOD__3 -1E+17 1E+17 /begin FUNCTION_LIST brakePressureR /end FUNCTION_LIST /end CHARACTERISTIC
/begin CHARACTERISTIC IN_brakePosF_zero "" VALUE 0x8003A464 RECORD_LAYOUT__3 0 COMPU_METHOD__5 0 1 /begin FUNCTION_LIST brakePressureF /end FUNCTION_LIST /end CHARACTERISTIC
/begin CHARACTERISTIC IN_brakePosOverrideF_bool "" VALUE 0x8003A465 RECORD_LAYOUT__3 0 COMPU_METHOD__5 0 1 /begin FUNCTION_LIST brakePressureF /end FUNCTION_LIST /end CHARACTERISTIC
/begin CHARACTERISTIC IN_brakePosOverrideF_pct_OvrSts "Controls status of value override." VALUE 0x80038048 RECORD_LAYOUT__3 0 COMPU_METHOD__6 0 255 /begin FUNCTION_LIST Override_3_ /end FUNCTION_LIST /end CHARACTERISTIC
/begin CHARACTERISTIC IN_brakePosOverrideF_pct_OvrVal "" VALUE 0x80038044 RECORD_LAYOUT__1 0 COMPU_METHOD__3 -1E+17 1E+17 /begin FUNCTION_LIST Override_3_ /end FUNCTION_LIST /end CHARACTERISTIC
/begin CHARACTERISTIC IN_brakePosOverrideR_bool "" VALUE 0x8003A467 RECORD_LAYOUT__3 0 COMPU_METHOD__5 0 1 /begin FUNCTION_LIST brakePressureR /end FUNCTION_LIST /end CHARACTERISTIC
/begin CHARACTERISTIC IN_brakePosOverrideR_pct_OvrSts "Controls status of value override." VALUE 0x80038050 RECORD_LAYOUT__3 0 COMPU_METHOD__6 0 255 /begin FUNCTION_LIST Override_4_ /end FUNCTION_LIST /end CHARACTERISTIC
/begin CHARACTERISTIC IN_brakePosOverrideR_pct_OvrVal "" VALUE 0x8003804C RECORD_LAYOUT__1 0 COMPU_METHOD__3 -1E+17 1E+17 /begin FUNCTION_LIST Override_4_ /end FUNCTION_LIST /end CHARACTERISTIC
/begin CHARACTERISTIC IN_brakePosR_zero "" VALUE 0x8003A466 RECORD_LAYOUT__3 0 COMPU_METHOD__5 0 1 /begin FUNCTION_LIST brakePressureR /end FUNCTION_LIST /end CHARACTERISTIC
/begin CHARACTERISTIC IN_brakePressureF_psiToPct "" VALUE 0x8003A488 RECORD_LAYOUT__1 0 COMPU_METHOD__3 -1E+17 1E+17 /begin FUNCTION_LIST brakePressureF /end FUNCTION_LIST /end CHARACTERISTIC
/begin CHARACTERISTIC IN_brakePressureF_vToPsi "" VALUE 0x8003A478 RECORD_LAYOUT__1 0 COMPU_METHOD__3 -1E+17 1E+17 /begin FUNCTION_LIST brakePressureF /end FUNCTION_LIST /end CHARACTERISTIC
/begin CHARACTERISTIC IN_brakePressureR_psiToPct "" VALUE 0x8003A4C4 RECORD_LAYOUT__1 0 COMPU_METHOD__3 -1E+17 1E+17 /begin FUNCTION_LIST brakePressureR /end FUNCTION_LIST /end CHARACTERISTIC
/begin CHARACTERISTIC IN_brakePressureR_vToPsi "" VALUE 0x8003A47C RECORD_LAYOUT__1 0 COMPU_METHOD__3 -1E+17 1E+17 /begin FUNCTION_LIST brakePressureR /end FUNCTION_LIST /end CHARACTERISTIC
/begin CHARACTERISTIC IN_bspdBrakeBadHigh "" VALUE 0x8003A744 RECORD_LAYOUT__1 0 COMPU_METHOD__3 -1E+17 1E+17 /begin FUNCTION_LIST bspdBrakeError /end FUNCTION_LIST /end CHARACTERISTIC
/begin CHARACTERISTIC IN_bspdBrakeBadLow "" VALUE 0x8003A748 RECORD_LAYOUT__1 0 COMPU_METHOD__3 -1E+17 1E+17 /begin FUNCTION_LIST bspdBrakeError /end FUNCTION_LIST /end CHARACTERISTIC
/begin CHARACTERISTIC IN_bspdBrakeGoodHigh "" VALUE 0x8003A750 RECORD_LAYOUT__1 0 COMPU_METHOD__3 -1E+17 1E+17 /begin FUNCTION_LIST bspdBrakeError /end FUNCTION_LIST /end CHARACTERISTIC
/begin CHARACTERISTIC IN_bspdBrakeGoodLow "" VALUE 0x8003A74C RECORD_LAYOUT__1 0 COMPU_METHOD__3 -1E+17 1E+17 /begin FUNCTION_LIST bspdBrakeError /end FUNCTION_LIST /end CHARACTERISTIC
/begin CHARACTERISTIC IN_bspdStatusBadHigh "" VALUE 0x8003A75C RECORD_LAYOUT__1 0 COMPU_METHOD__3 -1E+17 1E+17 /begin FUNCTION_LIST bspdStatusError /end FUNCTION_LIST /end CHARACTERISTIC
/begin CHARACTERISTIC IN_bspdStatusBadLow "" VALUE 0x8003A760 RECORD_LAYOUT__1 0 COMPU_METHOD__3 -1E+17 1E+17 /begin FUNCTION_LIST bspdStatusError /end FUNCTION_LIST /end CHARACTERISTIC
/begin CHARACTERISTIC IN_bspdStatusGoodHigh "" VALUE 0x8003A768 RECORD_LAYOUT__1 0 COMPU_METHOD__3 -1E+17 1E+17 /begin FUNCTION_LIST bspdStatusError /end FUNCTION_LIST /end CHARACTERISTIC
/begin CHARACTERISTIC IN_bspdStatusGoodLow "" VALUE 0x8003A764 RECORD_LAYOUT__1 0 COMPU_METHOD__3 -1E+17 1E+17 /begin FUNCTION_LIST bspdStatusError /end FUNCTION_LIST /end CHARACTERISTIC
/begin CHARACTERISTIC IN_coolantTempHighInverterIn_v "" VALUE 0x8003A780 RECORD_LAYOUT__1 0 COMPU_METHOD__3 -1E+17 1E+17 /begin FUNCTION_LIST coolantTempInverterIn /end FUNCTION_LIST /end CHARACTERISTIC
/begin CHARACTERISTIC IN_coolantTempHighInverterOut_v "" VALUE 0x8003A7A0 RECORD_LAYOUT__1 0 COMPU_METHOD__3 -1E+17 1E+17 /begin FUNCTION_LIST coolantTempInverterOut /end FUNCTION_LIST /end CHARACTERISTIC
/begin CHARACTERISTIC IN_coolantTempHighMotorIn_v "" VALUE 0x8003A7C0 RECORD_LAYOUT__1 0 COMPU_METHOD__3 -1E+17 1E+17 /begin FUNCTION_LIST coolantTempMotorIn /end FUNCTION_LIST /end CHARACTERISTIC
/begin CHARACTERISTIC IN_coolantTempInverterIn_bool "" VALUE 0x8003A66C RECORD_LAYOUT__3 0 COMPU_METHOD__5 0 1 /begin FUNCTION_LIST coolantTempInverterIn /end FUNCTION_LIST /end CHARACTERISTIC
/begin CHARACTERISTIC IN_coolantTempInverterIn_deg_OvrSts "Controls status of value override." VALUE 0x80038058 RECORD_LAYOUT__3 0 COMPU_METHOD__6 0 255 /begin FUNCTION_LIST Override_5_ /end FUNCTION_LIST /end CHARACTERISTIC
/begin CHARACTERISTIC IN_coolantTempInverterIn_deg_OvrVal "" VALUE 0x80038054 RECORD_LAYOUT__1 0 COMPU_METHOD__3 -1E+17 1E+17 /begin FUNCTION_LIST Override_5_ /end FUNCTION_LIST /end CHARACTERISTIC
/begin CHARACTERISTIC IN_coolantTempInverterOut_bool "" VALUE 0x8003A710 RECORD_LAYOUT__3 0 COMPU_METHOD__5 0 1 /begin FUNCTION_LIST coolantTempInverterOut /end FUNCTION_LIST /end CHARACTERISTIC
/begin CHARACTERISTIC IN_coolantTempInverterOut_deg_OvrSts "Controls status of value override." VALUE 0x80038060 RECORD_LAYOUT__3 0 COMPU_METHOD__6 0 255 /begin FUNCTION_LIST Override_6_ /end FUNCTION_LIST /end CHARACTERISTIC
/begin CHARACTERISTIC IN_coolantTempInverterOut_deg_OvrVal "" VALUE 0x8003805C RECORD_LAYOUT__1 0 COMPU_METHOD__3 -1E+17 1E+17 /begin FUNCTION_LIST Override_6_ /end FUNCTION_LIST /end CHARACTERISTIC
/begin CHARACTERISTIC IN_coolantTempLowInverterIn_v "" VALUE 0x8003A774 RECORD_LAYOUT__1 0 COMPU_METHOD__3 -1E+17 1E+17 /begin FUNCTION_LIST coolantTempInverterIn /end FUNCTION_LIST /end CHARACTERISTIC
/begin CHARACTERISTIC IN_coolantTempLowInverterOut_v "" VALUE 0x8003A794 RECORD_LAYOUT__1 0 COMPU_METHOD__3 -1E+17 1E+17 /begin FUNCTION_LIST coolantTempInverterOut /end FUNCTION_LIST /end CHARACTERISTIC
/begin CHARACTERISTIC IN_coolantTempLowMotorIn_v "" VALUE 0x8003A7B4 RECORD_LAYOUT__1 0 COMPU_METHOD__3 -1E+17 1E+17 /begin FUNCTION_LIST coolantTempMotorIn /end FUNCTION_LIST /end CHARACTERISTIC
/begin CHARACTERISTIC IN_coolantTempMotorIn_bool "" VALUE 0x8003A5C8 RECORD_LAYOUT__3 0 COMPU_METHOD__5 0 1 /begin FUNCTION_LIST coolantTempMotorIn /end FUNCTION_LIST /end CHARACTERISTIC
/begin CHARACTERISTIC IN_coolantTempMotorIn_deg_OvrSts "Controls status of value override." VALUE 0x80038068 RECORD_LAYOUT__3 0 COMPU_METHOD__6 0 255 /begin FUNCTION_LIST Override_7_ /end FUNCTION_LIST /end CHARACTERISTIC
/begin CHARACTERISTIC IN_coolantTempMotorIn_deg_OvrVal "" VALUE 0x80038064 RECORD_LAYOUT__1 0 COMPU_METHOD__3 -1E+17 1E+17 /begin FUNCTION_LIST Override_7_ /end FUNCTION_LIST /end CHARACTERISTIC
/begin CHARACTERISTIC IN_coolantTempVToDegInverterIn "" CURVE 0x8003A61C RECORD_LAYOUT__1 0 COMPU_METHOD__16 -1E+17 1E+17
 /begin AXIS_DESCR COM_AXIS IN_coolantTempVToDegInverterIn_LookupX_IN COMPU_METHOD__15 20 -1E+17 1E+17 AXIS_PTS_REF IN_coolantTempVToDegInverterIn_LookupX /end AXIS_DESCR
 /begin FUNCTION_LIST coolantTempInverterIn /end FUNCTION_LIST
/end CHARACTERISTIC
/begin CHARACTERISTIC IN_coolantTempVToDegInverterOut "" CURVE 0x8003A6C0 RECORD_LAYOUT__1 0 COMPU_METHOD__16 -1E+17 1E+17
 /begin AXIS_DESCR COM_AXIS IN_coolantTempVToDegInverterOut_LookupX_IN COMPU_METHOD__15 20 -1E+17 1E+17 AXIS_PTS_REF IN_coolantTempVToDegInverterOut_LookupX /end AXIS_DESCR
 /begin FUNCTION_LIST coolantTempInverterOut /end FUNCTION_LIST
/end CHARACTERISTIC
/begin CHARACTERISTIC IN_coolantTempVToDegMotorIn "" CURVE 0x8003A578 RECORD_LAYOUT__1 0 COMPU_METHOD__16 -1E+17 1E+17
 /begin AXIS_DESCR COM_AXIS IN_coolantTempVToDegMotorIn_LookupX_IN COMPU_METHOD__15 20 -1E+17 1E+17 AXIS_PTS_REF IN_coolantTempVToDegMotorIn_LookupX /end AXIS_DESCR
 /begin FUNCTION_LIST coolantTempMotorIn /end FUNCTION_LIST
/end CHARACTERISTIC
/begin CHARACTERISTIC IN_rotorTempFL_bool "" VALUE 0x8003A87C RECORD_LAYOUT__3 0 COMPU_METHOD__5 0 1 /begin FUNCTION_LIST rotorTemp_1_ /end FUNCTION_LIST /end CHARACTERISTIC
/begin CHARACTERISTIC IN_rotorTempFL_deg_OvrSts "Controls status of value override." VALUE 0x80038080 RECORD_LAYOUT__3 0 COMPU_METHOD__6 0 255 /begin FUNCTION_LIST Override_10_ /end FUNCTION_LIST /end CHARACTERISTIC
/begin CHARACTERISTIC IN_rotorTempFL_deg_OvrVal "" VALUE 0x8003807C RECORD_LAYOUT__1 0 COMPU_METHOD__3 -1E+17 1E+17 /begin FUNCTION_LIST Override_10_ /end FUNCTION_LIST /end CHARACTERISTIC
/begin CHARACTERISTIC IN_rotorTempFR_bool "" VALUE 0x8003A9D4 RECORD_LAYOUT__3 0 COMPU_METHOD__5 0 1 /begin FUNCTION_LIST rotorTemp2 /end FUNCTION_LIST /end CHARACTERISTIC
/begin CHARACTERISTIC IN_rotorTempFR_deg_OvrSts "Controls status of value override." VALUE 0x80038090 RECORD_LAYOUT__3 0 COMPU_METHOD__6 0 255 /begin FUNCTION_LIST Override_12_ /end FUNCTION_LIST /end CHARACTERISTIC
/begin CHARACTERISTIC IN_rotorTempFR_deg_OvrVal "" VALUE 0x8003808C RECORD_LAYOUT__1 0 COMPU_METHOD__3 -1E+17 1E+17 /begin FUNCTION_LIST Override_12_ /end FUNCTION_LIST /end CHARACTERISTIC
/begin CHARACTERISTIC IN_rotorTempHighFL_v "" VALUE 0x8003A7E0 RECORD_LAYOUT__1 0 COMPU_METHOD__3 -1E+17 1E+17 /begin FUNCTION_LIST rotorTemp_1_ /end FUNCTION_LIST /end CHARACTERISTIC
/begin CHARACTERISTIC IN_rotorTempHighFR_v "" VALUE 0x8003A938 RECORD_LAYOUT__1 0 COMPU_METHOD__3 -1E+17 1E+17 /begin FUNCTION_LIST rotorTemp2 /end FUNCTION_LIST /end CHARACTERISTIC
/begin CHARACTERISTIC IN_rotorTempHighRL_v "" VALUE 0x8003A88C RECORD_LAYOUT__1 0 COMPU_METHOD__3 -1E+17 1E+17 /begin FUNCTION_LIST rotorTemp1 /end FUNCTION_LIST /end CHARACTERISTIC
/begin CHARACTERISTIC IN_rotorTempHighRR_v "" VALUE 0x8003A9E4 RECORD_LAYOUT__1 0 COMPU_METHOD__3 -1E+17 1E+17 /begin FUNCTION_LIST rotorTemp3 /end FUNCTION_LIST /end CHARACTERISTIC
/begin CHARACTERISTIC IN_rotorTempLowFL_v "" VALUE 0x8003A7D4 RECORD_LAYOUT__1 0 COMPU_METHOD__3 -1E+17 1E+17 /begin FUNCTION_LIST rotorTemp_1_ /end FUNCTION_LIST /end CHARACTERISTIC
/begin CHARACTERISTIC IN_rotorTempLowFR_v "" VALUE 0x8003A92C RECORD_LAYOUT__1 0 COMPU_METHOD__3 -1E+17 1E+17 /begin FUNCTION_LIST rotorTemp2 /end FUNCTION_LIST /end CHARACTERISTIC
/begin CHARACTERISTIC IN_rotorTempLowRL_v "" VALUE 0x8003A880 RECORD_LAYOUT__1 0 COMPU_METHOD__3 -1E+17 1E+17 /begin FUNCTION_LIST rotorTemp1 /end FUNCTION_LIST /end CHARACTERISTIC
/begin CHARACTERISTIC IN_rotorTempLowRR_v "" VALUE 0x8003A9D8 RECORD_LAYOUT__1 0 COMPU_METHOD__3 -1E+17 1E+17 /begin FUNCTION_LIST rotorTemp3 /end FUNCTION_LIST /end CHARACTERISTIC
/begin CHARACTERISTIC IN_rotorTempRL_bool "" VALUE 0x8003A928 RECORD_LAYOUT__3 0 COMPU_METHOD__5 0 1 /begin FUNCTION_LIST rotorTemp1 /end FUNCTION_LIST /end CHARACTERISTIC
/begin CHARACTERISTIC IN_rotorTempRL_deg_OvrSts "Controls status of value override." VALUE 0x80038088 RECORD_LAYOUT__3 0 COMPU_METHOD__6 0 255 /begin FUNCTION_LIST Override_11_ /end FUNCTION_LIST /end CHARACTERISTIC
/begin CHARACTERISTIC IN_rotorTempRL_deg_OvrVal "" VALUE 0x80038084 RECORD_LAYOUT__1 0 COMPU_METHOD__3 -1E+17 1E+17 /begin FUNCTION_LIST Override_11_ /end FUNCTION_LIST /end CHARACTERISTIC
/begin CHARACTERISTIC IN_rotorTempRR_bool "" VALUE 0x8003AA80 RECORD_LAYOUT__3 0 COMPU_METHOD__5 0 1 /begin FUNCTION_LIST rotorTemp3 /end FUNCTION_LIST /end CHARACTERISTIC
/begin CHARACTERISTIC IN_rotorTempRR_deg_OvrSts "Controls status of value override." VALUE 0x80038098 RECORD_LAYOUT__3 0 COMPU_METHOD__6 0 255 /begin FUNCTION_LIST Override_13_ /end FUNCTION_LIST /end CHARACTERISTIC
/begin CHARACTERISTIC IN_rotorTempRR_deg_OvrVal "" VALUE 0x80038094 RECORD_LAYOUT__1 0 COMPU_METHOD__3 -1E+17 1E+17 /begin FUNCTION_LIST Override_13_ /end FUNCTION_LIST /end CHARACTERISTIC
/begin CHARACTERISTIC IN_rotorTempVToDegFL "" CURVE 0x8003A838 RECORD_LAYOUT__1 0 COMPU_METHOD__16 -1E+17 1E+17
 /begin AXIS_DESCR COM_AXIS IN_rotorTempVToDegFL_LookupX_IN COMPU_METHOD__15 17 -1E+17 1E+17 AXIS_PTS_REF IN_rotorTempVToDegFL_LookupX /end AXIS_DESCR
 /begin FUNCTION_LIST rotorTemp_1_ /end FUNCTION_LIST
/end CHARACTERISTIC
/begin CHARACTERISTIC IN_rotorTempVToDegFR "" CURVE 0x8003A990 RECORD_LAYOUT__1 0 COMPU_METHOD__16 -1E+17 1E+17
 /begin AXIS_DESCR COM_AXIS IN_rotorTempVToDegFR_LookupX_IN COMPU_METHOD__15 17 -1E+17 1E+17 AXIS_PTS_REF IN_rotorTempVToDegFR_LookupX /end AXIS_DESCR
 /begin FUNCTION_LIST rotorTemp2 /end FUNCTION_LIST
/end CHARACTERISTIC
/begin CHARACTERISTIC IN_rotorTempVToDegRL "" CURVE 0x8003A8E4 RECORD_LAYOUT__1 0 COMPU_METHOD__16 -1E+17 1E+17
 /begin AXIS_DESCR COM_AXIS IN_rotorTempVToDegRL_LookupX_IN COMPU_METHOD__15 17 -1E+17 1E+17 AXIS_PTS_REF IN_rotorTempVToDegRL_LookupX /end AXIS_DESCR
 /begin FUNCTION_LIST rotorTemp1 /end FUNCTION_LIST
/end CHARACTERISTIC
/begin CHARACTERISTIC IN_rotorTempVToDegRR "" CURVE 0x8003AA3C RECORD_LAYOUT__1 0 COMPU_METHOD__16 -1E+17 1E+17
 /begin AXIS_DESCR COM_AXIS IN_rotorTempVToDegRR_LookupX_IN COMPU_METHOD__15 17 -1E+17 1E+17 AXIS_PTS_REF IN_rotorTempVToDegRR_LookupX /end AXIS_DESCR
 /begin FUNCTION_LIST rotorTemp3 /end FUNCTION_LIST
/end CHARACTERISTIC
/begin CHARACTERISTIC IN_slipThreshold "" VALUE 0x80038C40 RECORD_LAYOUT__1 0 COMPU_METHOD__3 -1E+17 1E+17 /begin FUNCTION_LIST muEstimator /end FUNCTION_LIST /end CHARACTERISTIC
/begin CHARACTERISTIC IN_startSwitchNOHighLowerThresh "" VALUE 0x8003AA88 RECORD_LAYOUT__1 0 COMPU_METHOD__3 -1E+17 1E+17 /begin FUNCTION_LIST Subsystem /end FUNCTION_LIST /end CHARACTERISTIC
/begin CHARACTERISTIC IN_startSwitchNOHighUpperThresh "" VALUE 0x8003AA84 RECORD_LAYOUT__1 0 COMPU_METHOD__3 -1E+17 1E+17 /begin FUNCTION_LIST Subsystem /end FUNCTION_LIST /end CHARACTERISTIC
/begin CHARACTERISTIC IN_startSwitchNOLowLowerThresh "" VALUE 0x8003AA8C RECORD_LAYOUT__1 0 COMPU_METHOD__3 -1E+17 1E+17 /begin FUNCTION_LIST Subsystem /end FUNCTION_LIST /end CHARACTERISTIC
/begin CHARACTERISTIC IN_tcSet_OvrSts "Controls status of value override." VALUE 0x80038040 RECORD_LAYOUT__3 0 COMPU_METHOD__6 0 255 /begin FUNCTION_LIST Override_2_ /end FUNCTION_LIST /end CHARACTERISTIC
/begin CHARACTERISTIC IN_tcSet_OvrVal "" VALUE 0x8003803C RECORD_LAYOUT__1 0 COMPU_METHOD__3 -1E+17 1E+17 /begin FUNCTION_LIST Override_2_ /end FUNCTION_LIST /end CHARACTERISTIC
/begin CHARACTERISTIC IN_tcSetTable "" CURVE 0x8003A4F8 RECORD_LAYOUT__1 0 COMPU_METHOD__14 -1E+17 1E+17
 /begin AXIS_DESCR COM_AXIS IN_tcSetTable_LookupX_IN COMPU_METHOD__13 12 -1E+17 1E+17 AXIS_PTS_REF IN_tcSetTable_LookupX /end AXIS_DESCR
 /begin FUNCTION_LIST tcDial_1_ /end FUNCTION_LIST
/end CHARACTERISTIC
/begin CHARACTERISTIC IN_throttle1_degPerV "" VALUE 0x8003A494 RECORD_LAYOUT__1 0 COMPU_METHOD__3 -1E+17 1E+17 /begin FUNCTION_LIST throttle1Input /end FUNCTION_LIST /end CHARACTERISTIC
/begin CHARACTERISTIC IN_throttle2_degPerV "" VALUE 0x8003A4AC RECORD_LAYOUT__1 0 COMPU_METHOD__3 -1E+17 1E+17 /begin FUNCTION_LIST throttle2Input /end FUNCTION_LIST /end CHARACTERISTIC
/begin CHARACTERISTIC IN_throttleHigh1_v "" VALUE 0x8003A48C RECORD_LAYOUT__1 0 COMPU_METHOD__3 -1E+17 1E+17 /begin FUNCTION_LIST throttle1Input /end FUNCTION_LIST /end CHARACTERISTIC
/begin CHARACTERISTIC IN_throttleHigh2_v "" VALUE 0x8003A4A4 RECORD_LAYOUT__1 0 COMPU_METHOD__3 -1E+17 1E+17 /begin FUNCTION_LIST throttle2Input /end FUNCTION_LIST /end CHARACTERISTIC
/begin CHARACTERISTIC IN_throttleLow1_v "" VALUE 0x8003A490 RECORD_LAYOUT__1 0 COMPU_METHOD__3 -1E+17 1E+17 /begin FUNCTION_LIST throttle1Input /end FUNCTION_LIST /end CHARACTERISTIC
/begin CHARACTERISTIC IN_throttleLow2_v "" VALUE 0x8003A4A8 RECORD_LAYOUT__1 0 COMPU_METHOD__3 -1E+17 1E+17 /begin FUNCTION_LIST throttle2Input /end FUNCTION_LIST /end CHARACTERISTIC
/begin CHARACTERISTIC IN_throttleOffset1_deg "" VALUE 0x8003A498 RECORD_LAYOUT__1 0 COMPU_METHOD__3 -1E+17 1E+17 /begin FUNCTION_LIST throttle1Input /end FUNCTION_LIST /end CHARACTERISTIC
/begin CHARACTERISTIC IN_throttleOffset2_deg "" VALUE 0x8003A4B0 RECORD_LAYOUT__1 0 COMPU_METHOD__3 -1E+17 1E+17 /begin FUNCTION_LIST throttle2Input /end FUNCTION_LIST /end CHARACTERISTIC
/begin CHARACTERISTIC IN_throttleOverride1_bool "" VALUE 0x8003A46C RECORD_LAYOUT__3 0 COMPU_METHOD__5 0 1 /begin FUNCTION_LIST throttle1Input /end FUNCTION_LIST /end CHARACTERISTIC
/begin CHARACTERISTIC IN_throttleOverride1_pct_OvrSts "Controls status of value override." VALUE 0x80038070 RECORD_LAYOUT__3 0 COMPU_METHOD__6 0 255 /begin FUNCTION_LIST Override_8_ /end FUNCTION_LIST /end CHARACTERISTIC
/begin CHARACTERISTIC IN_throttleOverride1_pct_OvrVal "" VALUE 0x8003806C RECORD_LAYOUT__1 0 COMPU_METHOD__3 -1E+17 1E+17 /begin FUNCTION_LIST Override_8_ /end FUNCTION_LIST /end CHARACTERISTIC
/begin CHARACTERISTIC IN_throttleOverride2_bool "" VALUE 0x8003A474 RECORD_LAYOUT__3 0 COMPU_METHOD__5 0 1 /begin FUNCTION_LIST throttle2Input /end FUNCTION_LIST /end CHARACTERISTIC
/begin CHARACTERISTIC IN_throttleOverride2_pct_OvrSts "Controls status of value override." VALUE 0x80038078 RECORD_LAYOUT__3 0 COMPU_METHOD__6 0 255 /begin FUNCTION_LIST Override_9_ /end FUNCTION_LIST /end CHARACTERISTIC
/begin CHARACTERISTIC IN_throttleOverride2_pct_OvrVal "" VALUE 0x80038074 RECORD_LAYOUT__1 0 COMPU_METHOD__3 -1E+17 1E+17 /begin FUNCTION_LIST Override_9_ /end FUNCTION_LIST /end CHARACTERISTIC
/begin CHARACTERISTIC IN_throttlePos1_pctPerDeg "" VALUE 0x8003A49C RECORD_LAYOUT__1 0 COMPU_METHOD__3 -1E+17 1E+17 /begin FUNCTION_LIST throttle1Input /end FUNCTION_LIST /end CHARACTERISTIC
/begin CHARACTERISTIC IN_throttlePos1_zero "" VALUE 0x8003A468 RECORD_LAYOUT__1 0 COMPU_METHOD__3 -1E+17 1E+17 /begin FUNCTION_LIST throttle1Input /end FUNCTION_LIST /end CHARACTERISTIC
/begin CHARACTERISTIC IN_throttlePos2_pctPerDeg "" VALUE 0x8003A4B4 RECORD_LAYOUT__1 0 COMPU_METHOD__3 -1E+17 1E+17 /begin FUNCTION_LIST throttle2Input /end FUNCTION_LIST /end CHARACTERISTIC
/begin CHARACTERISTIC IN_throttlePos2_zero "" VALUE 0x8003A470 RECORD_LAYOUT__1 0 COMPU_METHOD__3 -1E+17 1E+17 /begin FUNCTION_LIST throttle2Input /end FUNCTION_LIST /end CHARACTERISTIC
/begin CHARACTERISTIC IN_tireTempFLI_bool "" VALUE 0x8003AB2C RECORD_LAYOUT__3 0 COMPU_METHOD__5 0 1 /begin FUNCTION_LIST tireTempFLI /end FUNCTION_LIST /end CHARACTERISTIC
/begin CHARACTERISTIC IN_tireTempFLI_deg_OvrSts "Controls status of value override." VALUE 0x800380A0 RECORD_LAYOUT__3 0 COMPU_METHOD__6 0 255 /begin FUNCTION_LIST Override_14_ /end FUNCTION_LIST /end CHARACTERISTIC
/begin CHARACTERISTIC IN_tireTempFLI_deg_OvrVal "" VALUE 0x8003809C RECORD_LAYOUT__1 0 COMPU_METHOD__3 -1E+17 1E+17 /begin FUNCTION_LIST Override_14_ /end FUNCTION_LIST /end CHARACTERISTIC
/begin CHARACTERISTIC IN_tireTempFLM_bool "" VALUE 0x8003AB90 RECORD_LAYOUT__3 0 COMPU_METHOD__5 0 1 /begin FUNCTION_LIST tireTempFLM /end FUNCTION_LIST /end CHARACTERISTIC
/begin CHARACTERISTIC IN_tireTempFLM_deg_OvrSts "Controls status of value override." VALUE 0x800380A8 RECORD_LAYOUT__3 0 COMPU_METHOD__6 0 255 /begin FUNCTION_LIST Override_15_ /end FUNCTION_LIST /end CHARACTERISTIC
/begin CHARACTERISTIC IN_tireTempFLM_deg_OvrVal "" VALUE 0x800380A4 RECORD_LAYOUT__1 0 COMPU_METHOD__3 -1E+17 1E+17 /begin FUNCTION_LIST Override_15_ /end FUNCTION_LIST /end CHARACTERISTIC
/begin CHARACTERISTIC IN_tireTempFLO_bool "" VALUE 0x8003ABF4 RECORD_LAYOUT__3 0 COMPU_METHOD__5 0 1 /begin FUNCTION_LIST tireTempFLO /end FUNCTION_LIST /end CHARACTERISTIC
/begin CHARACTERISTIC IN_tireTempFLO_deg_OvrSts "Controls status of value override." VALUE 0x800380B0 RECORD_LAYOUT__3 0 COMPU_METHOD__6 0 255 /begin FUNCTION_LIST Override_16_ /end FUNCTION_LIST /end CHARACTERISTIC
/begin CHARACTERISTIC IN_tireTempFLO_deg_OvrVal "" VALUE 0x800380AC RECORD_LAYOUT__1 0 COMPU_METHOD__3 -1E+17 1E+17 /begin FUNCTION_LIST Override_16_ /end FUNCTION_LIST /end CHARACTERISTIC
/begin CHARACTERISTIC IN_tireTempFRI_bool "" VALUE 0x8003AC58 RECORD_LAYOUT__3 0 COMPU_METHOD__5 0 1 /begin FUNCTION_LIST tireTempFRI /end FUNCTION_LIST /end CHARACTERISTIC
/begin CHARACTERISTIC IN_tireTempFRI_deg_OvrSts "Controls status of value override." VALUE 0x800380B8 RECORD_LAYOUT__3 0 COMPU_METHOD__6 0 255 /begin FUNCTION_LIST Override_17_ /end FUNCTION_LIST /end CHARACTERISTIC
/begin CHARACTERISTIC IN_tireTempFRI_deg_OvrVal "" VALUE 0x800380B4 RECORD_LAYOUT__1 0 COMPU_METHOD__3 -1E+17 1E+17 /begin FUNCTION_LIST Override_17_ /end FUNCTION_LIST /end CHARACTERISTIC
/begin CHARACTERISTIC IN_tireTempFRM_bool "" VALUE 0x8003ACBC RECORD_LAYOUT__3 0 COMPU_METHOD__5 0 1 /begin FUNCTION_LIST tireTempFRM /end FUNCTION_LIST /end CHARACTERISTIC
/begin CHARACTERISTIC IN_tireTempFRM_deg_OvrSts "Controls status of value override." VALUE 0x800380C0 RECORD_LAYOUT__3 0 COMPU_METHOD__6 0 255 /begin FUNCTION_LIST Override_18_ /end FUNCTION_LIST /end CHARACTERISTIC
/begin CHARACTERISTIC IN_tireTempFRM_deg_OvrVal "" VALUE 0x800380BC RECORD_LAYOUT__1 0 COMPU_METHOD__3 -1E+17 1E+17 /begin FUNCTION_LIST Override_18_ /end FUNCTION_LIST /end CHARACTERISTIC
/begin CHARACTERISTIC IN_tireTempFRO_bool "" VALUE 0x8003AD20 RECORD_LAYOUT__3 0 COMPU_METHOD__5 0 1 /begin FUNCTION_LIST tireTempFRO /end FUNCTION_LIST /end CHARACTERISTIC
/begin CHARACTERISTIC IN_tireTempFRO_deg_OvrSts "Controls status of value override." VALUE 0x800380C8 RECORD_LAYOUT__3 0 COMPU_METHOD__6 0 255 /begin FUNCTION_LIST Override_19_ /end FUNCTION_LIST /end CHARACTERISTIC
/begin CHARACTERISTIC IN_tireTempFRO_deg_OvrVal "" VALUE 0x800380C4 RECORD_LAYOUT__1 0 COMPU_METHOD__3 -1E+17 1E+17 /begin FUNCTION_LIST Override_19_ /end FUNCTION_LIST /end CHARACTERISTIC
/begin CHARACTERISTIC IN_tireTempHighFLI_v "" VALUE 0x8003AAD8 RECORD_LAYOUT__1 0 COMPU_METHOD__3 -1E+17 1E+17 /begin FUNCTION_LIST tireTempFLI /end FUNCTION_LIST /end CHARACTERISTIC
/begin CHARACTERISTIC IN_tireTempHighFLM_v "" VALUE 0x8003AB3C RECORD_LAYOUT__1 0 COMPU_METHOD__3 -1E+17 1E+17 /begin FUNCTION_LIST tireTempFLM /end FUNCTION_LIST /end CHARACTERISTIC
/begin CHARACTERISTIC IN_tireTempHighFLO_v "" VALUE 0x8003ABA0 RECORD_LAYOUT__1 0 COMPU_METHOD__3 -1E+17 1E+17 /begin FUNCTION_LIST tireTempFLO /end FUNCTION_LIST /end CHARACTERISTIC
/begin CHARACTERISTIC IN_tireTempHighFRI_v "" VALUE 0x8003AC04 RECORD_LAYOUT__1 0 COMPU_METHOD__3 -1E+17 1E+17 /begin FUNCTION_LIST tireTempFRI /end FUNCTION_LIST /end CHARACTERISTIC
/begin CHARACTERISTIC IN_tireTempHighFRM_v "" VALUE 0x8003AC68 RECORD_LAYOUT__1 0 COMPU_METHOD__3 -1E+17 1E+17 /begin FUNCTION_LIST tireTempFRM /end FUNCTION_LIST /end CHARACTERISTIC
/begin CHARACTERISTIC IN_tireTempHighFRO_v "" VALUE 0x8003ACCC RECORD_LAYOUT__1 0 COMPU_METHOD__3 -1E+17 1E+17 /begin FUNCTION_LIST tireTempFRO /end FUNCTION_LIST /end CHARACTERISTIC
/begin CHARACTERISTIC IN_tireTempHighRLI_v "" VALUE 0x8003AD30 RECORD_LAYOUT__1 0 COMPU_METHOD__3 -1E+17 1E+17 /begin FUNCTION_LIST tireTempRLI /end FUNCTION_LIST /end CHARACTERISTIC
/begin CHARACTERISTIC IN_tireTempLowFLI_v "" VALUE 0x8003AACC RECORD_LAYOUT__1 0 COMPU_METHOD__3 -1E+17 1E+17 /begin FUNCTION_LIST tireTempFLI /end FUNCTION_LIST /end CHARACTERISTIC
/begin CHARACTERISTIC IN_tireTempLowFLM_v "" VALUE 0x8003AB30 RECORD_LAYOUT__1 0 COMPU_METHOD__3 -1E+17 1E+17 /begin FUNCTION_LIST tireTempFLM /end FUNCTION_LIST /end CHARACTERISTIC
/begin CHARACTERISTIC IN_tireTempLowFLO_v "" VALUE 0x8003AB94 RECORD_LAYOUT__1 0 COMPU_METHOD__3 -1E+17 1E+17 /begin FUNCTION_LIST tireTempFLO /end FUNCTION_LIST /end CHARACTERISTIC
/begin CHARACTERISTIC IN_tireTempLowFRI_v "" VALUE 0x8003ABF8 RECORD_LAYOUT__1 0 COMPU_METHOD__3 -1E+17 1E+17 /begin FUNCTION_LIST tireTempFRI /end FUNCTION_LIST /end CHARACTERISTIC
/begin CHARACTERISTIC IN_tireTempLowFRM_v "" VALUE 0x8003AC5C RECORD_LAYOUT__1 0 COMPU_METHOD__3 -1E+17 1E+17 /begin FUNCTION_LIST tireTempFRM /end FUNCTION_LIST /end CHARACTERISTIC
/begin CHARACTERISTIC IN_tireTempLowFRO_v "" VALUE 0x8003ACC0 RECORD_LAYOUT__1 0 COMPU_METHOD__3 -1E+17 1E+17 /begin FUNCTION_LIST tireTempFRO /end FUNCTION_LIST /end CHARACTERISTIC
/begin CHARACTERISTIC IN_tireTempLowRLI_v "" VALUE 0x8003AD24 RECORD_LAYOUT__1 0 COMPU_METHOD__3 -1E+17 1E+17 /begin FUNCTION_LIST tireTempRLI /end FUNCTION_LIST /end CHARACTERISTIC
/begin CHARACTERISTIC IN_tireTempRLI_bool "" VALUE 0x8003AD84 RECORD_LAYOUT__3 0 COMPU_METHOD__5 0 1 /begin FUNCTION_LIST tireTempRLI /end FUNCTION_LIST /end CHARACTERISTIC
/begin CHARACTERISTIC IN_tireTempRLI_deg_OvrSts "Controls status of value override." VALUE 0x800380D0 RECORD_LAYOUT__3 0 COMPU_METHOD__6 0 255 /begin FUNCTION_LIST Override_20_ /end FUNCTION_LIST /end CHARACTERISTIC
/begin CHARACTERISTIC IN_tireTempRLI_deg_OvrVal "" VALUE 0x800380CC RECORD_LAYOUT__1 0 COMPU_METHOD__3 -1E+17 1E+17 /begin FUNCTION_LIST Override_20_ /end FUNCTION_LIST /end CHARACTERISTIC
/begin CHARACTERISTIC IN_tireTempVToDegFLI "" CURVE 0x8003AB0C RECORD_LAYOUT__1 0 COMPU_METHOD__16 -1E+17 1E+17
 /begin AXIS_DESCR COM_AXIS IN_tireTempVToDegFLI_LookupX_IN COMPU_METHOD__15 8 -1E+17 1E+17 AXIS_PTS_REF IN_tireTempVToDegFLI_LookupX /end AXIS_DESCR
 /begin FUNCTION_LIST tireTempFLI /end FUNCTION_LIST
/end CHARACTERISTIC
/begin CHARACTERISTIC IN_tireTempVToDegFLM "" CURVE 0x8003AB70 RECORD_LAYOUT__1 0 COMPU_METHOD__16 -1E+17 1E+17
 /begin AXIS_DESCR COM_AXIS IN_tireTempVToDegFLM_LookupX_IN COMPU_METHOD__15 8 -1E+17 1E+17 AXIS_PTS_REF IN_tireTempVToDegFLM_LookupX /end AXIS_DESCR
 /begin FUNCTION_LIST tireTempFLM /end FUNCTION_LIST
/end CHARACTERISTIC
/begin CHARACTERISTIC IN_tireTempVToDegFLO "" CURVE 0x8003ABD4 RECORD_LAYOUT__1 0 COMPU_METHOD__16 -1E+17 1E+17
 /begin AXIS_DESCR COM_AXIS IN_tireTempVToDegFLO_LookupX_IN COMPU_METHOD__15 8 -1E+17 1E+17 AXIS_PTS_REF IN_tireTempVToDegFLO_LookupX /end AXIS_DESCR
 /begin FUNCTION_LIST tireTempFLO /end FUNCTION_LIST
/end CHARACTERISTIC
/begin CHARACTERISTIC IN_tireTempVToDegFRI "" CURVE 0x8003AC38 RECORD_LAYOUT__1 0 COMPU_METHOD__16 -1E+17 1E+17
 /begin AXIS_DESCR COM_AXIS IN_tireTempVToDegFRI_LookupX_IN COMPU_METHOD__15 8 -1E+17 1E+17 AXIS_PTS_REF IN_tireTempVToDegFRI_LookupX /end AXIS_DESCR
 /begin FUNCTION_LIST tireTempFRI /end FUNCTION_LIST
/end CHARACTERISTIC
/begin CHARACTERISTIC IN_tireTempVToDegFRM "" CURVE 0x8003AC9C RECORD_LAYOUT__1 0 COMPU_METHOD__16 -1E+17 1E+17
 /begin AXIS_DESCR COM_AXIS IN_tireTempVToDegFRM_LookupX_IN COMPU_METHOD__15 8 -1E+17 1E+17 AXIS_PTS_REF IN_tireTempVToDegFRM_LookupX /end AXIS_DESCR
 /begin FUNCTION_LIST tireTempFRM /end FUNCTION_LIST
/end CHARACTERISTIC
/begin CHARACTERISTIC IN_tireTempVToDegFRO "" CURVE 0x8003AD00 RECORD_LAYOUT__1 0 COMPU_METHOD__16 -1E+17 1E+17
 /begin AXIS_DESCR COM_AXIS IN_tireTempVToDegFRO_LookupX_IN COMPU_METHOD__15 8 -1E+17 1E+17 AXIS_PTS_REF IN_tireTempVToDegFRO_LookupX /end AXIS_DESCR
 /begin FUNCTION_LIST tireTempFRO /end FUNCTION_LIST
/end CHARACTERISTIC
/begin CHARACTERISTIC IN_tireTempVToDegRLI "" CURVE 0x8003AD64 RECORD_LAYOUT__1 0 COMPU_METHOD__16 -1E+17 1E+17
 /begin AXIS_DESCR COM_AXIS IN_tireTempVToDegRLI_LookupX_IN COMPU_METHOD__15 8 -1E+17 1E+17 AXIS_PTS_REF IN_tireTempVToDegRLI_LookupX /end AXIS_DESCR
 /begin FUNCTION_LIST tireTempRLI /end FUNCTION_LIST
/end CHARACTERISTIC
/begin CHARACTERISTIC KeySwHiTimeThr "State high time threshold" VALUE 0x80038168 RECORD_LAYOUT__1 0 COMPU_METHOD__2 -1E+17 1E+17 /begin FUNCTION_LIST PowerUp_Down /end FUNCTION_LIST /end CHARACTERISTIC
/begin CHARACTERISTIC KeySwLoTimeThr "State low time threshold" VALUE 0x8003816C RECORD_LAYOUT__1 0 COMPU_METHOD__2 -1E+17 1E+17 /begin FUNCTION_LIST PowerUp_Down /end FUNCTION_LIST /end CHARACTERISTIC
/begin AXIS_PTS CTRL_cellSegment1TempToHVDuty_LookupX "" 0x800386D8 CTRL_cellSegment1TempToHVDuty_LookupX_IN RECORD_LAYOUT__2 0 COMPU_METHOD__4 11 -1E+17 1E+17 DEPOSIT ABSOLUTE /begin FUNCTION_LIST accFanDuty /end FUNCTION_LIST /end AXIS_PTS
/begin AXIS_PTS CTRL_cellSegment1TempToLVDuty_LookupX "" 0x80038680 CTRL_cellSegment1TempToLVDuty_LookupX_IN RECORD_LAYOUT__2 0 COMPU_METHOD__4 11 -1E+17 1E+17 DEPOSIT ABSOLUTE /begin FUNCTION_LIST accFanDuty /end FUNCTION_LIST /end AXIS_PTS
/begin AXIS_PTS CTRL_cellSegment2TempToHVDuty_LookupX "" 0x800384B0 CTRL_cellSegment2TempToHVDuty_LookupX_IN RECORD_LAYOUT__2 0 COMPU_METHOD__4 11 -1E+17 1E+17 DEPOSIT ABSOLUTE /begin FUNCTION_LIST accFanDuty4 /end FUNCTION_LIST /end AXIS_PTS
/begin AXIS_PTS CTRL_cellSegment2TempToLVDuty_LookupX "" 0x80038458 CTRL_cellSegment2TempToLVDuty_LookupX_IN RECORD_LAYOUT__2 0 COMPU_METHOD__4 11 -1E+17 1E+17 DEPOSIT ABSOLUTE /begin FUNCTION_LIST accFanDuty4 /end FUNCTION_LIST /end AXIS_PTS
/begin AXIS_PTS CTRL_cellSegment3TempToHVDuty_LookupX "" 0x80038620 CTRL_cellSegment3TempToHVDuty_LookupX_IN RECORD_LAYOUT__2 0 COMPU_METHOD__4 11 -1E+17 1E+17 DEPOSIT ABSOLUTE /begin FUNCTION_LIST accFanDuty1 /end FUNCTION_LIST /end AXIS_PTS
/begin AXIS_PTS CTRL_cellSegment3TempToLVDuty_LookupX "" 0x800385C8 CTRL_cellSegment3TempToLVDuty_LookupX_IN RECORD_LAYOUT__2 0 COMPU_METHOD__4 11 -1E+17 1E+17 DEPOSIT ABSOLUTE /begin FUNCTION_LIST accFanDuty1 /end FUNCTION_LIST /end AXIS_PTS
/begin AXIS_PTS CTRL_cellSegment4TempToHVDuty_LookupX "" 0x800383F8 CTRL_cellSegment4TempToHVDuty_LookupX_IN RECORD_LAYOUT__2 0 COMPU_METHOD__4 11 -1E+17 1E+17 DEPOSIT ABSOLUTE /begin FUNCTION_LIST accFanDuty5 /end FUNCTION_LIST /end AXIS_PTS
/begin AXIS_PTS CTRL_cellSegment4TempToLVDuty_LookupX "" 0x800383A0 CTRL_cellSegment4TempToLVDuty_LookupX_IN RECORD_LAYOUT__2 0 COMPU_METHOD__4 11 -1E+17 1E+17 DEPOSIT ABSOLUTE /begin FUNCTION_LIST accFanDuty5 /end FUNCTION_LIST /end AXIS_PTS
/begin AXIS_PTS CTRL_cellSegment5TempToHVDuty_LookupX "" 0x80038568 CTRL_cellSegment5TempToHVDuty_LookupX_IN RECORD_LAYOUT__2 0 COMPU_METHOD__4 11 -1E+17 1E+17 DEPOSIT ABSOLUTE /begin FUNCTION_LIST accFanDuty2 /end FUNCTION_LIST /end AXIS_PTS
/begin AXIS_PTS CTRL_cellSegment5TempToLVDuty_LookupX "" 0x80038510 CTRL_cellSegment5TempToLVDuty_LookupX_IN RECORD_LAYOUT__2 0 COMPU_METHOD__4 11 -1E+17 1E+17 DEPOSIT ABSOLUTE /begin FUNCTION_LIST accFanDuty2 /end FUNCTION_LIST /end AXIS_PTS
/begin AXIS_PTS CTRL_cellSegment6TempToHVDuty_LookupX "" 0x80038340 CTRL_cellSegment6TempToHVDuty_LookupX_IN RECORD_LAYOUT__2 0 COMPU_METHOD__4 11 -1E+17 1E+17 DEPOSIT ABSOLUTE /begin FUNCTION_LIST accFanDuty6 /end FUNCTION_LIST /end AXIS_PTS
/begin AXIS_PTS CTRL_cellSegment6TempToLVDuty_LookupX "" 0x800382E8 CTRL_cellSegment6TempToLVDuty_LookupX_IN RECORD_LAYOUT__2 0 COMPU_METHOD__4 11 -1E+17 1E+17 DEPOSIT ABSOLUTE /begin FUNCTION_LIST accFanDuty6 /end FUNCTION_LIST /end AXIS_PTS
/begin AXIS_PTS CTRL_cellSegment7TempToHVDuty_LookupX "" 0x800381D0 CTRL_cellSegment7TempToHVDuty_LookupX_IN RECORD_LAYOUT__2 0 COMPU_METHOD__4 11 -1E+17 1E+17 DEPOSIT ABSOLUTE /begin FUNCTION_LIST accFanDuty3 /end FUNCTION_LIST /end AXIS_PTS
/begin AXIS_PTS CTRL_cellSegment7TempToLVDuty_LookupX "" 0x80038178 CTRL_cellSegment7TempToLVDuty_LookupX_IN RECORD_LAYOUT__2 0 COMPU_METHOD__4 11 -1E+17 1E+17 DEPOSIT ABSOLUTE /begin FUNCTION_LIST accFanDuty3 /end FUNCTION_LIST /end AXIS_PTS
/begin AXIS_PTS CTRL_cellSegment8TempToHVDuty_LookupX "" 0x80038288 CTRL_cellSegment8TempToHVDuty_LookupX_IN RECORD_LAYOUT__2 0 COMPU_METHOD__4 11 -1E+17 1E+17 DEPOSIT ABSOLUTE /begin FUNCTION_LIST accFanDuty7 /end FUNCTION_LIST /end AXIS_PTS
/begin AXIS_PTS CTRL_cellSegment8TempToLVDuty_LookupX "" 0x80038230 CTRL_cellSegment8TempToLVDuty_LookupX_IN RECORD_LAYOUT__2 0 COMPU_METHOD__4 11 -1E+17 1E+17 DEPOSIT ABSOLUTE /begin FUNCTION_LIST accFanDuty7 /end FUNCTION_LIST /end AXIS_PTS
/begin AXIS_PTS CTRL_coolantTempInverterInToLeftHVDuty_LookupX "" 0x80038CB4 CTRL_coolantTempInverterInToLeftHVDuty_LookupX_IN RECORD_LAYOUT__2 0 COMPU_METHOD__4 11 -1E+17 1E+17 DEPOSIT ABSOLUTE /begin FUNCTION_LIST fanDutyLeft /end FUNCTION_LIST /end AXIS_PTS
/begin AXIS_PTS CTRL_coolantTempInverterInToLeftLVDuty_LookupX "" 0x80039030 CTRL_coolantTempInverterInToLeftLVDuty_LookupX_IN RECORD_LAYOUT__2 0 COMPU_METHOD__11 14 -1E+17 1E+17 DEPOSIT ABSOLUTE /begin FUNCTION_LIST fanDutyLeft /end FUNCTION_LIST /end AXIS_PTS
/begin AXIS_PTS CTRL_coolantTempInverterInToLeftLVDuty_LookupY "" 0x80039068 CTRL_coolantTempInverterInToLeftLVDuty_LookupY_IN RECORD_LAYOUT__2 0 COMPU_METHOD__4 11 -1E+17 1E+17 DEPOSIT ABSOLUTE /begin FUNCTION_LIST fanDutyLeft /end FUNCTION_LIST /end AXIS_PTS
/begin AXIS_PTS CTRL_coolantTempInverterInToRightHVDuty_LookupX "" 0x80039638 CTRL_coolantTempInverterInToRightHVDuty_LookupX_IN RECORD_LAYOUT__2 0 COMPU_METHOD__4 11 -1E+17 1E+17 DEPOSIT ABSOLUTE /begin FUNCTION_LIST fanDutyRight /end FUNCTION_LIST /end AXIS_PTS
/begin AXIS_PTS CTRL_coolantTempInverterInToRightLVDuty_LookupX "" 0x800399B4 CTRL_coolantTempInverterInToRightLVDuty_LookupX_IN RECORD_LAYOUT__2 0 COMPU_METHOD__11 14 -1E+17 1E+17 DEPOSIT ABSOLUTE /begin FUNCTION_LIST fanDutyRight /end FUNCTION_LIST /end AXIS_PTS
/begin AXIS_PTS CTRL_coolantTempInverterInToRightLVDuty_LookupY "" 0x800399EC CTRL_coolantTempInverterInToRightLVDuty_LookupY_IN RECORD_LAYOUT__2 0 COMPU_METHOD__4 11 -1E+17 1E+17 DEPOSIT ABSOLUTE /begin FUNCTION_LIST fanDutyRight /end FUNCTION_LIST /end AXIS_PTS
/begin AXIS_PTS CTRL_coolantTempInverterInToWpDuty_LookupX "" 0x8003A104 CTRL_coolantTempInverterInToWpDuty_LookupX_IN RECORD_LAYOUT__2 0 COMPU_METHOD__12 8 -1E+17 1E+17 DEPOSIT ABSOLUTE /begin FUNCTION_LIST wpDuty /end FUNCTION_LIST /end AXIS_PTS
/begin AXIS_PTS CTRL_coolantTempInverterInToWpDuty_LookupY "" 0x8003A124 CTRL_coolantTempInverterInToWpDuty_LookupY_IN RECORD_LAYOUT__2 0 COMPU_METHOD__4 11 -1E+17 1E+17 DEPOSIT ABSOLUTE /begin FUNCTION_LIST wpDuty /end FUNCTION_LIST /end AXIS_PTS
/begin AXIS_PTS CTRL_coolantTempInverterOutToLeftHVDuty_LookupX "" 0x80038D0C CTRL_coolantTempInverterOutToLeftHVDuty_LookupX_IN RECORD_LAYOUT__2 0 COMPU_METHOD__4 11 -1E+17 1E+17 DEPOSIT ABSOLUTE /begin FUNCTION_LIST fanDutyLeft /end FUNCTION_LIST /end AXIS_PTS
/begin AXIS_PTS CTRL_coolantTempInverterOutToLeftLVDuty_LookupX "" 0x800392FC CTRL_coolantTempInverterOutToLeftLVDuty_LookupX_IN RECORD_LAYOUT__2 0 COMPU_METHOD__11 14 -1E+17 1E+17 DEPOSIT ABSOLUTE /begin FUNCTION_LIST fanDutyLeft /end FUNCTION_LIST /end AXIS_PTS
/begin AXIS_PTS CTRL_coolantTempInverterOutToLeftLVDuty_LookupY "" 0x80039334 CTRL_coolantTempInverterOutToLeftLVDuty_LookupY_IN RECORD_LAYOUT__2 0 COMPU_METHOD__4 11 -1E+17 1E+17 DEPOSIT ABSOLUTE /begin FUNCTION_LIST fanDutyLeft /end FUNCTION_LIST /end AXIS_PTS
/begin AXIS_PTS CTRL_coolantTempInverterOutToRightHVDuty_LookupX "" 0x80039690 CTRL_coolantTempInverterOutToRightHVDuty_LookupX_IN RECORD_LAYOUT__2 0 COMPU_METHOD__4 11 -1E+17 1E+17 DEPOSIT ABSOLUTE /begin FUNCTION_LIST fanDutyRight /end FUNCTION_LIST /end AXIS_PTS
/begin AXIS_PTS CTRL_coolantTempInverterOutToRightLVDuty_LookupX "" 0x80039C80 CTRL_coolantTempInverterOutToRightLVDuty_LookupX_IN RECORD_LAYOUT__2 0 COMPU_METHOD__11 14 -1E+17 1E+17 DEPOSIT ABSOLUTE /begin FUNCTION_LIST fanDutyRight /end FUNCTION_LIST /end AXIS_PTS
/begin AXIS_PTS CTRL_coolantTempInverterOutToRightLVDuty_LookupY "" 0x80039CB8 CTRL_coolantTempInverterOutToRightLVDuty_LookupY_IN RECORD_LAYOUT__2 0 COMPU_METHOD__4 11 -1E+17 1E+17 DEPOSIT ABSOLUTE /begin FUNCTION_LIST fanDutyRight /end FUNCTION_LIST /end AXIS_PTS
/begin AXIS_PTS CTRL_coolantTempInverterOutToWpDuty_LookupX "" 0x8003A2B0 CTRL_coolantTempInverterOutToWpDuty_LookupX_IN RECORD_LAYOUT__2 0 COMPU_METHOD__12 8 -1E+17 1E+17 DEPOSIT ABSOLUTE /begin FUNCTION_LIST wpDuty /end FUNCTION_LIST /end AXIS_PTS
/begin AXIS_PTS CTRL_coolantTempInverterOutToWpDuty_LookupY "" 0x8003A2D0 CTRL_coolantTempInverterOutToWpDuty_LookupY_IN RECORD_LAYOUT__2 0 COMPU_METHOD__4 11 -1E+17 1E+17 DEPOSIT ABSOLUTE /begin FUNCTION_LIST wpDuty /end FUNCTION_LIST /end AXIS_PTS
/begin AXIS_PTS CTRL_coolantTempMotorInToLeftHVDuty_LookupX "" 0x80038C5C CTRL_coolantTempMotorInToLeftHVDuty_LookupX_IN RECORD_LAYOUT__2 0 COMPU_METHOD__4 11 -1E+17 1E+17 DEPOSIT ABSOLUTE /begin FUNCTION_LIST fanDutyLeft /end FUNCTION_LIST /end AXIS_PTS
/begin AXIS_PTS CTRL_coolantTempMotorInToLeftLVDuty_LookupX "" 0x80038D64 CTRL_coolantTempMotorInToLeftLVDuty_LookupX_IN RECORD_LAYOUT__2 0 COMPU_METHOD__11 14 -1E+17 1E+17 DEPOSIT ABSOLUTE /begin FUNCTION_LIST fanDutyLeft /end FUNCTION_LIST /end AXIS_PTS
/begin AXIS_PTS CTRL_coolantTempMotorInToLeftLVDuty_LookupY "" 0x80038D9C CTRL_coolantTempMotorInToLeftLVDuty_LookupY_IN RECORD_LAYOUT__2 0 COMPU_METHOD__4 11 -1E+17 1E+17 DEPOSIT ABSOLUTE /begin FUNCTION_LIST fanDutyLeft /end FUNCTION_LIST /end AXIS_PTS
/begin AXIS_PTS CTRL_coolantTempMotorInToRightHVDuty_LookupX "" 0x800395E0 CTRL_coolantTempMotorInToRightHVDuty_LookupX_IN RECORD_LAYOUT__2 0 COMPU_METHOD__4 11 -1E+17 1E+17 DEPOSIT ABSOLUTE /begin FUNCTION_LIST fanDutyRight /end FUNCTION_LIST /end AXIS_PTS
/begin AXIS_PTS CTRL_coolantTempMotorInToRightLVDuty_LookupX "" 0x800396E8 CTRL_coolantTempMotorInToRightLVDuty_LookupX_IN RECORD_LAYOUT__2 0 COMPU_METHOD__11 14 -1E+17 1E+17 DEPOSIT ABSOLUTE /begin FUNCTION_LIST fanDutyRight /end FUNCTION_LIST /end AXIS_PTS
/begin AXIS_PTS CTRL_coolantTempMotorInToRightLVDuty_LookupY "" 0x80039720 CTRL_coolantTempMotorInToRightLVDuty_LookupY_IN RECORD_LAYOUT__2 0 COMPU_METHOD__4 11 -1E+17 1E+17 DEPOSIT ABSOLUTE /begin FUNCTION_LIST fanDutyRight /end FUNCTION_LIST /end AXIS_PTS
/begin AXIS_PTS CTRL_coolantTempMotorInToWpDuty_LookupX "" 0x80039F58 CTRL_coolantTempMotorInToWpDuty_LookupX_IN RECORD_LAYOUT__2 0 COMPU_METHOD__12 8 -1E+17 1E+17 DEPOSIT ABSOLUTE /begin FUNCTION_LIST wpDuty /end FUNCTION_LIST /end AXIS_PTS
/begin AXIS_PTS CTRL_coolantTempMotorInToWpDuty_LookupY "" 0x80039F78 CTRL_coolantTempMotorInToWpDuty_LookupY_IN RECORD_LAYOUT__2 0 COMPU_METHOD__4 11 -1E+17 1E+17 DEPOSIT ABSOLUTE /begin FUNCTION_LIST wpDuty /end FUNCTION_LIST /end AXIS_PTS
/begin AXIS_PTS CTRL_throttleToNm_LookupX "" 0x80038744 CTRL_throttleToNm_LookupX_IN RECORD_LAYOUT__2 0 COMPU_METHOD__7 81 -1E+17 1E+17 DEPOSIT ABSOLUTE /begin FUNCTION_LIST torqueCommand_1_ /end FUNCTION_LIST /end AXIS_PTS
/begin AXIS_PTS CTRL_yawRateToAimSlip_LookupX "" 0x800389FC CTRL_yawRateToAimSlip_LookupX_IN RECORD_LAYOUT__2 0 COMPU_METHOD__10 13 -1E+17 1E+17 DEPOSIT ABSOLUTE /begin FUNCTION_LIST tractionControl_1_ /end FUNCTION_LIST /end AXIS_PTS
/begin AXIS_PTS CTRL_yawRateToAimSlip_LookupY "" 0x800389D4 CTRL_yawRateToAimSlip_LookupY_IN RECORD_LAYOUT__2 0 COMPU_METHOD__9 10 -1E+17 1E+17 DEPOSIT ABSOLUTE /begin FUNCTION_LIST tractionControl_1_ /end FUNCTION_LIST /end AXIS_PTS
/begin AXIS_PTS IN_coolantTempVToDegInverterIn_LookupX "" 0x8003A5CC IN_coolantTempVToDegInverterIn_LookupX_IN RECORD_LAYOUT__2 0 COMPU_METHOD__15 20 -1E+17 1E+17 DEPOSIT ABSOLUTE /begin FUNCTION_LIST coolantTempInverterIn /end FUNCTION_LIST /end AXIS_PTS
/begin AXIS_PTS IN_coolantTempVToDegInverterOut_LookupX "" 0x8003A670 IN_coolantTempVToDegInverterOut_LookupX_IN RECORD_LAYOUT__2 0 COMPU_METHOD__15 20 -1E+17 1E+17 DEPOSIT ABSOLUTE /begin FUNCTION_LIST coolantTempInverterOut /end FUNCTION_LIST /end AXIS_PTS
/begin AXIS_PTS IN_coolantTempVToDegMotorIn_LookupX "" 0x8003A528 IN_coolantTempVToDegMotorIn_LookupX_IN RECORD_LAYOUT__2 0 COMPU_METHOD__15 20 -1E+17 1E+17 DEPOSIT ABSOLUTE /begin FUNCTION_LIST coolantTempMotorIn /end FUNCTION_LIST /end AXIS_PTS
/begin AXIS_PTS IN_rotorTempVToDegFL_LookupX "" 0x8003A7F4 IN_rotorTempVToDegFL_LookupX_IN RECORD_LAYOUT__2 0 COMPU_METHOD__15 17 -1E+17 1E+17 DEPOSIT ABSOLUTE /begin FUNCTION_LIST rotorTemp_1_ /end FUNCTION_LIST /end AXIS_PTS
/begin AXIS_PTS IN_rotorTempVToDegFR_LookupX "" 0x8003A94C IN_rotorTempVToDegFR_LookupX_IN RECORD_LAYOUT__2 0 COMPU_METHOD__15 17 -1E+17 1E+17 DEPOSIT ABSOLUTE /begin FUNCTION_LIST rotorTemp2 /end FUNCTION_LIST /end AXIS_PTS
/begin AXIS_PTS IN_rotorTempVToDegRL_LookupX "" 0x8003A8A0 IN_rotorTempVToDegRL_LookupX_IN RECORD_LAYOUT__2 0 COMPU_METHOD__15 17 -1E+17 1E+17 DEPOSIT ABSOLUTE /begin FUNCTION_LIST rotorTemp1 /end FUNCTION_LIST /end AXIS_PTS
/begin AXIS_PTS IN_rotorTempVToDegRR_LookupX "" 0x8003A9F8 IN_rotorTempVToDegRR_LookupX_IN RECORD_LAYOUT__2 0 COMPU_METHOD__15 17 -1E+17 1E+17 DEPOSIT ABSOLUTE /begin FUNCTION_LIST rotorTemp3 /end FUNCTION_LIST /end AXIS_PTS
/begin AXIS_PTS IN_tcSetTable_LookupX "" 0x8003A4C8 IN_tcSetTable_LookupX_IN RECORD_LAYOUT__2 0 COMPU_METHOD__13 12 -1E+17 1E+17 DEPOSIT ABSOLUTE /begin FUNCTION_LIST tcDial_1_ /end FUNCTION_LIST /end AXIS_PTS
/begin AXIS_PTS IN_tireTempVToDegFLI_LookupX "" 0x8003AAEC IN_tireTempVToDegFLI_LookupX_IN RECORD_LAYOUT__2 0 COMPU_METHOD__15 8 -1E+17 1E+17 DEPOSIT ABSOLUTE /begin FUNCTION_LIST tireTempFLI /end FUNCTION_LIST /end AXIS_PTS
/begin AXIS_PTS IN_tireTempVToDegFLM_LookupX "" 0x8003AB50 IN_tireTempVToDegFLM_LookupX_IN RECORD_LAYOUT__2 0 COMPU_METHOD__15 8 -1E+17 1E+17 DEPOSIT ABSOLUTE /begin FUNCTION_LIST tireTempFLM /end FUNCTION_LIST /end AXIS_PTS
/begin AXIS_PTS IN_tireTempVToDegFLO_LookupX "" 0x8003ABB4 IN_tireTempVToDegFLO_LookupX_IN RECORD_LAYOUT__2 0 COMPU_METHOD__15 8 -1E+17 1E+17 DEPOSIT ABSOLUTE /begin FUNCTION_LIST tireTempFLO /end FUNCTION_LIST /end AXIS_PTS
/begin AXIS_PTS IN_tireTempVToDegFRI_LookupX "" 0x8003AC18 IN_tireTempVToDegFRI_LookupX_IN RECORD_LAYOUT__2 0 COMPU_METHOD__15 8 -1E+17 1E+17 DEPOSIT ABSOLUTE /begin FUNCTION_LIST tireTempFRI /end FUNCTION_LIST /end AXIS_PTS
/begin AXIS_PTS IN_tireTempVToDegFRM_LookupX "" 0x8003AC7C IN_tireTempVToDegFRM_LookupX_IN RECORD_LAYOUT__2 0 COMPU_METHOD__15 8 -1E+17 1E+17 DEPOSIT ABSOLUTE /begin FUNCTION_LIST tireTempFRM /end FUNCTION_LIST /end AXIS_PTS
/begin AXIS_PTS IN_tireTempVToDegFRO_LookupX "" 0x8003ACE0 IN_tireTempVToDegFRO_LookupX_IN RECORD_LAYOUT__2 0 COMPU_METHOD__15 8 -1E+17 1E+17 DEPOSIT ABSOLUTE /begin FUNCTION_LIST tireTempFRO /end FUNCTION_LIST /end AXIS_PTS
/begin AXIS_PTS IN_tireTempVToDegRLI_LookupX "" 0x8003AD44 IN_tireTempVToDegRLI_LookupX_IN RECORD_LAYOUT__2 0 COMPU_METHOD__15 8 -1E+17 1E+17 DEPOSIT ABSOLUTE /begin FUNCTION_LIST tireTempRLI /end FUNCTION_LIST /end AXIS_PTS
/begin FUNCTION Diagnostics "Diagnostics" /begin SUB_FUNCTION PowerUp_Down /end SUB_FUNCTION /end FUNCTION
/begin FUNCTION PowerUp_Down "PowerUp_Down" /end FUNCTION
/begin FUNCTION EVSR24 "EVSR24" /begin SUB_FUNCTION Foreground /end SUB_FUNCTION /end FUNCTION
/begin FUNCTION Foreground "Foreground" /begin SUB_FUNCTION ControlsAlgorithms Inputs Outputs /end SUB_FUNCTION /end FUNCTION
/begin FUNCTION ControlsAlgorithms "ControlsAlgorithms" /begin SUB_FUNCTION controls /end SUB_FUNCTION /end FUNCTION
/begin FUNCTION controls "controls"
 /begin SUB_FUNCTION airCoolingDuty brakeBias brakelight bspd torqueCommand tractionControl waterCoolingDuty wheelSlip /end SUB_FUNCTION
/end FUNCTION
/begin FUNCTION airCoolingDuty "airCoolingDuty"
 /begin SUB_FUNCTION accFanDuty accFanDuty1 accFanDuty2 accFanDuty3 accFanDuty4 accFanDuty5 accFanDuty6 accFanDuty7 /end SUB_FUNCTION
/end FUNCTION
/begin FUNCTION accFanDuty "accFanDuty" /end FUNCTION
/begin FUNCTION accFanDuty1 "accFanDuty1" /end FUNCTION
/begin FUNCTION accFanDuty2 "accFanDuty2" /end FUNCTION
/begin FUNCTION accFanDuty3 "accFanDuty3" /end FUNCTION
/begin FUNCTION accFanDuty4 "accFanDuty4" /end FUNCTION
/begin FUNCTION accFanDuty5 "accFanDuty5" /end FUNCTION
/begin FUNCTION accFanDuty6 "accFanDuty6" /end FUNCTION
/begin FUNCTION accFanDuty7 "accFanDuty7" /end FUNCTION
/begin FUNCTION brakeBias "brakeBias" /begin SUB_FUNCTION brakeBias_1_ /end SUB_FUNCTION /end FUNCTION
/begin FUNCTION brakeBias_1_ "brakeBias" /end FUNCTION
/begin FUNCTION brakelight "brakelight" /begin SUB_FUNCTION brakelight_1_ /end SUB_FUNCTION /end FUNCTION
/begin FUNCTION brakelight_1_ "brakelight" /begin SUB_FUNCTION Override /end SUB_FUNCTION /end FUNCTION
/begin FUNCTION Override "Override" /end FUNCTION
/begin FUNCTION bspd "bspd" /begin SUB_FUNCTION bspc /end SUB_FUNCTION /end FUNCTION
/begin FUNCTION bspc "bspc" /end FUNCTION
/begin FUNCTION torqueCommand "torqueCommand" /begin SUB_FUNCTION torqueCommand_1_ /end SUB_FUNCTION /end FUNCTION
/begin FUNCTION torqueCommand_1_ "torqueCommand" /begin SUB_FUNCTION Override_1_ /end SUB_FUNCTION /end FUNCTION
/begin FUNCTION Override_1_ "Override" /end FUNCTION
/begin FUNCTION tractionControl "tractionControl" /begin SUB_FUNCTION muEstimator tractionControl_1_ /end SUB_FUNCTION /end FUNCTION
/begin FUNCTION muEstimator "muEstimator" /end FUNCTION
/begin FUNCTION tractionControl_1_ "tractionControl" /begin SUB_FUNCTION Override_2_ /end SUB_FUNCTION /end FUNCTION
/begin FUNCTION Override_2_ "Override" /end FUNCTION
/begin FUNCTION waterCoolingDuty "waterCoolingDuty" /begin SUB_FUNCTION fanDutyLeft fanDutyRight wpDuty /end SUB_FUNCTION /end FUNCTION
/begin FUNCTION fanDutyLeft "fanDutyLeft" /end FUNCTION
/begin FUNCTION fanDutyRight "fanDutyRight" /end FUNCTION
/begin FUNCTION wpDuty "wpDuty" /end FUNCTION
/begin FUNCTION wheelSlip "wheelSlip" /begin SUB_FUNCTION driveSpeed groundSpeed slipRatio /end SUB_FUNCTION /end FUNCTION
/begin FUNCTION driveSpeed "driveSpeed" /end FUNCTION
/begin FUNCTION groundSpeed "groundSpeed" /end FUNCTION
/begin FUNCTION slipRatio "slipRatio" /end FUNCTION
/begin FUNCTION Inputs "Inputs" /begin SUB_FUNCTION analogInputs digitalInputs /end SUB_FUNCTION /end FUNCTION
/begin FUNCTION analogInputs "analogInputs"
 /begin SUB_FUNCTION brakePressure coolantTemp rotorTemp startSwitch tcDial throttleInput tireTemp tsSwitch wheelSpeed /end SUB_FUNCTION
/end FUNCTION
/begin FUNCTION brakePressure "brakePressure"
 /begin SUB_FUNCTION brakePressureF brakePressureR bspdBrakeError bspdStatusError /end SUB_FUNCTION
/end FUNCTION
/begin FUNCTION brakePressureF "brakePressureF" /begin SUB_FUNCTION Override_3_ /end SUB_FUNCTION /end FUNCTION
/begin FUNCTION Override_3_ "Override" /end FUNCTION
/begin FUNCTION brakePressureR "brakePressureR" /begin SUB_FUNCTION Override_4_ /end SUB_FUNCTION /end FUNCTION
/begin FUNCTION Override_4_ "Override" /end FUNCTION
/begin FUNCTION bspdBrakeError "bspdBrakeError" /end FUNCTION
/begin FUNCTION bspdStatusError "bspdStatusError" /end FUNCTION
/begin FUNCTION coolantTemp "coolantTemp"
 /begin SUB_FUNCTION coolantTempInverterIn coolantTempInverterOut coolantTempMotorIn /end SUB_FUNCTION
/end FUNCTION
/begin FUNCTION coolantTempInverterIn "coolantTempInverterIn" /begin SUB_FUNCTION Override_5_ /end SUB_FUNCTION /end FUNCTION
/begin FUNCTION Override_5_ "Override" /end FUNCTION
/begin FUNCTION coolantTempInverterOut "coolantTempInverterOut" /begin SUB_FUNCTION Override_6_ /end SUB_FUNCTION /end FUNCTION
/begin FUNCTION Override_6_ "Override" /end FUNCTION
/begin FUNCTION coolantTempMotorIn "coolantTempMotorIn" /begin SUB_FUNCTION Override_7_ /end SUB_FUNCTION /end FUNCTION
/begin FUNCTION Override_7_ "Override" /end FUNCTION
/begin FUNCTION rotorTemp "rotorTemp" /begin SUB_FUNCTION rotorTemp_1_ rotorTemp1 rotorTemp2 rotorTemp3 /end SUB_FUNCTION /end FUNCTION
/begin FUNCTION rotorTemp_1_ "rotorTemp" /begin SUB_FUNCTION Override_10_ /end SUB_FUNCTION /end FUNCTION
/begin FUNCTION Override_10_ "Override" /end FUNCTION
/begin FUNCTION rotorTemp1 "rotorTemp1" /begin SUB_FUNCTION Override_11_ /end SUB_FUNCTION /end FUNCTION
/begin FUNCTION Override_11_ "Override" /end FUNCTION
/begin FUNCTION rotorTemp2 "rotorTemp2" /begin SUB_FUNCTION Override_12_ /end SUB_FUNCTION /end FUNCTION
/begin FUNCTION Override_12_ "Override" /end FUNCTION
/begin FUNCTION rotorTemp3 "rotorTemp3" /begin SUB_FUNCTION Override_13_ /end SUB_FUNCTION /end FUNCTION
/begin FUNCTION Override_13_ "Override" /end FUNCTION
/begin FUNCTION startSwitch "startSwitch" /begin SUB_FUNCTION Subsystem /end SUB_FUNCTION /end FUNCTION
/begin FUNCTION Subsystem "Subsystem" /end FUNCTION
/begin FUNCTION tcDial "tcDial" /begin SUB_FUNCTION tcDial_1_ /end SUB_FUNCTION /end FUNCTION
/begin FUNCTION tcDial_1_ "tcDial" /end FUNCTION
/begin FUNCTION throttleInput "throttleInput" /begin SUB_FUNCTION APPS throttle1Input throttle2Input /end SUB_FUNCTION /end FUNCTION
/begin FUNCTION APPS "APPS" /end FUNCTION
/begin FUNCTION throttle1Input "throttle1Input" /begin SUB_FUNCTION Override_8_ /end SUB_FUNCTION /end FUNCTION
/begin FUNCTION Override_8_ "Override" /end FUNCTION
/begin FUNCTION throttle2Input "throttle2Input" /begin SUB_FUNCTION Override_9_ /end SUB_FUNCTION /end FUNCTION
/begin FUNCTION Override_9_ "Override" /end FUNCTION
/begin FUNCTION tireTemp "tireTemp"
 /begin SUB_FUNCTION tireTempFLI tireTempFLM tireTempFLO tireTempFRI tireTempFRM tireTempFRO tireTempRLI tireTempRLM tireTempRLO tireTempRRI tireTempRRM tireTempRRO /end SUB_FUNCTION
/end FUNCTION
/begin FUNCTION tireTempFLI "tireTempFLI" /begin SUB_FUNCTION Override_14_ /end SUB_FUNCTION /end FUNCTION
/begin FUNCTION Override_14_ "Override" /end FUNCTION
/begin FUNCTION tireTempFLM "tireTempFLM" /begin SUB_FUNCTION Override_15_ /end SUB_FUNCTION /end FUNCTION
/begin FUNCTION Override_15_ "Override" /end FUNCTION
/begin FUNCTION tireTempFLO "tireTempFLO" /begin SUB_FUNCTION Override_16_ /end SUB_FUNCTION /end FUNCTION
/begin FUNCTION Override_16_ "Override" /end FUNCTION
/begin FUNCTION tireTempFRI "tireTempFRI" /begin SUB_FUNCTION Override_17_ /end SUB_FUNCTION /end FUNCTION
/begin FUNCTION Override_17_ "Override" /end FUNCTION
/begin FUNCTION tireTempFRM "tireTempFRM" /begin SUB_FUNCTION Override_18_ /end SUB_FUNCTION /end FUNCTION
/begin FUNCTION Override_18_ "Override" /end FUNCTION
/begin FUNCTION tireTempFRO "tireTempFRO" /begin SUB_FUNCTION Override_19_ /end SUB_FUNCTION /end FUNCTION
/begin FUNCTION Override_19_ "Override" /end FUNCTION
/begin FUNCTION tireTempRLI "tireTempRLI" /begin SUB_FUNCTION Override_20_ /end SUB_FUNCTION /end FUNCTION
/begin FUNCTION Override_20_ "Override" /end FUNCTION
/begin USER_RIGHTS Access1 /begin REF_GROUP GroupAccess1 /end REF_GROUP /end USER_RIGHTS
/begin GROUP GroupAccess1
 /begin REF_CHARACTERISTIC KeySwHiTimeThr KeySwLoTimeThr CTRL_upperThreshCellSeg7LV CTRL_upperThreshCellSeg7HV CTRL_cellSegment7TempToLVDuty_LookupX CTRL_cellSegment7TempToLVDuty CTRL_cellSegment7TempToHVDuty_LookupX CTRL_cellSegment7TempToHVDuty CTRL_upperThreshCellSeg8LV CTRL_upperThreshCellSeg8HV CTRL_cellSegment8TempToLVDuty_LookupX CTRL_cellSegment8TempToLVDuty CTRL_cellSegment8TempToHVDuty_LookupX CTRL_cellSegment8TempToHVDuty CTRL_upperThreshCellSeg6LV CTRL_upperThreshCellSeg6HV CTRL_cellSegment6TempToLVDuty_LookupX CTRL_cellSegment6TempToLVDuty CTRL_cellSegment6TempToHVDuty_LookupX CTRL_cellSegment6TempToHVDuty CTRL_upperThreshCellSeg4LV CTRL_upperThreshCellSeg4HV CTRL_cellSegment4TempToLVDuty_LookupX CTRL_cellSegment4TempToLVDuty CTRL_cellSegment4TempToHVDuty_LookupX CTRL_cellSegment4TempToHVDuty CTRL_upperThreshCellSeg2LV CTRL_upperThreshCellSeg2HV CTRL_cellSegment2TempToLVDuty_LookupX CTRL_cellSegment2TempToLVDuty CTRL_cellSegment2TempToHVDuty_LookupX CTRL_cellSegment2TempToHVDuty CTRL_upperThreshCellSeg5LV CTRL_upperThreshCellSeg5HV CTRL_cellSegment5TempToLVDuty_LookupX CTRL_cellSegment5TempToLVDuty CTRL_cellSegment5TempToHVDuty_LookupX CTRL_cellSegment5TempToHVDuty CTRL_upperThreshCellSeg3LV CTRL_upperThreshCellSeg3HV CTRL_cellSegment3TempToLVDuty_LookupX CTRL_cellSegment3TempToLVDuty CTRL_cellSegment3TempToHVDuty_LookupX CTRL_cellSegment3TempToHVDuty CTRL_upperThreshCellSeg1LV CTRL_upperThreshCellSeg1HV CTRL_cellSegment1TempToLVDuty_LookupX CTRL_cellSegment1TempToLVDuty CTRL_cellSegment1TempToHVDuty_LookupX CTRL_cellSegment1TempToHVDuty CTRL_upperThreshBrakeBias CTRL_dbzBrakeBias CTRL_brakelight_bool CTRL_upperThreshBrakelight CTRL_brakelight_bool_OvrVal CTRL_brakelight_bool_OvrSts CTRL_bspcTorqueOverride_Nm CTRL_throttleToNm_LookupX CTRL_throttleToNm CTRL_torqueCommand_Nm_OvrVal CTRL_torqueCommand_Nm_OvrSts CTRL_torqueCommandOverride_bool IN_tcSet_OvrVal IN_tcSet_OvrSts CTRL_tcOverride_bool CTRL_yawRateToAimSlip_LookupY CTRL_yawRateToAimSlip_LookupX CTRL_yawRateToAimSlip CTRL_upperThreshPIDIn CTRL_upperThreshPwrReduction IN_slipThreshold CTRL_upperThreshCoolantInverterInLVLeft CTRL_upperThreshCoolantMotorInLVLeft CTRL_upperThreshCoolantInverterOutLVLeft CTRL_upperThreshCoolantInverterInHVLeft CTRL_upperThreshCoolantMotorInHVLeft CTRL_upperThreshCoolantInverterOutHVLeft CTRL_coolantTempMotorInToLeftHVDuty_LookupX CTRL_coolantTempMotorInToLeftHVDuty CTRL_coolantTempInverterInToLeftHVDuty_LookupX CTRL_coolantTempInverterInToLeftHVDuty CTRL_coolantTempInverterOutToLeftHVDuty_LookupX CTRL_coolantTempInverterOutToLeftHVDuty CTRL_coolantTempMotorInToLeftLVDuty_LookupX CTRL_coolantTempMotorInToLeftLVDuty_LookupY CTRL_coolantTempMotorInToLeftLVDuty CTRL_coolantTempInverterInToLeftLVDuty_LookupX CTRL_coolantTempInverterInToLeftLVDuty_LookupY CTRL_coolantTempInverterInToLeftLVDuty CTRL_coolantTempInverterOutToLeftLVDuty_LookupX CTRL_coolantTempInverterOutToLeftLVDuty_LookupY CTRL_coolantTempInverterOutToLeftLVDuty CTRL_upperThreshCoolantInverterInLVRight CTRL_upperThreshCoolantMotorInLVRight CTRL_upperThreshCoolantInverterOutLVRight CTRL_upperThreshCoolantInverterInHVRight CTRL_upperThreshCoolantMotorInHVRight CTRL_upperThreshCoolantInverterOutHVRight CTRL_coolantTempMotorInToRightHVDuty_LookupX CTRL_coolantTempMotorInToRightHVDuty CTRL_coolantTempInverterInToRightHVDuty_LookupX CTRL_coolantTempInverterInToRightHVDuty CTRL_coolantTempInverterOutToRightHVDuty_LookupX CTRL_coolantTempInverterOutToRightHVDuty CTRL_coolantTempMotorInToRightLVDuty_LookupX CTRL_coolantTempMotorInToRightLVDuty_LookupY CTRL_coolantTempMotorInToRightLVDuty CTRL_coolantTempInverterInToRightLVDuty_LookupX CTRL_coolantTempInverterInToRightLVDuty_LookupY CTRL_coolantTempInverterInToRightLVDuty CTRL_coolantTempInverterOutToRightLVDuty_LookupX CTRL_coolantTempInverterOutToRightLVDuty_LookupY CTRL_coolantTempInverterOutToRightLVDuty CTRL_upperThreshCoolantInverterIn CTRL_upperThreshCoolantMotorIn CTRL_upperThreshCoolantInverterOut CTRL_coolantTempMotorInToWpDuty_LookupX CTRL_coolantTempMotorInToWpDuty_LookupY CTRL_coolantTempMotorInToWpDuty CTRL_coolantTempInverterInToWpDuty_LookupX CTRL_coolantTempInverterInToWpDuty_LookupY CTRL_coolantTempInverterInToWpDuty CTRL_coolantTempInverterOutToWpDuty_LookupX CTRL_coolantTempInverterOutToWpDuty_LookupY CTRL_coolantTempInverterOutToWpDuty CTRL_slipRatioUpperThresh CTRL_slipConstant IN_brakePosF_zero IN_brakePosOverrideF_pct_OvrVal IN_brakePosOverrideF_pct_OvrSts IN_brakePosOverrideF_bool IN_brakePosR_zero IN_brakePosOverrideR_pct_OvrVal IN_brakePosOverrideR_pct_OvrSts IN_brakePosOverrideR_bool IN_coolantTempInverterIn_deg_OvrVal IN_coolantTempInverterIn_deg_OvrSts IN_coolantTempInverterOut_deg_OvrVal IN_coolantTempInverterOut_deg_OvrSts IN_coolantTempMotorIn_deg_OvrVal IN_coolantTempMotorIn_deg_OvrSts IN_throttlePos1_zero IN_throttleOverride1_pct_OvrVal IN_throttleOverride1_pct_OvrSts IN_throttleOverride1_bool IN_throttlePos2_zero IN_throttleOverride2_pct_OvrVal IN_throttleOverride2_pct_OvrSts IN_throttleOverride2_bool IN_brakePressureF_vToPsi IN_brakePressureR_vToPsi IN_brakeHighF_v IN_brakeLowF_v IN_brakePressureF_psiToPct IN_throttleHigh1_v IN_throttleLow1_v IN_throttle1_degPerV IN_throttleOffset1_deg IN_throttlePos1_pctPerDeg CTRL_bspcThrottleThresh_pct IN_throttleHigh2_v IN_throttleLow2_v IN_throttle2_degPerV IN_throttleOffset2_deg IN_throttlePos2_pctPerDeg CTRL_bspcBrakeThresh_pct IN_brakeHighR_v IN_brakeLowR_v IN_brakePressureR_psiToPct IN_tcSetTable_LookupX IN_tcSetTable IN_coolantTempVToDegMotorIn_LookupX IN_coolantTempVToDegMotorIn IN_coolantTempMotorIn_bool IN_coolantTempVToDegInverterIn_LookupX IN_coolantTempVToDegInverterIn IN_coolantTempInverterIn_bool IN_coolantTempVToDegInverterOut_LookupX IN_coolantTempVToDegInverterOut IN_coolantTempInverterOut_bool IN_bspdBrakeBadHigh IN_bspdBrakeBadLow IN_bspdBrakeGoodLow IN_bspdBrakeGoodHigh IN_bspdStatusBadHigh IN_bspdStatusBadLow IN_bspdStatusGoodLow IN_bspdStatusGoodHigh IN_coolantTempLowInverterIn_v IN_coolantTempHighInverterIn_v IN_coolantTempLowInverterOut_v IN_coolantTempHighInverterOut_v IN_coolantTempLowMotorIn_v IN_coolantTempHighMotorIn_v IN_rotorTempLowFL_v IN_rotorTempHighFL_v IN_rotorTempVToDegFL_LookupX IN_rotorTempVToDegFL IN_rotorTempFL_deg_OvrVal IN_rotorTempFL_deg_OvrSts IN_rotorTempFL_bool IN_rotorTempLowRL_v IN_rotorTempHighRL_v IN_rotorTempVToDegRL_LookupX IN_rotorTempVToDegRL IN_rotorTempRL_deg_OvrVal IN_rotorTempRL_deg_OvrSts IN_rotorTempRL_bool IN_rotorTempLowFR_v IN_rotorTempHighFR_v IN_rotorTempVToDegFR_LookupX IN_rotorTempVToDegFR IN_rotorTempFR_deg_OvrVal IN_rotorTempFR_deg_OvrSts IN_rotorTempFR_bool IN_rotorTempLowRR_v IN_rotorTempHighRR_v IN_rotorTempVToDegRR_LookupX IN_rotorTempVToDegRR IN_rotorTempRR_deg_OvrVal IN_rotorTempRR_deg_OvrSts IN_rotorTempRR_bool IN_startSwitchNOHighUpperThresh IN_startSwitchNOHighLowerThresh IN_startSwitchNOLowLowerThresh IN_appsThreshold IN_tireTempLowFLI_v IN_tireTempHighFLI_v IN_tireTempVToDegFLI_LookupX IN_tireTempVToDegFLI IN_tireTempFLI_deg_OvrVal IN_tireTempFLI_deg_OvrSts IN_tireTempFLI_bool IN_tireTempLowFLM_v IN_tireTempHighFLM_v IN_tireTempVToDegFLM_LookupX IN_tireTempVToDegFLM IN_tireTempFLM_deg_OvrVal IN_tireTempFLM_deg_OvrSts IN_tireTempFLM_bool IN_tireTempLowFLO_v IN_tireTempHighFLO_v IN_tireTempVToDegFLO_LookupX IN_tireTempVToDegFLO IN_tireTempFLO_deg_OvrVal IN_tireTempFLO_deg_OvrSts IN_tireTempFLO_bool IN_tireTempLowFRI_v IN_tireTempHighFRI_v IN_tireTempVToDegFRI_LookupX IN_tireTempVToDegFRI IN_tireTempFRI_deg_OvrVal IN_tireTempFRI_deg_OvrSts IN_tireTempFRI_bool IN_tireTempLowFRM_v IN_tireTempHighFRM_v IN_tireTempVToDegFRM_LookupX IN_tireTempVToDegFRM IN_tireTempFRM_deg_OvrVal IN_tireTempFRM_deg_OvrSts IN_tireTempFRM_bool IN_tireTempLowFRO_v IN_tireTempHighFRO_v IN_tireTempVToDegFRO_LookupX IN_tireTempVToDegFRO IN_tireTempFRO_deg_OvrVal IN_tireTempFRO_deg_OvrSts IN_tireTempFRO_bool IN_tireTempLowRLI_v IN_tireTempHighRLI_v IN_tireTempVToDegRLI_LookupX IN_tireTempVToDegRLI IN_tireTempRLI_deg_OvrVal IN_tireTempRLI_deg_OvrSts IN_tireTempRLI_bool DATA_unloadedWheelRadius_m DATA_wheelTooth_ct DATA_maxMotorTorque_Nm /end REF_CHARACTERISTIC
 /begin REF_MEASUREMENT FgndTasksStopped KeySw_Bgnd KeepModuleOn CTRL_cellSegment7TempToLVDuty_LookupX_IN CTRL_cellSegment7TempToHVDuty_LookupX_IN CTRL_cellSegment8TempToLVDuty_LookupX_IN CTRL_cellSegment8TempToHVDuty_LookupX_IN CTRL_cellSegment6TempToLVDuty_LookupX_IN CTRL_cellSegment6TempToHVDuty_LookupX_IN CTRL_cellSegment4TempToLVDuty_LookupX_IN CTRL_cellSegment4TempToHVDuty_LookupX_IN CTRL_cellSegment2TempToLVDuty_LookupX_IN CTRL_cellSegment2TempToHVDuty_LookupX_IN CTRL_cellSegment5TempToLVDuty_LookupX_IN CTRL_cellSegment5TempToHVDuty_LookupX_IN CTRL_cellSegment3TempToLVDuty_LookupX_IN CTRL_cellSegment3TempToHVDuty_LookupX_IN CTRL_cellSegment1TempToLVDuty_LookupX_IN CTRL_cellSegment1TempToHVDuty_LookupX_IN CTRL_throttleToNm_LookupX_IN CTRL_torqueCommand_Nm CTRL_yawRateToAimSlip_LookupY_IN CTRL_yawRateToAimSlip_LookupX_IN CTRL_slipAim CTRL_slipAimError CTRL_tcPowerReduction_pct CTRL_coolantTempMotorInToLeftHVDuty_LookupX_IN CTRL_coolantTempInverterInToLeftHVDuty_LookupX_IN CTRL_coolantTempInverterOutToLeftHVDuty_LookupX_IN CTRL_coolantTempMotorInToLeftLVDuty_LookupX_IN CTRL_coolantTempMotorInToLeftLVDuty_LookupY_IN CTRL_coolantTempInverterInToLeftLVDuty_LookupX_IN CTRL_coolantTempInverterInToLeftLVDuty_LookupY_IN CTRL_coolantTempInverterOutToLeftLVDuty_LookupX_IN CTRL_coolantTempInverterOutToLeftLVDuty_LookupY_IN CTRL_coolantTempMotorInToRightHVDuty_LookupX_IN CTRL_coolantTempInverterInToRightHVDuty_LookupX_IN CTRL_coolantTempInverterOutToRightHVDuty_LookupX_IN CTRL_coolantTempMotorInToRightLVDuty_LookupX_IN CTRL_coolantTempMotorInToRightLVDuty_LookupY_IN CTRL_coolantTempInverterInToRightLVDuty_LookupX_IN CTRL_coolantTempInverterInToRightLVDuty_LookupY_IN CTRL_coolantTempInverterOutToRightLVDuty_LookupX_IN CTRL_coolantTempInverterOutToRightLVDuty_LookupY_IN CTRL_coolantTempMotorInToWpDuty_LookupX_IN CTRL_coolantTempMotorInToWpDuty_LookupY_IN CTRL_coolantTempInverterInToWpDuty_LookupX_IN CTRL_coolantTempInverterInToWpDuty_LookupY_IN CTRL_coolantTempInverterOutToWpDuty_LookupX_IN CTRL_coolantTempInverterOutToWpDuty_LookupY_IN CTRL_driveSpeed_mph CTRL_groundSpeed_mph CTRL_slipRatio IN_coolantTempInverterIn_deg IN_coolantTempInverterOut_deg IN_coolantTempMotorIn_deg IN_throttleOverride1_pct IN_throttleOverride2_pct IN_tcSetTable_LookupX_IN IN_coolantTempVToDegMotorIn_LookupX_IN IN_coolantTempVToDegInverterIn_LookupX_IN IN_coolantTempVToDegInverterOut_LookupX_IN IN_brakePressureF_psi IN_brakePressureR_psi IN_bspdBrakeError_v IN_bspdStatusError_v IN_rotorTempVToDegFL_LookupX_IN IN_rotorTempFL_deg IN_rotorTempVToDegRL_LookupX_IN IN_rotorTempRL_deg IN_rotorTempVToDegFR_LookupX_IN IN_rotorTempFR_deg IN_rotorTempVToDegRR_LookupX_IN IN_rotorTempRR_deg IN_startSwitchSig_v IN_tcSetInput IN_throttlePos1_deg IN_throttlePos2_deg IN_tireTempVToDegFLI_LookupX_IN IN_tireTempFLI_deg IN_tireTempVToDegFLM_LookupX_IN IN_tireTempFLM_deg IN_tireTempVToDegFLO_LookupX_IN IN_tireTempFLO_deg IN_tireTempVToDegFRI_LookupX_IN IN_tireTempFRI_deg IN_tireTempVToDegFRM_LookupX_IN IN_tireTempFRM_deg IN_tireTempVToDegFRO_LookupX_IN IN_tireTempFRO_deg IN_tireTempVToDegRLI_LookupX_IN IN_tireTempRLI_deg /end REF_MEASUREMENT
/end GROUP
/end MODULE
/end PROJECT
